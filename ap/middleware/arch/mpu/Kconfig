## ap/middleware/arch/mpu/Kconfig
```kconfig
menu "Arch::MPU"
	config MPU
		bool "Enable Memory Protect Unit Feature"
		default n
		help
			Enable Memory Protection Unit support for region attributes and
			access protection. This is required by some cacheable-memory and
			memory-isolation configurations.
endmenu
```

## ap/middleware/compal/Kconfig
```kconfig
menu "Compatibility Layer"
	depends on FREERTOS_V10

	config COMMON_IO
		bool "Enable Common Io"
		default n
		help
			Amazon Common IO

endmenu
```

## ap/middleware/driver/Kconfig
```kconfig
menu "SoC Low-level Drivers"
	menu "System Control"
	source "${ARMINO_PATH}/middleware/driver/common/Kconfig"
	source "${ARMINO_PATH}/middleware/driver/device/Kconfig"
	source "${ARMINO_PATH}/middleware/driver/sys_ctrl/Kconfig"
	source "${ARMINO_PATH}/middleware/driver/icu/Kconfig"
	source "${ARMINO_PATH}/middleware/driver/reset_reason/Kconfig"
	source "${ARMINO_PATH}/middleware/driver/chip_support/Kconfig"
	source "${ARMINO_PATH}/middleware/driver/dbg_probe/Kconfig"
	source "${ARMINO_PATH}/middleware/driver/sys_sw_regs/Kconfig"
	endmenu

	menu "Bus & IO"
	source "${ARMINO_PATH}/middleware/driver/uart/Kconfig"
	source "${ARMINO_PATH}/middleware/driver/gpio/Kconfig"
	source "${ARMINO_PATH}/middleware/driver/i2c/Kconfig"
	source "${ARMINO_PATH}/middleware/driver/spi/Kconfig"
	source "${ARMINO_PATH}/middleware/driver/qspi/Kconfig"
	source "${ARMINO_PATH}/middleware/driver/lin/Kconfig"
	source "${ARMINO_PATH}/middleware/driver/can/Kconfig"
	source "${ARMINO_PATH}/middleware/driver/scr/Kconfig"
	source "${ARMINO_PATH}/middleware/driver/hspl/Kconfig"
	source "${ARMINO_PATH}/middleware/driver/aspl/Kconfig"
	source "${ARMINO_PATH}/middleware/driver/pwm/Kconfig"
	endmenu

	menu "Inter-core & Sync"
	source "${ARMINO_PATH}/middleware/driver/multicore/Kconfig"
	source "${ARMINO_PATH}/middleware/driver/mailbox/Kconfig"
	source "${ARMINO_PATH}/middleware/driver/ipi/Kconfig"
	source "${ARMINO_PATH}/middleware/driver/spinlock/Kconfig"
	endmenu

	menu "Storage & DMA"
	source "${ARMINO_PATH}/middleware/driver/flash/Kconfig"
	source "${ARMINO_PATH}/middleware/driver/emmc/Kconfig"
	source "${ARMINO_PATH}/middleware/driver/sd_card/Kconfig"
	source "${ARMINO_PATH}/middleware/driver/sdio_dwc/Kconfig"
	source "${ARMINO_PATH}/middleware/driver/sdio_func/Kconfig"
	source "${ARMINO_PATH}/middleware/driver/general_dma/Kconfig"
	source "${ARMINO_PATH}/middleware/driver/hp_dma/Kconfig"
	source "${ARMINO_PATH}/middleware/driver/psram/Kconfig"
	endmenu

	menu "Analog & Audio HW"
	source "${ARMINO_PATH}/middleware/driver/i2s/Kconfig"
	source "${ARMINO_PATH}/middleware/driver/audio/Kconfig"
	source "${ARMINO_PATH}/middleware/driver/saradc/Kconfig"
	source "${ARMINO_PATH}/middleware/driver/sdmadc/Kconfig"
	source "${ARMINO_PATH}/middleware/driver/fft/Kconfig"
	source "${ARMINO_PATH}/middleware/driver/sbc/Kconfig"
	endmenu

	menu "Display & Media HW"
	source "${ARMINO_PATH}/middleware/driver/lcd/Kconfig"
	source "${ARMINO_PATH}/middleware/driver/touch/Kconfig"
	endmenu

	menu "Power & Clock HW"
	source "${ARMINO_PATH}/middleware/driver/pmu/Kconfig"
	source "${ARMINO_PATH}/middleware/driver/pwr_clk/Kconfig"
	source "${ARMINO_PATH}/middleware/driver/rtc/Kconfig"
	source "${ARMINO_PATH}/middleware/driver/calendar/Kconfig"
	source "${ARMINO_PATH}/middleware/driver/timer/Kconfig"
	source "${ARMINO_PATH}/middleware/driver/ckmn/Kconfig"
	endmenu

	menu "Security & Fuse"
	source "${ARMINO_PATH}/middleware/driver/otp/Kconfig"
	endmenu

	menu "Connectivity PHY"
	source "${ARMINO_PATH}/middleware/driver/eth/Kconfig"
	source "${ARMINO_PATH}/middleware/driver/phy/Kconfig"
	source "${ARMINO_PATH}/middleware/driver/irda/Kconfig"
	endmenu

	menu "Watchdog"
	source "${ARMINO_PATH}/middleware/driver/wdt/Kconfig"
	source "${ARMINO_PATH}/middleware/driver/wwdt/Kconfig"
	endmenu
endmenu
```

## ap/middleware/driver/aspl/Kconfig
```kconfig
menu "ASPL"
	config SSPL_TEST
		bool "Enable SSPL test"
		default n
		help
			Enable SSPL driver CLI test commands.
endmenu
```

## ap/middleware/driver/audio/Kconfig
```kconfig
menu "AUDIO"

	config AUDIO
		bool "Enable Audio"
		default n

	choice AUD_DRIVER_VERSION
		prompt "AUD driver version"
		depends on AUDIO
		default AUD_DRIVER_V2
		help
			Select AUD (audio driver) implementation: V1 or V2.

		config AUD_DRIVER_V1
			bool "AUD driver V1"

		config AUD_DRIVER_V2
			bool "AUD driver V2"
	endchoice

	config AUDIO_ADC
		depends on AUDIO
		bool "Enable audio adc driver"
		default n

	config AUDIO_DAC
		depends on AUDIO
		bool "Enable audio dac driver"
		default n

	config AUD_DAC_DRC
		depends on AUDIO_DAC && AUD_DRIVER_V2
		bool "Enable DAC A2DP-path hardware DRC"
		default n
		help
			Compile DAC hardware DRC support (k/p/st register programming).
			HW DRC applies only to the A2DP source path
			(Resample → EQ → DRC); CALL/HINT bypass DRC and mix later.
			Init preset is selected by aud_dac_config_t.a2dp_drc_preset,
			not by Kconfig. Runtime switch: bk_aud_dac_drc_apply_preset().

	config AUDIO_DMIC
		depends on AUD_DRIVER_V1
		bool "Enable audio dmic driver"
		default n

	config AUDIO_DTMF
		depends on AUD_DRIVER_V1
		bool "Enable audio dtmf driver"
		default n

	config AUDIO_RING_BUFF
		bool "Enable Audio Ring Buff"
		default y
		help
			Enable Audio ring buffer

	choice AUD_PM_FAST_MODE
		prompt "Audio recovery mode after AP fast boot"
		depends on AUDIO && PM_AP_FAST_BOOT_ENABLE
		optional
		help
			Cold and hot recovery cannot share the same service
			callbacks. Leave unselected if audio does not participate
			in AP fast boot.

		config AUD_PM_FAST_COLD
			bool "Cold start (service init/deinit)"
			help
				On AP off, each audio service deinit. After fast
				boot, the same service init+start with retained
				config. AUD register backup/restore is not used.

		config AUD_PM_FAST_HOT
			bool "Hot start (register backup/restore + open/close)"
			help
				Keep service objects, backup/restore AUD
				registers, then open. Mutually exclusive with
				cold start.
	endchoice
endmenu
```

## ap/middleware/driver/dbg_probe/Kconfig
```kconfig
menu "DBG_PROBE"
	config DBG_PROBE
		bool "Enable dbg_probe (register-level debug probe)"
		default n
		help
			Two-layer register-level debug probe. Frontend dbg_probe_* APIs
			encode a compact self-describing frame and hand it to a backend
			sink. Default backend: UART direct write (per-core; core0->UART1,
			core1->UART2), force-on power/clock, bypassing the UART driver
			framework. When disabled every API compiles to a static-inline
			no-op.

	config DBG_PROBE_TIMESTAMP
		bool "Attach AON-RTC timestamps to _ts probe frames"
		depends on DBG_PROBE
		default y
		help
			When set, the dbg_probe_*_ts() variants read the AON RTC counter
			and emit an 8-byte frame: a full 32-bit tick for value16 kinds, or
			a 16-bit short tick (bytes 2..3) for the 32-bit payload kinds
			(TASK/U32). If the AON RTC is not yet enabled the frame degrades to
			the no-ts form (a probe never blocks on an idle RTC). When unset the
			_ts variants behave like their plain counterparts.

	config DBG_PROBE_RAMRING
		bool "Tee probe frames into a per-core RAM ring buffer"
		depends on DBG_PROBE
		default y
		help
			Always-on RAM sink: every runtime frame is also copied into a
			per-core circular buffer (overwrite policy). With no UART attached,
			a memory dump (or the `dbgp dump` CLI) recovers the most recent probe
			timeline; the self-describing frames let the parser resync after the
			wrap point. Per-core rings keep the hot path spinlock-free. A small
			separate "critical" ring isolates exception frames from the default
			high-volume stream. When unset the RAM sink compiles to no-ops.

	config DBG_PROBE_SYNC
		bool "Inject a periodic sync frame (corruption recovery + drop detect)"
		depends on DBG_PROBE
		default y
		help
			Every DBG_PROBE_SYNC_EVERY user frames (per core), emit a sync frame
			(U32 kind + SYNC module) carrying a 32-bit running frame counter and a
			short timestamp. The host parser uses it to re-anchor after a corrupted
			byte run and to detect how many frames were lost in a window. When
			unset, no sync frames are emitted (the counter logic compiles out).
endmenu
```

## ap/middleware/driver/emmc/Kconfig
```kconfig
menu "EMMC"
	config EMMC
		bool "Enable eMMC"
		default n
		depends on SDIO_V3P0
		help
		  eMMC device protocol driver built on top of the generic SDIO host
		  controller interface (<driver/sdio_host.h>). Requires the SDIO host
		  controller (CONFIG_SDIO_V3P0).

	config EMMC_HOST_ID
		int "SDIO host controller the eMMC is wired to (0=SDIO0, 1=SDIO1)"
		depends on EMMC
		default 0
		help
		  Selects which of the two BK7259 SDIO host controllers the eMMC
		  device is connected to.

	config EMMC_BUS_WIDTH
		int "eMMC data bus width (1/4/8)"
		depends on EMMC
		default 8
		help
		  Target data bus width after initialization. 8-bit needs the SDIO
		  controller DATA4~7 pins routed to the eMMC.
endmenu
```

## ap/middleware/driver/flash/Kconfig
```kconfig
menu "FLASH"
	config FLASH
		bool "Enable flash"
		default y

	config FLASH_QUAD_ENABLE
		bool "Enable flash quad enable"
		default n

	config FLASH_SRC_CLK_60M
		bool "Enable flash source clock 60M"
		default n

	config FLASH_TEST
		depends on FLASH
		bool "Enable flash test"
		default y

	config PARTITION_TEST
		depends on FLASH
		bool "Enable pattition test"
		default y

	config FLASH_API_TEST
		depends on FLASH
		bool "Enable flash_api test"
		default n

	config FLASH_PARTITION_CHECK_VALID
		depends on FLASH
		bool "Enable flash driver check write permission and address range"
		default y

	config FLASH_CLK_120M
		depends on FLASH
		bool "Enable flash clk using 120M"
		default n

	config FLASH_BYPASS_OTP_OPERATION
		bool "Bypass flash to operate otp in flash"
		default n

	config FLASH_CAPACITY_16M
		bool "Use 16M flash partition table (auto_partitions_16M.csv)"
		default n
		help
			Select the 16M partition layout (sys_rf/sys_net at 0xFFE000/0xFFF000).
			Save as project default ([D] in menuconfig) or pass FLASH_CAPACITY=16M
			on the make command line. Images are stored in build/<soc>/<project>_16M/
			so they do not overwrite the 8M package.
endmenu
```

## ap/middleware/driver/general_dma/Kconfig
```kconfig
menu "GENERAL_DMA"
	config GENERAL_DMA
		bool "Enable General DMA"
		default y

	choice GENERAL_DMA_VERSION
		prompt "DMA Driver Version"
		default GENERAL_DMA_V2P6
		help
		  Select the DMA driver version to use.
		  
		config GENERAL_DMA_V2P6
			bool "DMA v2p6"
			help
			  Use DMA driver version 2p6.
			  
		config GENERAL_DMA_V2PX
			bool "DMA v2px"
			help
			  Use DMA driver version 2px (for BK7258 project).
	endchoice

	config GENERAL_DMA_LINK_MODE
		depends on GENERAL_DMA_V2P6
		bool "Enable DMA linked list mode"
		default y
		help
		  Enable DMA linked list transfer mode support.
		  This feature allows DMA to transfer data using descriptor linked lists.

	config DMA_LOGIC_CHAN_CNT
		int "Current CPU-CORE software system uses how many dma-logic-channels. \
		        Total of all CPU-COREs dma logic chan count should be not bigger then total dma hardware supportted channels"
		default 4

	config DMA_LOGIC_CHAN_ID_MIN
		int "Current CPU-CORE software system min dma-logic-channel-id. \
		        Be care overlap the other CPU-CORE software system's dma-logic-channel-id. \
		        The value should be set like this: \
		        CPU0 is from 0; \
		        CPU1 is from CPU0_DMA_LOGIC_CHAN_CNT \
		        CPU2 is from CPU0_DMA_LOGIC_CHAN_CNT + CPU1_DMA_LOGIC_CHAN_CNT"
		default 4

	config GENERAL_DMA_TEST
		depends on GENERAL_DMA
		bool "Enable general dma test"
		default n
endmenu
```

## ap/middleware/driver/hp_dma/Kconfig
```kconfig
menu "HIGH PERFORMANCE DMA"
	config HIGH_PERFORMANCE_DMA
		bool "Enable High performance dma"
		default y

	config HPDMA_LOGIC_CHAN_CNT
		int "Current CPU-CORE software system uses how many dma-logic-channels"
		default 4
		help
			Total of all CPU-COREs dma logic chan count should be not bigger
			than total DMA hardware supported channels.

	config HPDMA_LOGIC_CHAN_ID_MIN
		int "Current CPU-CORE software system min dma-logic-channel-id"
		default 0
		help
			Be careful to avoid overlapping other CPU-CORE software system
			DMA logic channel IDs. CPU0 starts from 0; CPU1 starts from
			CPU0_DMA_LOGIC_CHAN_CNT; CPU2 starts from
			CPU0_DMA_LOGIC_CHAN_CNT + CPU1_DMA_LOGIC_CHAN_CNT.

	config HIGH_PERFORMANCE_DMA_TEST
		depends on HIGH_PERFORMANCE_DMA
		bool "Enable high performance dma test"
		default y
endmenu
```

## ap/middleware/driver/hspl/Kconfig
```kconfig
menu "HSPL"
	config HSPL
		bool "Enable HSPL (Hardware Spin Lock)"
		default y
		help
			Enable HSPL hardware spinlock driver.

	config HSPL_TEST
		depends on HSPL && DRIVER_TEST
		bool "Enable HSPL test"
		default n
		help
			Enable HSPL driver CLI test commands.

	config HSPL_LEAK_DEBUG
		depends on HSPL
		bool "Enable HSPL leak debug before AP powerdown"
		default n
		help
			Record AP HSPL owner core and caller PC in shared memory, and let
			CP assert before AP powerdown if AP still owns a lock.

	config HSPL_TIMEOUT_MONITOR_MS
		depends on HSPL
		int "HSPL timeout monitor threshold in ms"
		range 1 1000
		default 1
		help
			Timeout threshold used by the local HSPL timeout monitor.
			If a lock is held longer than this threshold, the HSPL timeout
			interrupt dumps state and triggers BK_ASSERT(0).

	config HSPL_TIMEOUT_MONITOR_CHANNEL
		depends on HSPL
		int "HSPL timeout monitor channel"
		range 0 15
		default 8
		help
			Channel selected in the local HSPL timeout monitor. The hardware
			timeout monitor can track one selected channel per HSPL instance.

	config HSPL_MUST_LOCK_TIMEOUT_MS_DEFAULT
		depends on HSPL
		int "must_lock timeout for non-FLASH resources (ms)"
		range 0 60000
		default 500
		help
			Timeout for all HSPL resources except FLASH. 0 means wait forever.

	config HSPL_MUST_LOCK_TIMEOUT_MS_FLASH
		depends on HSPL
		int "must_lock timeout for FLASH resource (ms)"
		range 0 5000
		default 5000
		help
			FLASH erase/program may take longer; max 5000 ms. 0 means wait forever.
endmenu
```

## ap/middleware/driver/i3c/Kconfig
```kconfig
# I3C driver (controller + Beken wrapper)

menu "I3C"
	config I3C
		bool "Enable I3C"
		default n
		help
			Enable I3C driver (master/slave, SDR/HDR).

	config I3C_TEST
		bool "Enable I3C test"
		depends on I3C
		default n
		help
			Enable I3C test and CLI commands for master/slave communication demo.
			Use CLI: i3c mst <mode> [clk_div] [tx_rx] | i3c slv <id>
endmenu
```

## ap/middleware/driver/icu/Kconfig
```kconfig
menu "ICU & Interrupt"
	config ICU_GPIO
		bool "Enable icu gpio"
		default n

	config ISR_REG_DISABLE
		bool "Disable irq"
		default n
endmenu
```

## ap/middleware/driver/ipi/Kconfig
```kconfig
menu "IPI"
	config IPI
		bool "Enable IPI (Inter-Processor Interrupt)"
		default y
		help
			Enable IPI driver for inter-core communication.
			IPI allows different CPU cores to send interrupts to each other.

	config IPI_TEST
		depends on IPI && DRIVER_TEST
		bool "Enable IPI test"
		default n
		help
			Enable IPI driver test cases.

	config IPI_DUMP
		depends on IPI
		bool "Enable IPI dump (code size increases)"
		default n
		help
			Enable bk_ipi_dump_info() detailed dump output.
			Disable it for smaller code size.
endmenu
```
