## ap/middleware/driver/sdio_dwc/v3p0/Kconfig
```kconfig
menu "SDCARD"
	config SDCARD
		bool "Enable SDCARD"
		default y

	config SDCARD_DEFAULT_CLOCK_FREQ
		int "sd card default clock freq"
		default 11

	config SDCARD_CHECK_INSERTION_EN
		bool "Whether to use pin to determine whether the sdcard is connected"
		default n

	menu "SDCARD_CHECK_INSERTION_EN"
		depends on SDCARD_CHECK_INSERTION_EN

		config SDCARD_CHECK_INSERTION_GPIO_ID
			int "Detect whether to connect the GPIO ID of the sdcard"
			default 0
	endmenu

	config SDCARD_BUSWIDTH_4LINE
		bool "Support SDCARD 4 Data Wires"
		default n

	config SDCARD_POWER_GPIO_CTRL
		depends on SDCARD
		bool "Enable SDcard power gpio ctrl"
		default n

        config SDCARD_POWER_GPIO_CTRL_AUTO_POWERDOWN_WHEN_IDLE
            depends on SDCARD_POWER_GPIO_CTRL
            bool "Enable SDcard auto powerdown when idle"
            default y

	config SDCARD_DEBUG_SUPPORT
		bool "Enable SDcard debug"
		default n
		help
			enable SDCARD debug, it will dump write and read data with SDCARD



	config SDIO_HOST
		bool "Enable sdio host"
		default n

	config SDIO_HOST_DEFAULT_CLOCK_FREQ
		int "SDIO Host default clock freq"
		default 200000

	config SDIO_HOST_CLR_WRITE_INT
		bool "SDIO CLEAR WRITE INT NEED WAIT"
		default n

        config PIN_SDIO_GROUP_1
		bool "SDIO pin map select"
		default n
endmenu
```

## ap/middleware/driver/sdio_func/Kconfig
```kconfig
menu "SDIO_FUNC"
	config SDIO_FUNC
		bool "Enable SDIO function (peripheral) core"
		default n
		depends on SDIO_V3P0
		help
		  SDIO peripheral (I/O card) core built on top of the generic SDIO
		  host controller interface (<driver/sdio_host.h>). Provides Linux-like
		  CMD52/CMD53 access (sdio_readb/writeb, block transfers), function
		  enable, block size and async interrupt handling. Requires the SDIO
		  host controller (CONFIG_SDIO_V3P0).

	config SDIO_FUNC_HOST_ID
		int "Default SDIO host controller for the SDIO peripheral (0/1)"
		depends on SDIO_FUNC
		default 0
		help
		  Default controller used by bk_sdio_func_init() when called with an
		  out-of-range id.

	config SDIO_FUNC_CLI
		bool "Enable the \"sdio_func\" CLI command"
		depends on SDIO_FUNC && CLI
		default y
		help
		  Build the "sdio_func" shell command (scan/info/enable/rb/wb ...) used
		  to bring up and validate an external SDIO peripheral. The command is
		  auto-registered at boot via DRV_CLI_CMD_EXPORT, so no explicit
		  registration call is needed. Set to n to drop the CLI front-end
		  entirely when it is no longer required.
endmenu
```
