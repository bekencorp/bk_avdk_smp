## ap/middleware/driver/lcd/Kconfig
```kconfig
menu "LCD"
	config LCD_QSPI
		bool "Enable LCD QSPI"
		default n

	config LCD_QSPI_COLOR_DEPTH_BYTE
		depends on LCD_QSPI
		int "Set Lcd Qspi Color Depth"
		default 2
		help
			2 - RGB565
			3 - RGB888

	config LCD_QSPI_TE
		depends on LCD_QSPI
		bool "Enable LCD QSPI TE"
		default n

	config LCD_SPI
		bool "Enable LCD SPI"
		default n

	config LCD_SPI_COLOR_DEPTH_BYTE
		depends on LCD_SPI
		int "Set Lcd spi Color Depth"
		default 2
		help
			2 - RGB565
			3 - RGB888

	config LCD_SPI_TE
		depends on LCD_SPI
		bool "Enable LCD SPI TE"
		default n

	config LCD_SPI_REFRESH_WITH_SPI
		depends on SPI
		depends on LCD_SPI
		bool "Enable LCD SPI Refresh with SPI"
		default n
endmenu
```

## ap/middleware/driver/mailbox/Kconfig
```kconfig
menu "MAILBOX"
	config MAILBOX
		bool "Enable mail_box"
		default n

	config MAILBOX_V2_0
		bool "Use mailbox v2.0 driver"
		default n

	config MAILBOX_IPC
		bool "Enable mailbox socket ipc driver"
		default y

	config IPC_STRESS_TEST
		depends on MAILBOX_IPC
		bool "Enable cross-core IPC stress test CLI (AP side)"
		default n
		help
			Build the AP-side IPC stress clients and auto-register the
			"ipc_stress" CLI command (via DRV_CLI_CMD_EXPORT). Pairs with the
			CP-side echo server to verify cross-core mailbox IPC under load.

	config MAILBOX_IPC_API_TASK_STACK_SIZE
		int "Set MAILBOX IPC API Task Stack Size"
		default 2048
		help
			Stack size of MAILBOX IPC API Task

	config MAILBOX_IPC_DATA_POOL_NUM
		depends on MAILBOX_IPC
		int "MAILBOX IPC data object pool size"
		default 8
		help
			Number of pre-allocated bk_ipc_data_t objects served from the IPC
			send object pool instead of the heap. Sends that exceed the pool
			temporarily fall back to os_malloc, so raising this only reduces
			heap traffic under concurrent/burst sends.

	config MAILBOX_IPC_SYNC_TIMEOUT_MS
		depends on MAILBOX_IPC
		int "MAILBOX synchronous IPC send timeout (ms)"
		default 2000
		help
			Bounded wait for a synchronous IPC send to receive its ACK from the
			peer core. On timeout the send returns an error instead of blocking
			forever; the request object is safely reclaimed if a late ACK
			arrives. Set smaller for faster caller recovery.

    config SLAVE_HEART_BEAT
		depends on MAILBOX
		bool "Enable heartbeat mechanism when dual core communication"
		default n

	config SLAVE_HEART_BEAT_USE_IPI
		depends on SLAVE_HEART_BEAT && IPI
		bool "Use IPI for heartbeat transport"
		default y
		help
			Send heartbeat notifications through IPI_DOMAIN_HEARTBEAT instead of mailbox.
endmenu
```

## ap/middleware/driver/multicore/Kconfig
```kconfig
menu "Multicore"
	config SUPPORT_MULTICORE
		bool "Enable multicore"
		default n

	config MULTICORE_TEST
		depends on SUPPORT_MULTICORE && DRIVER_TEST
		bool "Enable multicore test"
		default n

	config CPU_HOTPLUG
		depends on SUPPORT_MULTICORE && SOC_SMP
		bool "Enable CPU Hotplug"
		default y

	config CPU_HOTPLUG_BOOT_OFFLINE
		depends on CPU_HOTPLUG
		bool "Keep secondary hotplug CPU offline at power-on (online via cpu online <id>)"
		default n

	config CPU_HP_VOTE
		depends on CPU_HOTPLUG
		bool "Enable CPU hotplug voting layer"
		default n

	if CPU_HP_VOTE

		config CPU_HP_VOTE_MAX_VOTERS
			int "Maximum number of concurrently registered voters"
			default 64

		config CPU_HP_VOTE_DUMP
			bool "Enable bk_cpu_hp_vote_dump() per-voter listing"
			default y

		config CPU_HP_VOTE_NAME
			bool "Record a name string for each voter (find-by-name and dump labels)"
			default n

		config CPU_HP_VOTE_NAME_LEN
			depends on CPU_HP_VOTE_NAME
			int "Maximum length of voter name string"
			default 16

		config CPU_HP_VOTE_FIND
			depends on CPU_HP_VOTE_NAME && CPU_HP_VOTE_DUMP
			bool "Enable bk_cpu_hp_vote_find() (look up a voter by name)"
			default n

		config CPU_HP_VOTE_STATIC
			bool "Allocate voter handles from a static pool (no malloc)"
			default n

	endif

	config CPU_HP_GOVERNOR
		depends on CPU_HOTPLUG
		bool "Enable dynamic CPU load governor (auto online/offline CP1)"
		default n

	if CPU_HP_GOVERNOR

		config CPU_HP_GOVERNOR_AUTOSTART
			bool "Start auto-adjust immediately at boot"
			default y

		config CPU_HP_GOVERNOR_UP_THRESHOLD
			int "CP0 load%% above which CP1 is brought online"
			default 80

		config CPU_HP_GOVERNOR_DOWN_THRESHOLD
			int "Combined CP0+CP1 load%% below which CP1 is taken offline"
			default 60

		config CPU_HP_GOVERNOR_LOAD_EMA_DIV
			int "Load EMA divisor (default: 100% weight)"
			default 1
			help
				if value is 2, the current load is 50%(1/2) weight
				if value is 4, the current load is 25%(1/4) weight

		config CPU_HP_GOVERNOR_PERIOD_MS
			int "Load sampling period (ms)"
			default 100

		config CPU_HP_GOVERNOR_UP_DEBOUNCE
			int "Consecutive overloaded samples required to online AP1"
			default 2

		config CPU_HP_GOVERNOR_DOWN_DEBOUNCE
			int "Consecutive underloaded samples required to offline AP1"
			default 5

		config CPU_HP_GOVERNOR_COOLDOWN_MS
			int "Minimum dwell time after a transition (ms)"
			default 1000
	
	endif

endmenu
```

## ap/middleware/driver/psram/Kconfig
```kconfig
menu "PSRAM"
	config PSRAM
		bool "Enable PSRAM"
		default n

	config PSRAM_AS_SYS_MEMORY
		depends on PSRAM
		bool "Enable psram_malloc API"
		default n

	config PSRAM_WRITE_THROUGH
		depends on PSRAM
		bool "Enable PSRAM write through"
		default n

	config PSRAM_CALIBRATE
		depends on PSRAM
		bool "Enable PSRAM calibrate"
		default n

	config PSRAM_INTERLEAVE
		depends on PSRAM
		bool "Enable PSRAM interleave mode"
		help
		  Interleave mode: merge two PSRAMs into one virtual PSRAM via virtual address 0x80000000.
		  Data is arranged as: psram0:0-255 | psram1:0-255 | psram0:256-511 | psram1:256-511 | ...
		  Interleave granularity can be 32/64/128/256 bytes. Default is 256 bytes.
		default n

	config PSRAM_INTERLEAVE_OFFSET
		depends on PSRAM_INTERLEAVE
		hex "PSRAM interleave offset"
		help
		  Interleave virtual address offset.
		default 0x20000000

	config PSRAM_AUTO_DETECT
		depends on PSRAM && EASY_FLASH && EASY_FLASH_V4
		bool "Enable PSRAM id auto detect function"
		default n

	config PSRAM_TEST
		depends on CLI && PSRAM
		bool "Enable Psram Test"
		default n

	config PSRAM_TEST_USE_HPDMA
		depends on PSRAM_TEST
		bool "Use HPDMA for PSRAM test (else use GDMA)"
		help
		  When y, psram_test and write-through test use HPDMA (bk_hpdma_memcpy).
		  When n, use GDMA (dma_memcpy from general_dma); requires GENERAL_DMA.
		default n

endmenu
```

## ap/middleware/driver/pwm/Kconfig
```kconfig
menu "PWM"
	config PWM
		bool "Enable pwm"
		default n

	config PWM_PM_CB_SUPPORT
		bool "PWM PM Support"
		default n

	config PWM_PHASE_SHIFT
		bool "PWM phase shift Support"
		default n

	config PWM_FADE
		bool "PWM fade mode support"
		default n

	config PWM_TEST
		depends on PWM && DRIVER_TEST
		bool "Enable pwm test"
		default y

	config PWM_AUTO
		depends on PWM && DRIVER_TEST
		bool "Enable pwm automatic loopback test"
		default n
		help
			Enable the PWM automatic loopback CLI test.
			The platform wiring is PWM2 (GPIO32) to PWM4 (GPIO34)
			and PWM3 (GPIO33) to PWM5 (GPIO35).

endmenu
```

## ap/middleware/driver/qspi/Kconfig
```kconfig
menu "QSPI"
	config QSPI
		bool "Enable QSPI"
		default n

	config QSPI_STATIS
		bool "Enable QSPI Statis"
		default n

	config QSPI_MST_PSRAM
		bool "Enable QSPI PSRAM"
		depends on QSPI
		default n

	choice
		prompt "QSPI Flash type"
		optional
		depends on QSPI
		help
			Select NOR or NAND for the QSPI master flash. They are mutually
			exclusive; leave unselected if QSPI flash is not used.
			NOR and NAND share the same bk_qspi_flash_* API and only one driver
			is linked at a time. If both are force-enabled outside this choice,
			NAND takes precedence.

		config QSPI_NOR_FLASH
			bool "Enable QSPI NOR Flash"
			help
				BEKEN Chip sets QSPI interface as a master device, the slave device is a NOR flash,
				then BEKEN Chip can access the flash with QSPI interface.
				The application can read/writes data to flash directly by QSPI Flash API,
				or reads/writes by file system API if enable relates macro, I.E. CONFIG_FATFS, CONFIG_LITTLEFS, CONFIG_VFS...

		config QSPI_NAND_FLASH
			bool "Enable QSPI NAND Flash"
	endchoice

	config QSPI_NOR_FLASH_SIZE
		hex "NOR Flash Size (Bytes)"
		depends on QSPI_NOR_FLASH
		default 0x1000000
		help
			Fallback total size of the SPI NOR Flash in bytes, used only when
			Read ID (9Fh) returns a part not present in the descriptor registry.
			Identified parts report their real capacity via
			bk_qspi_flash_nor_total_size(). Default is 16MB (0x1000000).

	config QSPI_NOR_ALLOW_UNKNOWN
		bool "Allow unidentified SPI NOR to continue init"
		depends on QSPI_NOR_FLASH
		default y
		help
			When set, an unidentified SPI NOR (JEDEC ID not in the descriptor
			registry) still initialises using a generic default descriptor and
			the QSPI_NOR_FLASH_SIZE fallback capacity. Convenient while bringing
			up a new part. Production configs should set this to n so an unknown
			part fails init instead of running with possibly wrong command set,
			protection bits or capacity.

	config QSPI_NAND_FLASH_SIZE
		hex "NAND Flash Size (Bytes)"
		depends on QSPI_NAND_FLASH
		default 0x8000000
		help
			Fallback total size of the SPI NAND Flash in bytes, used only when
			Read ID (9Fh) returns a part not present in the descriptor registry.
			Identified parts report their real capacity via
			bk_qspi_flash_nand_total_size(). Default is 128MB (0x8000000).

	config QSPI_NAND_ALLOW_UNKNOWN
		bool "Allow unidentified SPI NAND to continue init"
		depends on QSPI_NAND_FLASH
		default y
		help
			When set, an unidentified SPI NAND (JEDEC ID not in the descriptor
			registry) still initialises using a generic default descriptor and
			the QSPI_NAND_FLASH_SIZE fallback capacity. Convenient while bringing
			up a new part. Production configs should set this to n so an unknown
			part fails init instead of running with a possibly wrong capacity,
			protection bit or ECC semantics.

	config QSPI_TEST
		depends on QSPI && DRIVER_TEST
		bool "Enable qspi test"
		default n

	config QSPI_LINE_MODE
		int "qspi line mode choose"
		range 1 8
		default 4
		help
		The value should be changed if need to change qspi line mode
endmenu
```

## ap/middleware/driver/saradc/Kconfig
```kconfig
menu "SARADC"
	config SARADC
		bool "Enable SARADC"
		default y

	config SARADC_CLIENT
		bool "Enable SARADC client"
		depends on SARADC
		default y

	config SARADC_MB
		bool "Enable SARADC mailbox"
		depends on SARADC
		default n

	config SARADC_TEST
		depends on SARADC
		bool "Enable SARADC test"
		default y

	config SARADC_EXAMPLE
		depends on SARADC
		bool "Enable SARADC example"
		default n
	config AP_SARADC_MEDIAN_FILTER
		bool "Enable saradc median filtering algorithm"
		default n

endmenu
```

## ap/middleware/driver/sd_card/Kconfig
```kconfig
menu "SDCARD"
	config SDCARD
		bool "Enable SDCARD"
		default y

	config SDCARD_HOST_ID
		int "SDIO host controller the SD card is wired to (0=SDIO0, 1=SDIO1)"
		depends on SDCARD
		default 0
		help
		  Single source of truth for which of the two BK7259 SDIO host
		  controllers the SD card is connected to. 0 = SDIO0
		  (GPIO2/3/4/5/10/11), 1 = SDIO1 (GPIO14~23). Applied at runtime via
		  the generic bk_sdio_host_*() API. Boards wiring the SD card to
		  SDIO1 (e.g. BK7259 Robot V1 AI kit) should set this to 1.

	config SDCARD_BUSWIDTH_4LINE
		bool "Use 4-bit SD data bus (default is 1-bit)"
		depends on SDCARD
		default n
		help
		  Master switch for the SD data bus width. Default (n) keeps the
		  proven 1-bit bus. Set y to switch the card and the SDIO controller
		  to 4-bit (DAT0~DAT3) after enumeration for ~4x data throughput.

		  Requirements when enabling:
		    - all four data lines (DATA0~DATA3), CLK and CMD must be muxed
		      for the chosen SDIO group in the board usr_gpio_cfg.h;
		    - DAT3 is temporarily forced high by the SD card driver during
		      the CMD0/CMD8 identification window, then restored to the SDIO
		      DATA3 function before the 4-bit switch.

	config SDCARD_HIGH_SPEED
		bool "Enable SD High Speed mode (CMD6, 3.3V)"
		depends on SDCARD
		default n
		help
		  Switch the card to SD High Speed after identification (CMD6
		  access mode 1) and set the host HIGH_SPEED_EN / SDR25
		  sampling path. This is classic 3.3V High Speed, not UHS-I;
		  it does not require 1.8V signaling or tuning.

		  Default (n) keeps Default Speed. When enabled, the transfer
		  clock range is raised to 50MHz and defaults to 40MHz (the
		  highest 80MHz-base integer divide that stays within the
		  50MHz High Speed limit). If the card rejects CMD6 the
		  driver falls back to Default Speed.

	config SDCARD_CLOCK_FREQ_HZ
		int "SD card transfer clock frequency in Hz"
		depends on SDCARD
		default 40000000 if SDCARD_HIGH_SPEED
		default 20000000
		range 400000 50000000 if SDCARD_HIGH_SPEED
		range 400000 25000000 if !SDCARD_HIGH_SPEED
		help
		  SD data-transfer clock after card identification, passed to
		  bk_sdio_host_set_clock(). Identification still runs at the
		  host's low init clock (~400kHz).

		  Without High Speed the range is 400kHz-25MHz (Default
		  Speed; default 20MHz). With CONFIG_SDCARD_HIGH_SPEED the
		  range is 400kHz-50MHz (default 40MHz). Lower values can be
		  used on boards with marginal SDIO signal integrity.

	config SDCARD_MAX_BLOCKS_PER_XFER
		int "Max blocks per CMD18 transfer (0=unlimited)"
		depends on SDCARD
		default 0
		range 0 256
		help
		  Split large FATFS disk_read requests into smaller CMD18
		  multi-block transfers. 0 keeps a single CMD18 with the full
		  block count from the caller.

		  On boards with marginal SDIO signal integrity, long
		  multi-block PIO reads are more prone to DATA_END_BIT_ERR.
		  Set a small value (e.g. 4) in the board defconfig as a
		  software workaround until the PCB/SI is improved.

	config SDCARD_CHECK_INSERTION_EN
		bool "Whether to use pin to determine whether the sdcard is connected"
		default n

	menu "Card Detect GPIO"
		depends on SDCARD_CHECK_INSERTION_EN

		config SDCARD_CHECK_INSERTION_GPIO_ID
			int "Detect whether to connect the GPIO ID of the sdcard"
			default 0
	endmenu

	config SDCARD_POWER_GPIO_CTRL
		depends on SDCARD
		bool "Enable SDcard power gpio ctrl"
		default n

    config SDCARD_POWER_GPIO_CTRL_AUTO_POWERDOWN_WHEN_IDLE
        depends on SDCARD_POWER_GPIO_CTRL
        bool "Enable SDcard auto powerdown when idle"
        default n

	config SDCARD_DEBUG_SUPPORT
		bool "Enable SDcard debug"
		default n
		help
			enable SDCARD debug, it will dump write and read data with SDCARD
endmenu
```

## ap/middleware/driver/sdio_dwc/Kconfig
```kconfig
menu "SDIO_DWC"
	config SUPPORT_SDIO_DWC
		bool "Enable SDIO DWC"
		default n

	config SDIO_DWC_TEST
		bool "Enable SDIO DWC Test"
		depends on SUPPORT_SDIO_DWC
		default n

	config SDIO_V3P0
		bool "SDIO Version V3P0"
		depends on SUPPORT_SDIO_DWC
		default y

endmenu
```
