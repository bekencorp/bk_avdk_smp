## cp/components/bk_pm/Kconfig
```kconfig
# KCONFIG_GROUP: Power Management
menu "PM"
	config PM_ENABLE
		bool "pm enable"
		default n

	config PM_CLIENT
		bool "indicate the current cpu running as pm client core, otherwise running as pm server core"
		default n

	config PM_SUPER_DEEP_SLEEP
		bool "Enable super deep sleep"
		default n

	config PM_EXTEND_CPU_FREQ
		bool "Extend cpu freq"
		default n

	config PM_LV_TIME_COST_DEBUG
		bool "Enable low voltage sleep time cost debug"

	config PM_ENTER_LV_TIME_OUT_PERIOD_MS
		int "Enter LV time out"
		default 30000
		help
			enter LV time out time(unit:ms)

	config PM_LV_WDT_PROTECTION
		bool "add protection for hardware enter low voltage fail when application abnormal operate, using wdt to reboot"
		default n

	config PM_CPU_FRQ_HIGHEST
		int "config highest cpu frequency"
		default 4
		help
		   config highest cpu frequency(0:xtal;1:60M;2:80M;3:120M;4:160M;5:240M;)

	config PM_CPU_FRQ_DEFAULT
		int "config default cpu frequency"
		default 3
		help
		   config default cpu frequency(0:xtal;1:60M;2:80M;3:120M;4:160M;5:240M;)

	config PM_PROTECT_TIME_CHECK
		bool "Primarily protect time check"
		default n
		help
			Primarily protect the BT sleep time until re-entering the sleep scenario

	config PM_POWER_VOTE_RECORD
		bool "Enable PM power vote record"
		default n
		help
			Record PM power votes for debugging.

	config PM_CLOCK_VOTE_RECORD
		bool "Enable PM clock vote record"
		default n
		help
			Record PM clock votes for debugging.

	config PM_LOWEST_POWER_MODE
		int "config lowest power mode"
		default 0
		help
		   config lowest power mode(0:normal sleep;1:low voltage sleep;2:deep sleep;3:super deep sleep;)

	config PM_ONLY_CP_ENABLE
		bool "only cp enable ,ap disable"
		default n
		help
			only cp enable ,ap disable

	config PM_CP_PERI_CLK_DEFAULT_OFF
		bool "Default disable CP peripheral clocks"
		default n
		help
			Keep CP peripheral clocks disabled by default during early init.

	config PM_CP_CPU1_BAKP_AUDP_DOMAIN_DEFAULT_OFF
		bool "Default disable CP CPU1_BAKP_AUDP domain"
		depends on PM_ONLY_CP_ENABLE
		default n
		help
			Power down the CP CPU1_BAKP_AUDP domain during early init.

	config PM_XTAL_RX_TX_ANABUF_DEFAULT_OFF
		bool "Default disable XTAL RX/TX analog buffers"
		default n
		help
			Keep XTAL RX/TX analog buffers disabled by default.

	config PM_CURRENT_OPTIMIZE_XTAL_RX_TX_ANABUF
		bool "Optimize PM current through XTAL RX/TX analog buffers"
		default n
		help
			Optimize power-management current through XTAL RX/TX analog buffers.

	config DEEP_LV
		bool "Enable deep low voltage"
		default n

	config DEEP_LV_DEBUG_GPIO
		bool "Enable deep low voltage debug (GPIO toggle markers)"
		default n

	config DEEP_LV_DEBUG_LOG
		bool "Enable deep low voltage AON snapshot debug log"
		default n
		help
			Enable the AON register snapshot/diff log around deep LV
			sleep entry/exit. Independent from DEEP_LV_DEBUG_GPIO so the
			GPIO toggle markers can be disabled while the snapshot
			log stays enabled.

	config PM_CP_DEEP_LV_SRAM_CHECK
		bool "Enable CP SRAM CRC check in deep low voltage"
		depends on DEEP_LV
		default n
		help
			Check CP SRAM code/data retention around deep low voltage sleep.

	config PM_AP_SRAM_POWER_CTRL
		bool "Enable AP SRAM power control in deep low voltage"
		depends on DEEP_LV
		default y
		help
			Enable AP SRAM power control before entering deep low
			voltage sleep.

	menu "AP SRAM power control in deep low voltage"
		depends on PM_AP_SRAM_POWER_CTRL

		config PM_AP_MEM3_POWER_DOWN
			bool "Power down AP MEM3 in deep low voltage"
			default y
			help
				Power down AP MEM3 before entering deep low voltage sleep.
				Disable this option to keep MEM3 powered for SRAM data retention.

		config PM_AP_MEM4_POWER_DOWN
			bool "Power down AP MEM4 in deep low voltage"
			default y
			help
				Power down AP MEM4 before entering deep low voltage sleep.
				Disable this option to keep MEM4 powered for SRAM data retention.

		config PM_AP_MEM5_POWER_DOWN
			bool "Power down AP MEM5 in deep low voltage"
			default y
			help
				Power down AP MEM5 before entering deep low voltage sleep.
				Disable this option to keep MEM5 powered for SRAM data retention.

		config PM_AP_MEM6_POWER_DOWN
			bool "Power down AP MEM6 in deep low voltage"
			default y
			help
				Power down AP MEM6 before entering deep low voltage sleep.
				Disable this option to keep MEM6 powered for SRAM data retention.

		config PM_AP_CPU2_CACHE_POWER_DOWN
			bool "Power down AP CPU2 cache SRAM in deep low voltage"
			default y
			help
				Power down AP CPU2 cache SRAM before entering deep low
				voltage sleep. Disable this option to keep it powered for
				data retention.

		config PM_AP_CPU3_CACHE_POWER_DOWN
			bool "Power down AP CPU3 cache SRAM in deep low voltage"
			default y
			help
				Power down AP CPU3 cache SRAM before entering deep low
				voltage sleep. Disable this option to keep it powered for
				data retention.
	endmenu

	config AON_LDO_SEL
		int "Config AON LDO voltage select"
		range 0 7
		default 4
		help
			Config AON LDO voltage select.
			0:0.6V; 1:0.65V; 2:0.7V; 3:0.75V; 4:0.8V; 5:0.85V; 6:0.9V; 7:0.95V.

	config OPTIMIZE_AON_CURRENT
		bool "Optimize AON current"
		default y
		help
			Optimize AON current by lowering AON LDO voltage during low voltage sleep.

	config PM_AP_POWERDOWN_WHEN_LV
		bool "Power down ap when sleep"
		default n
endmenu
```

## cp/components/bk_uid/Kconfig
```kconfig
menu "bk_uid"

	config GET_UID_ENABLE
		bool "Enable get UID"
		depends on OTP_V1
		default n
	
	config GET_UID_TEST
		depends on GET_UID_ENABLE
		bool "Enable get UID test"
		default n
endmenu
```

## cp/components/controller_if/Kconfig
```kconfig
# KCONFIG_GROUP: Wireless Connectivity::Controller Interface
menu "Controller IF"
	config CTRL_IF_TP
		bool "Controller Interface Throughput debug"
		default n
	config CONTROLLER_RX_DIRECT_PSH
		bool "Controller RX Buf Directly push to AP"
		default y
	config CONTROLLER_WAR
		bool "Controller RX Buf Directly push to AP"
		default y
	config CONTROLLER_DEBUG
		bool "Controller Debug"
		default n
	config CONTROLLER_AP_BUFFER_COPY
		bool "Controller AP buffer copy to CP buffer when AP use PSRAM instead of SRAM"
		default n
	config WIFI_IRAM_OPT_LEVEL
		int "WiFi IRAM optimization level (higher keeps more WiFi code in IRAM)"
		range 1 3
		default 1
		help
		  Controls how much WiFi-dedicated code (.iram2 Tier2 / .iram3 Tier3)
		  stays resident in IRAM. Tier1 (.iram / __IRAM_WIFI / system __IRAM_SEC)
		  is always resident regardless of this level.
		  1: keep only Tier1 in IRAM (least SRAM use).
		  2: keep Tier1 and Tier2 (.iram2) in IRAM.
		  3: keep Tier1, Tier2 (.iram2), and Tier3 (.iram3) in IRAM
		     (best throughput, most SRAM use).
endmenu
```

## cp/components/coredump/Kconfig
```kconfig
# KCONFIG_GROUP: Debug::Crash Dump
menu "Coredump"
	config CM_BACKTRACE
		bool "Enable Cm Backtrace"
		default n

	config DUMP_ENABLE
			bool "Enable Dump Feature"
			default n
			help
				Dump all memory when exception happen

	config MEMDUMP_ALL
			bool "Enable Memdump All"
			default DEBUG_VERSION
			help
				Dump all memory when exception happen.
				Build-version driven: a Debug build dumps the full memory set,
				a Release build dumps only the minimal set. The full-vs-minimal
				selection also honors CONFIG_DEBUG_VERSION at compile time (see
				memdump_strategies/), so the developer environment gets full
				dumps even under BUILD_DEFAULT_VERSION while the released SDK
				(CONFIG_RELEASE_VERSION) stays minimal.

	config CP_HANG_DUMP_BY_AP
			bool "Enable AP-side CP hang dump feature"
			depends on IPI
			default y
			help
				Production reliability feature. Intentionally independent of
				DUMP_ENABLE so it stays ON in a Release build (DUMP_ENABLE=n):
				the cross-core hang watchdog only uses the always-compiled
				coredump writer primitives (bk_coredump_uart/manifest), not the
				DUMP_ENABLE-gated self-exception dump path.
				CP sends a private IPI heartbeat to AP. If AP observes CP
				heartbeat timeout, AP dumps CP-visible context and reboots the
				board without relying on the CP - covering the "CP wedged and
				not answering mailbox" case.

	config CP_HANG_DUMP_BY_AP_PERIOD_MS
			int "CP to AP debug heartbeat period(ms)"
			depends on CP_HANG_DUMP_BY_AP
			default 1000

	choice DUMP_UART_MEM_ENCODING
		prompt "Config DumpUart Memory Encoding"
		default DUMP_UART_MEM_ENCODING_ASCII
		help
			Default ASCII format

		config DUMP_UART_MEM_ENCODING_ASCII
			bool "ASCII"
			help
				Dump memory in ASCII format
		config DUMP_UART_MEM_ENCODING_BASE64
			bool "Base64"
			help
				Dump memory in Base64 format
	endchoice

	choice DUMP_BY_UART
		prompt "Dump output method"
		default DUMP_BY_LOG_UART
		help
			Dump output method
		config DUMP_BY_LOG_UART
			bool "Log UART"
			help
				Dump to log UART
		config DUMP_BY_FLASH
			bool "Flash"
			help
				Dump to flash
	endchoice

	config TRAP_TEST
			bool "Enable trap test"
			default n
			help
				trap test
endmenu
```

## cp/components/demos/net/iperf/Kconfig
```kconfig
# KCONFIG_GROUP: Demos::Network::Iperf
	config DEMOS_IPERF
		depends on WIFI_ENABLE
		bool "Enable Demos Iperf"
		default y
		help
			enable iperf demos
```

## cp/components/openthread/Kconfig
```kconfig
menu "OpenThread"
    config OPENTHREAD
        bool "Enable OpenThread"
        default n
    config OPENTHREAD_FTD
        bool "Enable FTD config"
        default n
        depends on OPENTHREAD
    config OPENTHREAD_MTD
        bool "Enable MTD config"
        default n
        depends on OPENTHREAD
    config OPENTHREAD_UNIT_TEST
	bool "Enable openthread unit test"
	default n
	depends on OPENTHREAD

    config OPENTHREAD_AON_US_TICK
        depends on OPENTHREAD
        bool "openthread us aon rtc as us clock source"
        default n
    config OT_TRIP_COEX_EN
        bool "ot wifi ble thread coexist enable"
        default n
endmenu
```

## cp/components/psa_mbedtls/Kconfig
```kconfig
# KCONFIG_GROUP: Security & Cloud::PSA Mbed TLS
menu "PSA Mbedtls"
	config PSA_MBEDTLS
		bool "Enable psa mbedtls v3.6.6"
		default n
		help
			enable psa mbedtls v3.6.6

	menu "PSA Mbedtls Options"
		depends on PSA_MBEDTLS

		config MBEDTLS_USE_PSA_CRYPTO
			bool "TLS/X509 use PSA via TF-M"
			default n
			depends on TFM && TFM_CRYPTO
			help
				NS PSA Crypto APIs are provided by the TF-M Crypto partition.
				TLS/X509 call psa_* through the TF-M NS client (IPC/veneer).
				Does not enable a local PSA Crypto server in NS.

		config PSA_MBEDTLS_TEST
			bool "Enable psa interface test"
			default n
			depends on MBEDTLS_USE_PSA_CRYPTO
			help
				PSA CLI tests; requires TF-M PSA client path

		config MBEDTLS_SSL_IN_CONTENT_LEN
			int "Config MBEDTLS_SSL_IN_CONTENT_LEN"
			default 4096

		config MBEDTLS_SSL_OUT_CONTENT_LEN
			int "Config MBEDTLS_SSL_OUT_CONTENT_LEN"
			default 4096

		config TRUSTENGINE
			bool "Enable TrustEngine hardware crypto"
			help
				Classic mbedtls crypto backend via TE200 hardware.
				Mutually exclusive with SW_CRYPTO. Does not provide PSA server.

		config SW_CRYPTO
			bool "Enable software crypto"
			default y
			depends on !TRUSTENGINE
			help
				Classic mbedtls crypto backend via pure software.
				Mutually exclusive with TRUSTENGINE. Does not provide PSA server.

		config TE200_ENTROPY
			bool "Enable TE200 entropy"
			depends on TRUSTENGINE
			default n

		config TRUSTENGINE_TEST
			bool "Enable classic mbedtls cli test"
			depends on PSA_MBEDTLS
			default n
			help
				Classic mbedtls CLI testing code

		config FULL_MBEDTLS
			bool "Enable Full Mbedtls"
			default n
			help
				mbedtls support more algorithms(enabled in xxx_config.h)

		config MBEDTLS_LOG_LEVEL
			string "Set Mbedtls Log Level"
			default "INFO"
			help
				Set mbedtls log level: OFF/ERROR/WARNING/INFO/DEBUG
	endmenu

endmenu
```

## cp/components/saradc_intf/Kconfig
```kconfig
# KCONFIG_GROUP: Device Drivers::Analog
menu "Saradc_intf"
	config SARADC_CALI
		bool "Enable Saradc Cali"
		default n
		help
			Enable SAR ADC Calibration
endmenu
```
