## ap/middleware/driver/spi/Kconfig
```kconfig
menu "SPI"
    #TODO optimize SPI_DMA and GENERAL_DMA when optimize driver
	config SPI
		bool "SPI ENABLE"
		default y

	config SOC_SPI_UNIT_NUM
		int "Number of SPI units (1-4)"
		depends on SPI
		range 1 4
		default 2
		help
			Number of SPI units supported by the hardware.
			Valid values: 1, 2, 3, or 4.

	config SPI_DMA
		bool "Enable SPI DMA"
		default y

	config SPI_STATIS
		bool "Enable SPI Statis"
		default n

	config SPI_SUPPORT_TX_FIFO_WR_READY
		bool "Support TX FIFO Write Ready"
		default y

	config SPI_MST_FLASH
		bool "SPI Flash"
		depends on SPI
		default n
		help
			BEKEN Chip sets SPI interface as a master device, the slave device is a flash,
			then BEKEN Chip can access the flash with SPI interface.
			The application can read/writes data to flash directly by SPI Flash API,
			or reads/writes by file system API if enable relates macro, I.E. CONFIG_FATFS, CONFIG_LITTLEFS, CONFIG_VFS...

	config SPI_MST_PSRAM
		bool "SPI MST PSRAM"
		default n

	config SPI_PM_CB_SUPPORT
		bool "SPI PM Support"
		default n

	config SPI_BYTE_INTERVAL
		bool "SPI byte interval"
		default n

	config SPI_TEST
		depends on SPI
		bool "Enable spi test"
		default n

	config SPI_API_TEST
		depends on SPI
		bool "Enable spi api test"
		default n
		help
			Enable spi api test.

endmenu
```

## ap/middleware/driver/timer/Kconfig
```kconfig
menu "TIMER"
	config TIMER
		bool "Enable TIMER"
		default y

	config TIMER_COUNTER
		bool "Enable timer counter"
		default y

	config TIMER_SUPPORT_ID_BITS
		int "timer support id bits"
		range 0 262143
		default 0
		help
		Bitmask of supported timer IDs. 0 means all IDs are supported.
		For AP TIMER_ID12-17 use 258048 (0x3F000).

	config TIMER_US
		bool "Enable timer0 as microsecond timer"
		default n

	config TIMER_PM_CB_SUPPORT
		bool "Enable TIMER enter low voltage callback support"
		default n

	config TIMER_TEST
		depends on TIMER && DRIVER_TEST
		bool "Enable timer test"
		default y
endmenu
```

## ap/middleware/driver/trng/Kconfig
```kconfig
menu "TRNG"
	config TRNG_SUPPORT
		bool "Support hardware TRNG"
		default y


	config TRNG_TEST
		depends on TRNG_SUPPORT && DRIVER_TEST
		bool "Enable trng test"
		default y
endmenu
```

## ap/middleware/driver/wdt/Kconfig
```kconfig
menu "Task Watchdog"
	config TASK_WDT
		bool "Enable Task Watchdog"
		default n

	config TASK_WDT_PERIOD_MS
		depends on TASK_WDT
		int "Task Watchdog Period(ms)"
		default 60000

	config TASK_WDT_TEST
		depends on TASK_WDT && DRIVER_TEST
		bool "Enable task watchdog test"
		default y
endmenu
```

## ap/middleware/driver/wwdt/Kconfig
```kconfig
menu "Window Watchdog"
	config SUPPORT_WWDT
		bool "Enable Window Watchdog"
		default n

	config INT_WWDT_PERIOD_MS
		depends on SUPPORT_WWDT
		int "Interrupt Watchdog Period(ms)"
		default 2000

	config WWDT_TEST
		depends on SUPPORT_WWDT && DRIVER_TEST
		bool "Enable window watchdog test"
		default y
endmenu
```

## ap/middleware/soc/Kconfig
```kconfig
	choice SOC
		prompt "ARMINO SoC"
		default SOC_BK7259 if "$ARMINO_SOC" = "bk7259"
		default SOC_BK7259 if "$ARMINO_SOC" = "bk7259_ap"
		default SOC_BK7258 if "$ARMINO_SOC" = "bk7258"
		default SOC_BK7257 if "$ARMINO_SOC" = "bk7257"
		help
			Select the target chip family used by this build. The default is
			derived from ARMINO_SOC and normally should not be changed by users.

		config SOC_BK7259
			bool "BK7259"
		config SOC_BK7258
			select SOC_BK7236XX
			bool "BK7258"
		config SOC_BK7257
			select SOC_BK7236XX
			bool "BK7257"

	endchoice


	config CPU_CNT
			int "System CPU count: 1: single core, 2: dual core, etc."
			default 1
			help
				Total CPU count described by the target SoC/platform. This is a
				hardware/platform capability value and can include CPUs that are
				not managed by the current SMP OS instance.


	config SOC_STR
		string "SoC string"
		default "$ARMINO_SOC" if "$ARMINO_SOC" = "bk7259_ap"
		default "bk7259"  if SOC_BK7259
		default "bk7258"  if SOC_BK7258
		default "bk7257"  if SOC_BK7257
		default "$ARMINO_SOC"
		help
			String form of the selected SoC target. Build scripts and generated
			configuration files may use this value to locate target-specific
			resources.

	config SOC_ARCH
		string "Soc arch"
		default "unknown"
		help
			CPU architecture name for the selected SoC, such as cm55. This is
			normally provided by the target defconfig.

	config SOC_BK7236XX
		bool "For bk7236 series chipset"
		default n
		help
			Internal compatibility flag for BK7236-family chips. It is selected
			automatically by the matching SoC option.

	config SOC_SMP
		bool "For soc smp feature"
		default n
		help
			Enable Symmetric Multi-Processing support for SoCs and projects that
			run multiple CPU cores under one OS instance.

	config CPU_ID_OFFSET
		int "CPU ID offset"
		default 2
		depends on SOC_SMP
		help
			Base CPU ID used by the SMP runtime when mapping logical CPU indexes
			to hardware CPU IDs.

	config SMP_CORE_CNT
		int "SMP core count"
		default 2
		depends on SOC_SMP
		help
			Number of CPU cores that participate in the SMP OS scheduler. This
			is the runtime SMP core count and may be smaller than CPU_CNT when
			some CPUs are reserved for another core domain or firmware.
```

## ap/middleware/soc/bk7259_ap/Kconfig
```kconfig
	config SRAM_DIRECT_ADDR
		bool "Use SRAM direct address"
		default n

	config ITCM_SIZE
		hex "Total ITCM size"
		default 0x4000
		help
			Size of the Instruction TCM region reserved by the BK7259 AP
			memory layout. Keep this aligned with the linker script and target
			defconfig.

	config DTCM_SIZE
		hex "Total DTCM size"
		default 0x4000
		help
			Size of the Data TCM region reserved by the BK7259 AP memory
			layout. This region is used by the AP linker script, so change it
			only with a matching memory layout update.

	config ANA_REG_WRITE_POLL_REG_B
		bool "Write analog register polls sys reg0xb"
		default y
		help
			Use system register 0xb as the polling register when writing analog
			registers. This is a SoC-level hardware workaround and normally
			should keep the default value.

	config PM_HAL_DEBUG
		bool "Enable PM hal debug"
		default n
		help
			Enable extra debug output in the power-management HAL. This is
			intended for low-power debugging and should normally be disabled in
			product builds.

	config PM_HAL_CTRL
		bool "Enable PM HAL control"
		default n
		help
			Enable additional power-management HAL control paths for BK7259 AP.
			Use this only when the project explicitly needs PM HAL control
			debug or validation.

	config TZ
		bool "Supported TrustZone"
		default y
		help
			Enable TrustZone support for the BK7259 AP target. This should
			match the secure/non-secure memory layout and boot configuration.

	config SPE
		int "Enable SPE"
		default 0
		help
			Secure Processing Environment mode selector. This is a low-level
			boot/security setting and should match the target security layout.

	config RX_OPTIMIZE
		bool "Optimize rx current"
		default n
		help
			Enable receive-path current optimization for BK7259 AP. Use this
			only after validating RF/current behavior on the target board.
```

## cp/components/adc_key/Kconfig
```kconfig
# KCONFIG_GROUP: Device Drivers::Keys & Buttons
menu "Adc_key"

	config ADC_KEY
		bool "Enable Adc Key"
		default n

endmenu
```

## cp/components/at/Kconfig
```kconfig
# KCONFIG_GROUP: System Services::AT Command
menu "At"

	config AT_CMD
		bool "Enable At Cmd"
		default n

endmenu
```

## cp/components/audio_play/Kconfig
```kconfig
# KCONFIG_GROUP: Multimedia::Audio::Play
menu "Audio Play"

	config AUDIO_PLAY
		depends on AUDIO_DAC && ADK && ADK_RAW_STREAM && ADK_ONBOARD_SPEAKER_STREAM_V2
		bool "Enable Audio Play"
		default n

	config AUDIO_PLAY_SUPPORT_SBC_DECODER
		depends on AUDIO_PLAY && ADK_SBC_DECODER
		bool "Enable SBC decoder path in audio_play"
		default y

	config AUDIO_PLAY_SUPPORT_AAC_DECODER
		depends on AUDIO_PLAY && ADK_AAC_DECODER
		bool "Enable AAC decoder path in audio_play"
		default y

	config SPK_SERVICE_IDLE_LINGER_MS
		depends on AUDIO_PLAY && ADK_ONBOARD_SPEAKER_STREAM_SUPPORT_MULTIPLE_SOURCE
		int "Speaker service idle linger before auto-deinit (ms, 0=stay resident)"
		default 5000
		help
		  When the last playback source (A2DP/CALL/HINT) detaches, the shared
		  speaker/DAC lingers for this many milliseconds before being torn down.
		  A non-zero value bridges short gaps (track changes, call->music) so the
		  DAC is not re-initialised back to back (avoids pop/latency). Set to 0 to
		  keep the legacy behaviour where the speaker stays resident forever.

	config SPK_SERVICE_DUCK_ENABLE
		depends on AUDIO_PLAY && ADK_ONBOARD_SPEAKER_STREAM_SUPPORT_MULTIPLE_SOURCE
		bool "Enable prompt ducking (lower music/voice while a prompt plays)"
		default y
		help
		  While a prompt (HINT) is audible, attenuate the background music/voice
		  using the DAC per-source (first-stage) pre-mix gains, without touching
		  the master volume. Ducking is a prompt-only feature: music (A2DP) and
		  voice (CALL) are mutually exclusive by the app focus policy (a call
		  pauses music), so they never duck each other. Disable to mix a prompt at
		  full level over the background.

	config SPK_SERVICE_DUCK_HINT_ON_A2DP_DB
		depends on SPK_SERVICE_DUCK_ENABLE
		int "Prompt-over-music duck attenuation (dB, negative)"
		range -100 0
		default -12
		help
		  How much to lower A2DP music while a prompt plays. 0 = no ducking, more
		  negative = quieter background. -100 (or lower) fully mutes the music
		  (register forced to zero) so a prompt effectively silences it. Whole dB.

	config SPK_SERVICE_DUCK_HINT_ON_CALL_DB
		depends on SPK_SERVICE_DUCK_ENABLE
		int "Prompt-over-voice duck attenuation (dB, negative)"
		range -100 0
		default -6
		help
		  How much to lower HFP call voice while a prompt plays. Kept lighter than
		  music so call intelligibility is preserved. -100 fully mutes the voice.
		  Whole dB.

	config SPK_SERVICE_DUCK_RAMP_MS
		depends on SPK_SERVICE_DUCK_ENABLE
		int "Duck in/out ramp time (ms)"
		range 0 500
		default 30
		help
		  Duration of the smooth gain ramp when ducking engages/releases, so the
		  level change does not click. 0 applies the change in a single step.

	config SPK_SERVICE_DUCK_RAMP_STEP_MS
		depends on SPK_SERVICE_DUCK_ENABLE
		int "Duck ramp step interval (ms)"
		range 1 100
		default 5
		help
		  Granularity of the duck ramp: a smaller step is smoother but writes the
		  gain registers more often over the ramp window.

endmenu
```

## cp/components/bk_bluetooth/Kconfig
```kconfig
# KCONFIG_GROUP: Wireless Connectivity::Bluetooth
menu "Bk_ble"
    depends on BLUETOOTH

    config BT
        bool "Enable Bt"
        default n

    config BLE
        bool "Enable Ble"
        default y

    config BLE_LE_AUDIO
        bool "Enable LE Audio controller support"
        depends on BLE && BTDM_CONTROLLER_ONLY && BTDM_5_2
        default n
        help
            Enable controller-side LE Audio, Periodic Advertising, and PAST
            support for projects that use LE Audio broadcast synchronization.

    choice BLE_STACK
        prompt "Select Ble Version"
        depends on (BLE || BT)
        default BLE_5_X

        config BLE_5_X
            bool "BLE 5.X"
        config BLE_4_2
            bool "BLE 4.2"
        config BTDM_5_2
            bool "BTDM 5.2"
        config BTDM_5_2_MINDTREE
            bool "BTDM 5.2 Mindtree Host"
    endchoice

    config BLUETOOTH_MULTI_CONTROLLER
        bool "multi bluetooth controller"
        depends on (BLE || BT)
        default n

    choice BLUETOOTH_MULTI_CONTROLLER_MODE
        prompt "multi bluetooth controller mode"
        depends on BLUETOOTH_MULTI_CONTROLLER
        default BLUETOOTH_MULTI_CONTROLLER_MODE_PRI_ALL_SEC_NONE

        config BLUETOOTH_MULTI_CONTROLLER_MODE_PRI_ALL_SEC_NONE
            bool "primary all, secondary none"
        config BLUETOOTH_MULTI_CONTROLLER_MODE_PRI_NONE_SEC_ALL
            bool "primary none, secondary all"
        config BLUETOOTH_MULTI_CONTROLLER_MODE_PRI_BLE_SEC_BT
            bool "primary ble, secondary bt"
        config BLUETOOTH_MULTI_CONTROLLER_MODE_PRI_BT_SEC_BLE
            bool "primary bt, secondary ble"
    endchoice

    config BTDM_CONTROLLER_ONLY
        bool "BTDM controller only"
        default y

    config BLUETOOTH_RELEASE_CODESIZE
        bool "reduce ble stack size"
        depends on BLE
        default n
        help
            This option is used to reduce ble stack size for IoT scenarios that
            only use ble provisioning network.It supports two ble advertise,
            one ble link, and ble scan at the same time.it does not support SMP and central role.
            when config this option,BLUETOOTH_BLE_SLAVE_ONLY will be invalid.

    config BLUETOOTH_BLE_SLAVE_ONLY
        bool "only supports ble slave"
        depends on !BLUETOOTH_RELEASE_CODESIZE
        default n

    config BLUETOOTH_BLE_SLAVE_OBSERVER
        bool "only supports ble slave and observer"
        depends on BTDM_CONTROLLER_ONLY
        default n

    config BLUETOOTH_BLE_DISCOVER_AUTO
        bool "auto ble discover. Only used when single ble host"
        default y
    config BLUETOOTH_SUPPORT_LPO_ROSC
        bool "support lpo rosc"
        default n
    config BLUETOOTH_SUPPORT_IPC
        bool "bt support ipc"
        default y

    config BLE_LV_SUPPORT
        bool "support low voltage sleep"
        default n

    config BLUETOOTH_SUPPORT_AP_PWD_ALL
        bool "bluetooth support ap power down all"
        depends on BLUETOOTH_SUPPORT_IPC
        default n

    choice BLUETOOTH_RF_MODE
        prompt "Select Bluetooth RF Mode"
        default BLUETOOTH_RF_MODE_IQ_HIGH_PLL

        config BLUETOOTH_RF_MODE_POLAR
            bool "Polar Mode"
        config BLUETOOTH_RF_MODE_IQ_HIGH_PLL
            bool "IQ Mode Wifi PLL"
        config BLUETOOTH_RF_MODE_IQ_LOW_PLL
            bool "IQ Mode BT PLL"
    endchoice
endmenu
```

## cp/components/bk_httpc/Kconfig
```kconfig
# KCONFIG_GROUP: Network Services::HTTP Client
menu "Httpc"
	config HTTPC
		bool "Enable HTTPC"
		default n

endmenu
```

## cp/components/bk_mac802154/Kconfig
```kconfig
# KCONFIG_GROUP: Wireless Connectivity::IEEE 802.15.4
menu "mac802154"
	config MAC802154_ENABLE
		bool "Enable IEEE802.15.4"
		default n

endmenu
```
