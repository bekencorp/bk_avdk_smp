## ap/components/bk_rtos/Kconfig
```kconfig
# KCONFIG_GROUP: RTOS & Kernel
menu "Bk_rtos"

	menu "Modify BK Heap Config"

		config BK_HEAP_ENABLE
			bool "Enable BK Heap"
			default y

		choice OS_HEAP_TYPE
			prompt "Default OS_HEAP type"
			default OS_HEAP_USE_HSRAM
			help
				Select the default heap type used by os_malloc/os_zalloc.

			config OS_HEAP_USE_SRAM
				bool "Use SRAM as default heap"
				help
					Select the default heap type as sram heap.

			config OS_HEAP_USE_PSRAM
				bool "Use PSRAM as default heap"
				help
					Select the default heap type as psram heap.

			config OS_HEAP_USE_HSRAM
				bool "Use HSRAM as default heap"
				help
					Select the default heap type as hsrams heap.
		endchoice

	endmenu

	config CUSTOMIZE_HEAP_SIZE
		int "Set Customize Heap Size"
		default 163840
		help
			customize heap size, default 160k
    
	config PSRAM_HEAP_INIT_SET_ZERO
		bool "Set psram content zero"
		default n
		help
			when initialising psram memory,its contents are 
			automatically zeroed.

	config PSRAM_HEAP_INIT_CODE_IN_IRAM
		bool "the function:psram_heap_init is at the iram space"
		default n

	menu "Modify FreeRTOS Config"
		config FREERTOS
			bool "Enable FreeRTOS"
			default y

		config FREERTOS_FPU_ENABLE
			bool "Enable FreeRTOS FPU"
			default y

		config FREERTOS_MVE_ENABLE
			bool "Enable FreeRTOS MVE"
			default n

		config FREERTOS_USE_QUEUE_SETS
			depends on FREERTOS
			bool "Enable FreeRTOS Queue_Sets"
			default n

		config MEM_MGMT
			bool "Enable Mem Mgmt"
			default n
			help
				Enable heap management module

		choice FREERTOS_VER
			depends on FREERTOS
			prompt "Select FreeRTOS Version"
			default FREERTOS_V10

			config FREERTOS_V10
				bool "FreeRTOS v10"
			config FREERTOS_SMP
				bool "FreeRTOS SMP v10"
		endchoice

		config FREERTOS_POSIX
			depends on FREERTOS_V10 || FREERTOS_SMP
			bool "Enable FreeRTOS Posix"
			default n

		config KVS_PTHREAD_CANCEL_DETACH
			depends on FREERTOS_POSIX
			bool "KVS pthread_cancel/pthread_detach (FreeRTOS POSIX stub)"
			default n
			help
				Provide pthread_cancel and pthread_detach for components that need them
				(e.g. kvs_aws). Enable when building with CONFIG_KVS_AWS.

		config FREERTOS_TRACE
			depends on FREERTOS_V10 || FREERTOS_SMP
			bool "FreeRTOS Trace"
			default n

		config TASK_STACK_IN_PSRAM
			depends on FREERTOS_V10 || FREERTOS_SMP
			bool "Create FreeRTOS Task stack in psram"
			default n
		
		config QUEUE_IN_PSRAM
			depends on FREERTOS_V10 || FREERTOS_SMP
			bool "Create FreeRTOS queue in psram"
			default n

		config FREERTOS_ALLOW_OS_API_IN_IRQ_DISABLED
			depends on FREERTOS_SMP
			bool "Allow Call OS API in IRQ disabled"
			default n
			help
				Allow call some OS API in irq disabled, and scheduler will not enable
				the irq but left the user app to restore previous irq status.

		config FREERTOS_SMP_CROSS_CORE_IPI
			depends on FREERTOS_SMP && IPI
			bool "Use IPI for FreeRTOS SMP cross-core interrupt"
			default n
			help
				Use IPI_DOMAIN_SMP as the SMP cross-core doorbell. If disabled,
				the SMP port keeps using the existing mailbox notification path.

		config FREERTOS_RTT_MONITOR
			depends on FREERTOS_SMP
			bool "FreeRTOS Segger Real-Time Transfer"
			default n

		config FREERTOS_USE_TICKLESS_IDLE
			depends on FREERTOS_V10 || FREERTOS_SMP
			int "Set FreeRTOS Use Tickless Idle"
			default 2
			help
				Use tickless idle, can be 0/1/2

		config FREERTOS_TICK_RATE_HZ
			depends on FREERTOS
			int "Set FreeRTOS tick count per second"
			default 1000
			help
				System tick count per second, can be 1-1000
        
		config BK_OS_TIMER_DEBUG
			bool "Enable OS timer Debug"
			default y
			 help
				when turn on the marco,the current task TCB information
				will be added every time the software timer command is sent

		config DEBUG_RTOS_TIMER
			bool "Enable OS adapter layer timer Debug"
			default n
			help
				when turn on the marco, the System will output timer related
				debug information

		config RTOS_TIMER_DEBUG_CNT
			depends on DEBUG_RTOS_TIMER
			int "OS adapter layer timer Debug count value"
			default 128
			help
				set OS adapter layer timer Debug count value    

		config FREERTOS_HISTORY_CPU_PERCENT
			bool "Enable FreeRTOS CPU usage percent record"
			default n             

		config SMP_FIRST_TASK_PENDSV_RACE_TEST
			depends on FREERTOS_SMP
			bool "TEST: reproduce early-PendSV-before-first-task race (BK7259SW-1723)"
			default n
			help
				Debug/test only. Force a PendSV to be pending right before each
				core starts its first task in xPortStartSchedulerOnCore(). This
				deterministically reproduces BK7259SW-1723: a PendSV serviced
				before the first task PSP is loaded, which (without the fix)
				saves the FP context to an invalid PSP (0xfffffffc) and triggers
				a MemFault. With the fix the pending PendSV stays masked until
				the first task PSP is valid, so the system boots normally.
				Keep this OFF in production builds.

		config SMP_DISABLE_FIRST_TASK_PENDSV_FIX
			depends on FREERTOS_SMP
			bool "TEST: disable the first-task PendSV-mask fix (BK7259SW-1723)"
			default n
			help
				Debug/test only. Revert vStartFirstTask() to the old behavior
				(open all interrupts via cpsie before the first task PSP is
				loaded). Use together with SMP_FIRST_TASK_PENDSV_RACE_TEST to
				demonstrate the original MemFault. Keep this OFF in production.

	endmenu



	menu "Modify NON_OS Config"

		config NON_OS
			bool "Enable Non_os"
			default n

	endmenu

	menu "Modify Memory Debug Config"

		config MALLOC_STATIS
			bool "Enable Malloc Statis"
			default n
			help
				enable malloc statistics

		config MEM_DEBUG
			bool "Enable Mem Debug"
			default n
			help
				When this option is enable, more memory will be consumed because
				a fixed length debug block will be appended to every memory allocated
				from heap.
				Moreover, suggest disable task/watchdog when this option is enabled
				in case os_dump_memory_stats() triggers watchdog.

		config MEM_DEBUG_FUNC_NAME
			depends on MEM_DEBUG
			bool "Enable Mem Debug Func Name"
			default y

		config MEM_DEBUG_FUNC_NAME_LEN
			depends on MEM_DEBUG_FUNC_NAME
			int "Set Mem Debug Func Name Len"
			default 16
			help
				set memory debug function name length

		config MEM_DEBUG_TASK_NAME
			depends on MEM_DEBUG
			bool "Enable Mem Debug Task Name"
			default y

		config MEM_DEBUG_TASK_NAME_LEN
			depends on MEM_DEBUG_TASK_NAME
			int "Set Mem Debug Task Name Len"
			default 8
			help
				set memory debug task name length

		config MEM_DEBUG_OVERFLOW
			bool "Enable memory overflow debug"
			default n

		config HEAP_UAF_AUDIT_POISON
			depends on MEM_DEBUG
			bool "Enable heap UAF audit and poison"
			default n
			help
				Enable the P0 heap use-after-free triage aid.

				When a block is freed, this option records the block address,
				size, allocation caller/task/tick, and free caller/task/tick
				in a fixed ring buffer. It also fills the user payload with a
				fixed poison pattern before returning the block to the heap, so
				stale reads or stale function/list pointers are more likely to
				show an obvious abnormal value or crash earlier.

				This option does not quarantine freed blocks and does not trap
				the exact stale access instruction. Quarantine is controlled
				separately by HEAP_UAF_QUARANTINE and reuses the same poison
				behavior.

				This is a debug-only aid and should stay disabled in production.

		config HEAP_UAF_FREE_RECORD_MAX
			depends on HEAP_UAF_AUDIT_POISON
			int "Set heap UAF free record count"
			range 1 512
			default 128
			help
				Number of recent free records kept in a fixed ring buffer.

		config HEAP_UAF_QUARANTINE
			depends on HEAP_UAF_AUDIT_POISON
			bool "Enable heap UAF quarantine"
			default n
			help
				Delay returning freed blocks to the underlying heap after
				the audit and poison step. This keeps poisoned payloads alive
				longer, so stale reads or stale pointer dereferences are more
				likely to expose use-after-free defects.

				The quarantine path is shared by SRAM, HSRAM, and PSRAM heap
				free operations. Blocks are released in FIFO order when the
				total quarantined capacity exceeds HEAP_UAF_QUARANTINE_BYTES.
				The fixed quarantine slot count is configured by
				HEAP_UAF_QUARANTINE_RECORD_MAX to avoid dynamic allocation
				in the debug path.

				This is a debug-only aid and should stay disabled in production.

		config HEAP_UAF_QUARANTINE_RECORD_MAX
			depends on HEAP_UAF_QUARANTINE
			int "Set heap UAF quarantine record count"
			range 1 1024
			default 512
			help
				Number of freed blocks that can be retained in the quarantine
				FIFO. This controls the metadata slot count, while
				HEAP_UAF_QUARANTINE_BYTES controls the total retained block
				capacity.

		config HEAP_UAF_QUARANTINE_BYTES
			depends on HEAP_UAF_QUARANTINE
			int "Set heap UAF quarantine capacity in bytes"
			range 4096 1048576
			default 65536
			help
				Maximum total allocated block bytes retained in the quarantine
				FIFO. When this capacity is exceeded, the oldest blocks are
				returned to their original heap until the new block can fit.
				A single block larger than half this capacity bypasses
				quarantine to prevent one large buffer from flushing the whole
				FIFO.
        
		config MEM_OVERFLOW_FREE_RECORD_MAX
			depends on MEM_DEBUG_OVERFLOW
			int "Set memory overflow free record len"
			default 512
        
        config MEM_OVERFLOW_MALLOC_RECORD_MAX
			depends on MEM_DEBUG_OVERFLOW
			int "Set memory overflow malloc record len"
			default 256
        
        config MEM_OVERFLOW_FREELIST_RECORD_MAX
			depends on MEM_DEBUG_OVERFLOW
			int "Set memory overflow freelist record len"
			default 128

	endmenu

    menu "Modify OS Debug Config "

        config ISR_DISABLE_TIME_STATISTIC
		bool "Measure interrupt-disabled time in critical sections"
		default n
		help
			Track how long interrupts stay disabled after entering RTOS
			critical sections, including global critical sections.

			When enabled, long interrupt-disabled intervals can be traced
			or asserted according to the runtime thresholds configured by
			the critstat CLI command.

    endmenu

endmenu
```

## ap/components/bk_tflite_micro/Kconfig
```kconfig
menu "TFLite Micro"
	config TFLITE_MICRO
		bool "Enable TFLite Micro"
		default n

	config NPU
		bool "Enable Arm Ethos-U65 NPU support"
		depends on TFLITE_MICRO
		default n
		help
			Enable Arm Ethos-U65 NPU support for TensorFlow Lite Micro.
			When enabled, operators supported by NPU will be offloaded to NPU,
			and unsupported operators will fall back to CMSIS-NN implementation.

	config NPU_CACHE
		bool "Enable NPU driver support cache operations"
		depends on NPU
		default n
		help
			Enable cache API adaptation for NPU driver.
			When enabled, bk_ethosu.c will implement cache operations using
			arch_dcache_flush_range and arch_dcache_invd_range, overriding the
			weak functions in ethosu_driver.c.
endmenu
```

## ap/components/bk_thirdparty/agora-iot-sdk/Kconfig
```kconfig
# KCONFIG_GROUP: Third Party::agora-iot-sdk
menu "Bk_thirdparty::agora-iot-sdk"

	config AGORA_IOT_SDK
		bool "Enable Agora iot sdk"
		default n
		help
			Enable Agora iot sdk lib

	config AGORA_RTC_THREAD_BIND_CPU
		bool "Enable agora RTC thread bind cpu"
		depends on AGORA_IOT_SDK
		default n
		help
			Enable Agora RTC thread bind cpu

	config AGORA_RTC_THREAD_BIND_CPU_ID
		int "Agora RTC thread bind cpu id"
		depends on AGORA_RTC_THREAD_BIND_CPU
		default 0
		help
			Agora RTC thread bind cpu id

	config AGORA_RTC_USE_STRING_UID
		bool "Use string UID for Agora RTC"
		depends on AGORA_IOT_SDK
		default n

endmenu
```

## ap/components/bk_thirdparty/kvs_aws/Kconfig
```kconfig
# KCONFIG_GROUP: Third Party::kvs_aws
# Kconfig for AWS Kinesis Video Streams WebRTC (kvs_aws)

menu "AWS KVS WebRTC"

	config KVS_AWS
		bool "Enable AWS KVS WebRTC component"
		default n
		# CommonDefs.h (BEKEN_PLATFORM) includes <FreeRTOS_POSIX.h>; bk_rtos only exports that path when this is on.
		select FREERTOS_POSIX
		select KVS_PTHREAD_CANCEL_DETACH
		help
			Enable Amazon Kinesis Video Streams WebRTC C SDK (kvsWebrtcClient + signaling + kvsCommonLws + PIC).

	config KVS_AWS_DATA_CHANNEL
		bool "Enable WebRTC Data Channel (SCTP)"
		depends on KVS_AWS
		default n
		help
			Enable Data Channel support. Requires usrsctp component. Leave disabled for audio/video-only use.

	config KVS_GET_CA_FROM_ARRAY
		bool "Load KVS TLS CA from embedded PEM array (not SD/file)"
		depends on KVS_AWS
		default n
		help
			When enabled, the AWS KVS / WebRTC CA trust anchor is taken from the compiled-in PEM in
			kvs_embedded_ca_cert.c instead of DEFAULT_KVS_CACERT_PATH on SD (e.g. /sdcard/certs/cert.pem).
			Disable to use file-based CA as before on Beken.

	config KVS_DEFAULT_STACK_SIZE_BYTES
		int "KVS/WebRTC default pthread stack size (bytes)"
		depends on KVS_AWS
		default 30720
		range 4096 131072
		help
			Raise if stack overflows; lower to save RAM when thread count is small.

	config KVS_SIGNALING_CACHE_ENTRY_COUNT
		int "Signaling file cache entry count (embedded)"
		depends on KVS_AWS
		default 4
		range 1 32
		help
			Each entry uses heap (~order of KB). Use 1 for single fixed channel; up to 32 for desktop-like behavior.

	config KVS_AWS_ROLE_VIEWER
		bool "Build kvs_aws_sample as Viewer (receive from Master)"
		depends on KVS_AWS
		default n
		help
			When set, sample runs as Viewer (receive H264/H265/Opus). When unset, runs as Master (send from h264/h265/opusSampleFrames).
endmenu
```

## ap/components/bk_thirdparty/libsrtp2/Kconfig
```kconfig
# KCONFIG_GROUP: Third Party::libsrtp2
menu "libsrtp2"
	config LIBSRTP
		bool "Enable libsrtp2"
		default n
		help
			enable libsrtp2
	menu "libsrtp2 Options"
		depends on LIBSRTP

		config LIBSRTP2_TEST
			bool "Enable libsrtp2 test"
			default n
			help
				control libsrtp2 testing code

	endmenu
endmenu
```

## ap/components/bk_thirdparty/libwebsockets/Kconfig
```kconfig
# KCONFIG_GROUP: Third Party::libwebsockets

config LIBWEBSOCKETS
	bool "Enable libwebsockets (selects PSA_MBEDTLS for TLS)"
	default n
	select PSA_MBEDTLS
	help
		Libwebsockets requires mbedtls for SSL/TLS. Selecting this will
		automatically enable PSA_MBEDTLS so that mbedtls headers are available.

menu "Libwebsockets"
	depends on LIBWEBSOCKETS

config LWS_MODEL_NAME
	string "Model name of device firmware is for"
	default "lws"

config LWS_IS_FACTORY_APPLICATION
	bool "Is this application is designed for the FACTORY flash slot"
	default "n"

config LWS_OTA_SERVER_FQDN
	depends on LWS_IS_FACTORY_APPLICATION
	string "Domain name of OTA update server, eg, warmcat.com"
	default ""

config LWS_OTA_SERVER_BASE_URL
	depends on LWS_IS_FACTORY_APPLICATION
	string "Base URL on OTA update server, eg, /esp32-ota (model is added)"
	default "/esp32-ota"

config LWS_OTA_SERVER_UPLOAD_USER
	depends on LWS_IS_FACTORY_APPLICATION
	string "User to scp to upload server with"
	default "root"

config LWS_OTA_SERVER_UPLOAD_PATH
	depends on LWS_IS_FACTORY_APPLICATION
	string "Path served in upload server (eg, \"/var/www/libwebsockets.org\""
	default "/var/www/libwebsockets.org"

endmenu
```

## ap/components/bk_tof/Kconfig
```kconfig
# KCONFIG_GROUP: Device Drivers::Sensors
menu "bk_tof"

	config TOF_ENABLE
		bool "Enable ToF"
		default n

	config TOF_I2C_ID
		depends on TOF_ENABLE
		int "I2C controller ID"
		range 0 2
		default 1

	config TOF_VI5302_ENABLE
		depends on TOF_ENABLE
		bool "Enable Visionics VI5302 "
		default n

	config TOF_VI5302_HW_IRQ
		depends on TOF_VI5302_ENABLE
		bool "Use GPIO hardware interrupt (else poll IntrStat)"
		default n

	config TOF_XSHUT_PIN
		depends on TOF_ENABLE
		int "XSHUT GPIO pin number"
		range 0 255
		default 255

	config TOF_INT_PIN
		depends on TOF_ENABLE
		int "INT GPIO pin number"
		range 0 255
		default 255


endmenu
```
