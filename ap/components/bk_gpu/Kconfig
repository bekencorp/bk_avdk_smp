## ap/components/bk_peripheral/src/lcd/dsi/Kconfig
```kconfig
# KCONFIG_GROUP: Multimedia::Display & UI::LCD
menu "DSI LCD"
	config LCD_DSI
		depends on BK_PERIPHERAL
		bool "Enable LCD_DSI intf"
		default n

	config LCD_FRD700B30023_MIPI_1024x600
		depends on LCD_DSI
		bool "Enable LCD_FRD700B30023_MIPI_1024x600 API"
		default n

	config LCD_GH8555BL_MIPI_800x1280
		depends on LCD_DSI
		bool "Enable LCD_GH8555BL_MIPI_800x1280 API"
		default n

	config LCD_HX8394F_MIPI_720x1280
		depends on LCD_DSI
		bool "Enable LCD_HX8394F_MIPI_720x1280 API"
		default n

	config LCD_HX8399C_MIPI_1080x1920
		depends on LCD_DSI
		bool "Enable LCD_HX8399C_MIPI_1080x1920 API"
		default n

	config LCD_EK79007AD_MIPI_1024x600
		depends on LCD_DSI
		bool "Enable LCD_EK79007AD_MIPI_1024x600 API"
		default n

	config LCD_FL7703NP_MIPI_720x1280
		depends on LCD_DSI
		bool "Enable LCD_FL7703NP_MIPI_720x1280 API"
		default n

	config LCD_FL7703_MIPI_720x1280
		depends on LCD_DSI
		bool "Enable LCD_FL7703_MIPI_720x1280 API"
		default n

	config LCD_ER68576B_MIPI_720x1280
		depends on LCD_DSI
		bool "Enable LCD_ER68576B_MIPI_720x1280 API"
		default n

	config LCD_GC9702_MIPI_720x1280
		depends on LCD_DSI
		bool "Enable LCD_GC9702_MIPI_720x1280 API"
		default n

	config LCD_JD9522Z_MIPI_1080x1920
		depends on LCD_DSI
		bool "Enable LCD_JD9522Z_MIPI_1080x1920 API"
		default n

	config LCD_JD9855_MIPI_320x385
		depends on LCD_DSI
		bool "Enable LCD_JD9855_MIPI_320x385 API"
		default n

	config LCD_CO5300_MIPI_320x360
		depends on LCD_DSI
		bool "Enable LCD_CO5300_MIPI_320x360 API"
		default n

	config LCD_ST7701SN_MIPI_360x640
		depends on LCD_DSI
		bool "Enable LCD_ST7701SN_MIPI_360x640 API"
		default n

	config LCD_ST7701S_MIPI_412x960
		depends on LCD_DSI
		bool "Enable LCD_ST7701S_MIPI_412x960 API"
		default n

	config LCD_ST7701SN_MIPI_480x640
		depends on LCD_DSI
		bool "Enable LCD_ST7701SN_MIPI_480x640 API"
		default n

	config LCD_ST7701SN_MIPI_480x854
		depends on LCD_DSI
		bool "Enable LCD_ST7701SN_MIPI_480x854 API"
		default n
	config LCD_LT8912B_MIPI_BRIDGE
		depends on LCD_DSI
		bool "Enable LCD_LT8912B_MIPI_BRIDGE"
		default n

	if LCD_LT8912B_MIPI_BRIDGE
	choice
		prompt "LT8912B HDMI resolution"
		default LCD_LT8912B_RES_1280x720
		config LCD_LT8912B_RES_800x600
			bool "800x600@60Hz"
		config LCD_LT8912B_RES_1024x768
			bool "1024x768@60Hz"
		config LCD_LT8912B_RES_1280x720
			bool "1280x720@60Hz"
		config LCD_LT8912B_RES_1280x800
			bool "1280x800@60Hz"
		config LCD_LT8912B_RES_1920x1080
			bool "1920x1080@30Hz"
	endchoice

	# LT8912B I2C pins are intentionally configured in this driver's own
	# Kconfig (and not in the generic display board config) so that the
	# bridge stays self-contained: the bk_display / panel common code
	# never sees, allocates, or forwards a "side-channel I2C" object -
	# that whole bus belongs to the bridge IC alone.
	# Defaults match the BK7259 EVB wiring; override per-board via
	# defconfig if your board routes LT8912B SCL/SDA differently.
	config LCD_LT8912B_PIN_SCL
		depends on LCD_LT8912B_MIPI_BRIDGE
		int "LT8912B I2C SCL GPIO"
		default 69
		help
		  GPIO index used for the LT8912B-private software I2C SCL
		  line. Consumed by sw_i2c_init() inside lcd_mipi_lt8912b_bridge.c.

	config LCD_LT8912B_PIN_SDA
		depends on LCD_LT8912B_MIPI_BRIDGE
		int "LT8912B I2C SDA GPIO"
		default 70
		help
		  GPIO index used for the LT8912B-private software I2C SDA
		  line. Consumed by sw_i2c_init() inside lcd_mipi_lt8912b_bridge.c.

	config LCD_LT8912B_AVI_ENABLE
		depends on LCD_LT8912B_MIPI_BRIDGE
		bool "Enable LT8912B AVI infoframe and audio IIS config"
		default n

	config LCD_LT8912B_LVDS_ENABLE
		depends on LCD_LT8912B_MIPI_BRIDGE
		bool "Enable LT8912B LVDS scaler config and disable LVDS output"
		default n
	endif
endmenu
```

## ap/components/bk_peripheral/src/lcd/spi/Kconfig
```kconfig
# KCONFIG_GROUP: Multimedia::Display & UI::LCD
menu "SPI LCD"

	config LCD_SPI_ST7796U
		bool "Enable LCD_SPI_ST7796U"
		default n

	config LCD_SPI_GC9D01
		bool "Enable LCD_SPI_GC9D01"
		default n

	config LCD_SPI_ST7789V2
		bool "Enable LCD_SPI_ST7789V2"
		default n

	config LCD_SPI_JD9853
		bool "Enable LCD_SPI_JD9853"
		default n
endmenu
```

## ap/components/bk_peripheral/src/tp/Kconfig
```kconfig
# KCONFIG_GROUP: Device Drivers::Touch
menu "TP"
	config TP
		bool "Enable TP"
		default n

	config TP_RST_PIN
		depends on TP
		int "Set TP RST PIN"
		default 5

	config TP_INT_PIN
		depends on TP
		int "Set TP INT PIN"
		default 6

	config TP_I2C_SDA_PIN
		depends on TP
		int "Set TP I2C SDA PIN"
		default 1

	config TP_I2C_SCL_PIN
		depends on TP
		int "Set TP I2C SCL PIN"
		default 0

	config TP_GT911
		depends on TP
		bool "Enable TP_GT911 API"
		default n

	config TP_GT1151
		depends on TP
		bool "Enable TP_GT1151 API"
		default n

	config TP_FT6336
		depends on TP
		bool "Enable TP_FT6336 API"
		default n

	config TP_HY4633
		depends on TP
		bool "Enable TP_HY4633 API"
		default n

	config TP_CST816D
		depends on TP
		bool "Enable TP_CST816D API"
		default n

	config TP_CST9217
		depends on TP
		bool "Enable TP_CST9217 API"
		default n

	config TP_CST328
		depends on TP
		bool "Enable TP_CST328 API"
		default n

	config TP_FT5316
		depends on TP
		bool "Enable TP_FT5316 API"
		default n
endmenu
```

## ap/components/bk_pm/Kconfig
```kconfig
# KCONFIG_GROUP: Power Management
menu "PM"
	config PM_ENABLE
		bool "pm enable"
		default n

	config PM_CLIENT
		bool "indicate the current cpu running as pm client core, otherwise running as pm server core"
		default n

	config PM_CLIENT_MAILBOX
		bool "enable mailbox communication between pm client and pm server"
		default n

	config PM_SUPER_DEEP_SLEEP
		bool "Enable super deep sleep"
		default n

	config PM_EXTEND_CPU_FREQ
		bool "Extend cpu freq"
		default n

	config PM_LV_TIME_COST_DEBUG
		bool "Enable low voltage sleep time cost debug"

	config PM_ENTER_LV_TIME_OUT_PERIOD_MS
		int "Enter LV time out"
		default 30000
		help
			enter LV time out time(unit:ms)

	config PM_LV_WDT_PROTECTION
		bool "add protection for hardware enter low voltage fail when application abnormal operate, using wdt to reboot"
		default n

	config PM_CPU_FRQ_HIGHEST
		int "config highest cpu frequency"
		default 3
		help
		   config highest cpu frequency(0:xtal;1:80M;2:120M;3:160M;4:240M;5:320M;6:480M;)

	config PM_CPU_FRQ_DEFAULT
		int "config default cpu frequency"
		default 2
		help
		   config default cpu frequency(0:xtal;1:80M;2:120M;3:160M;4:240M;5:320M;6:480M;)

	config PM_AP_CPU_FRQ_DEFAUL
		bool "Vote default cpu frequency during AP init"
		default n
		help
			When enabled, AP bk_init votes CONFIG_PM_CPU_FRQ_DEFAULT
			via bk_pm_module_vote_cpu_freq() at the end of initialization.

	config PM_PROTECT_TIME_CHECK
		bool "Primarily protect time check"
		default n
		help
			Primarily protect the BT sleep time until re-entering the sleep scenario

	config PM_LOWEST_POWER_MODE
		int "config lowest power mode"
		default 0
		help
		   config lowest power mode(0:normal sleep;1:low voltage sleep;2:deep sleep;3:super deep sleep;)

	config PM_ONLY_CP_ENABLE
		bool "only cp enable ,ap disable"
		default n
		help
			only cp enable ,ap disable

	config DEEP_LV
		bool "Enable deep low voltage"
		default n

	config DEEP_LV_DEBUG
		bool "Enable deep low voltage debug"
		default n

	config PM_AP_POWERDOWN_WHEN_LV
		bool "Power down ap when sleep"
		default n

	config PM_AP_SUBPOWER_DOMAIN_DEFAULT_DISABLE
		bool "Disable AP sub-power domains by default"
		default n
		help
			Power off the VIDEO_POST, H26E, ISP and NPU power domains
			during AP power-management hardware initialization.

	config PM_AP_FAST_BOOT_ENABLE
		bool "Restore AP FreeRTOS execution point after AP power cycle"
		depends on SOC_SMP && PSRAM_DATA_RETENTION_ENABLE
		select DEEP_LV
		default n
		help
			Save the AP CPU0 architectural context before WFI and resume it
			from the reset vector using retained AP SRAM. Back up power-gated
			DTCM into retained AP SRAM and restore it before re-enabling
			interrupts. The secondary AP core must be offline before capture.

endmenu
```
