## ap/components/bk_gpu/Kconfig
```kconfig
# KCONFIG_GROUP: Multimedia::Display & UI
menu "BK_GPU"

	config VG_LITE_GPU
		depends on FREERTOS_FPU_ENABLE
		bool "Enable VG_LITE_GPU"
		default n

	config VG_LITE_GPU_BASE_ADDRESS
		depends on VG_LITE_GPU
		hex "vg-lite gpu module base address"
		default 0x4c280000

	config VG_LITE_GPU_COMMAND_BUFFER_SIZE
		depends on VG_LITE_GPU
		hex "vg-lite gpu command buffer size, Default 16KB."
		default 0x2000

	config VG_LITE_GPU_TASK_STACK_SIZE
		depends on VG_LITE_GPU
		int "vg-lite gpu flexa worker task stack size (bytes)"
		default 10240
		help
			Stack for the "gpu" worker created by gpu_ctlr_open(). It comes
			out of HSRAM, which the display pipeline and the LVGL heap also
			draw on, so on memory-tight products this is worth measuring with
			the memstack command and trimming.

	config VG_LITE_GPU_TESS_WIDTH
		depends on VG_LITE_GPU
		int "vg-lite reserved tessellation width (0 = no reserved tess)"
		default 0
		help
		  Maximum tessellation width reserved when applying VG-Lite mem
		  config. GPU is shared by multiple scenes, so the contiguous
		  heap is always allocated for this maximum. A later
		  vg_lite_init() request larger than this value fails.
		  0 disables the reserved tess buffer.

	config VG_LITE_GPU_TESS_HEIGHT
		depends on VG_LITE_GPU
		int "vg-lite reserved tessellation height (0 = no reserved tess)"
		default 0
		help
		  Maximum tessellation height reserved when applying VG-Lite mem
		  config. Must be used together with VG_LITE_GPU_TESS_WIDTH.
		  0 disables the reserved tess buffer.

endmenu
```

## ap/components/bk_gsensor/Kconfig
```kconfig
# KCONFIG_GROUP: Device Drivers::Sensors
menu "bk_gsensor"

	config GSENSOR_ENABLE
		bool "Enable gsensor"
		default n

	config GSENSOR_TEST_EN
		depends on GSENSOR_ENABLE
		bool "Enable gsensor test"
		default n

	config GSENSOR_DEMO_EN
		depends on GSENSOR_ENABLE
		bool "Enable gsensor demo"
		default n
		
	config GSENSOR_ARITHEMTIC_DEMO_EN
		depends on GSENSOR_ENABLE
		bool "Enable gsensor arithemtic demo"
		default n

	choice
		depends on GSENSOR_ENABLE
		prompt "G-Sensor chip select"
		default GSENSOR_SC7A20_ENABLE

		config GSENSOR_SC7A20_ENABLE
			bool "gsensor SC7A20"

		config GSENSOR_ICM42670P_ENABLE
			bool "gsensor ICM-42670-P"
	endchoice

	config GSENSOR_I2C_ID
		depends on GSENSOR_ENABLE
		int "gsensor I2C ID"
		default 0
		range 0 2

	config GSENSOR_INT_PIN
		depends on GSENSOR_ENABLE
		int "gsensor INT pin"
		default 0
		range 0 79
endmenu
```

## ap/components/bk_httpc/Kconfig
```kconfig
# KCONFIG_GROUP: Network Services::HTTP
menu "Httpc"
	config HTTPC
		bool "Enable HTTPC"
		default n

endmenu
```

## ap/components/bk_https/Kconfig
```kconfig
# KCONFIG_GROUP: Network Services::HTTP
menu "Https"
	config HTTPS
		bool "Enable HTTPS"
		default n
endmenu
```

## ap/components/bk_init/Kconfig
```kconfig
# KCONFIG_GROUP: System Services::Startup & Initialization
menu "init"
	config UT_REG
		bool "Enable uinity UT register" 
		default n
endmenu
```

## ap/components/bk_jerryscript/Kconfig
```kconfig
# KCONFIG_GROUP: Third Party::JerryScript
menu "BK JerryScript"

	config BK_JERRYSCRIPT
		bool "Enable JavaScript runtime (JerryScript)"
		default n
		help
			Enable a JerryScript based JavaScript runtime.  The engine context
			and heap are allocated from PSRAM, and scripts are executed on a
			dedicated task so that the console task stack is never used to run
			JavaScript code.

	choice BK_JERRYSCRIPT_HEAP_MEM
		prompt "JerryScript heap memory"
		depends on BK_JERRYSCRIPT
		default BK_JERRYSCRIPT_HEAP_IN_PSRAM
		help
			Backing memory of the engine heap.  The heap is a single block
			allocated when the engine starts, so the choice is fixed at build
			time.  If the preferred allocator fails the other one is tried.

		config BK_JERRYSCRIPT_HEAP_IN_PSRAM
			bool "PSRAM"
			help
				Allocate the engine heap with psram_malloc().  Keeps internal
				SRAM free for LVGL and the application.  Slower, because the
				heap is not cacheable.

		config BK_JERRYSCRIPT_HEAP_IN_SRAM
			bool "HSRAM"
			help
				Allocate the engine heap from the high speed SRAM heap with
				hsram_malloc().  Noticeably faster, but a large heap will
				starve LVGL, so keep BK_JERRYSCRIPT_HEAP_SIZE_KB small
				(64-128 KB).
	endchoice

	config BK_JERRYSCRIPT_HEAP_SIZE_KB
		int "JerryScript heap size (KB)"
		depends on BK_JERRYSCRIPT
		range 64 512
		default 256
		help
			Size of the JerryScript engine heap.  16 bit compressed pointers
			limit the heap to 512 KB.

	config BK_JERRYSCRIPT_DEFAULT_TIMEOUT_MS
		int "Default script timeout (ms)"
		depends on BK_JERRYSCRIPT
		range 100 60000
		default 5000
		help
			Default execution timeout of a single script.  When the timeout
			expires the engine throws an error and the script is terminated.

	config BK_JERRYSCRIPT_TASK_STACK_SIZE
		int "JavaScript task stack size (bytes)"
		depends on BK_JERRYSCRIPT
		range 8192 65536
		default 24576

	config BK_JERRYSCRIPT_APPS_ROOT
		string "Application root directory"
		depends on BK_JERRYSCRIPT
		default "/apps"
		help
			Directory scanned for applications.  Every sub-directory is one
			application and contains manifest.json plus the entry script.

	config BK_JERRYSCRIPT_FS
		bool "Enable script access to the file system"
		depends on BK_JERRYSCRIPT && VFS
		default y
		help
			Add the fs.* and require() bindings and allow applications to be
			loaded from the file system.  Requires CONFIG_VFS and a mounted
			file system below the application root directory.

	config BK_JERRYSCRIPT_FS_AUTO_MOUNT
		bool "Mount the application file system during init"
		depends on BK_JERRYSCRIPT_FS && LITTLEFS
		default y
		help
			Mount the littlefs image stored in the usr_config flash
			partition on the application root directory when the JavaScript
			runtime is initialised.  Applications can then be started
			straight from the file system without a manual mount command.

	config BK_JERRYSCRIPT_UI
		bool "Enable LVGL bindings (lv.* / ui.*)"
		depends on BK_JERRYSCRIPT && LVGL && !LVGL_V8
		default y
		help
			Expose the lv.* widget factory and the higher level ui.* page
			helpers to scripts.  All LVGL calls are serialised with the
			LVGL display lock.

	config BK_JERRYSCRIPT_BUILTIN_DEMO
		bool "Fall back to the built-in demo application"
		depends on BK_JERRYSCRIPT
		default y
		help
			When no application can be loaded from the file system, run a
			small built-in demo instead of failing.  Useful to verify the
			display pipeline without an SD card.

	config BK_JERRYSCRIPT_AUTO_START
		bool "Start the first application automatically"
		depends on BK_JERRYSCRIPT
		default n
		help
			Start the default (or the first found) application as soon as
			bk_js_runtime_init() returns.

	config BK_JERRYSCRIPT_CLI
		bool "Enable js CLI command"
		depends on BK_JERRYSCRIPT && CLI
		default y
		help
			Register the "js" console command
			(js eval/run/apps/start/stop/status/mem/deinit).

endmenu
```

## ap/components/bk_log/Kconfig
```kconfig
menu "GPIO_LOG"

	config GPIO_LOG_ENABLE
		bool "Enable GPIO LOG"
		default n

	config GPIO_LOG_CLK_PIN
		int "Set GPIO LOG CLK PIN"
		depends on GPIO_LOG_ENABLE
		range 0 255
		default 3

	config GPIO_LOG_DATA_PIN
		int "Set GPIO LOG DATA PIN"
		depends on GPIO_LOG_ENABLE
		range 0 255
		default 2

	config GPIO_LOG_CLK_IDLE_STATE
		int "Set GPIO LOG CLK IDLE STATE"
		depends on GPIO_LOG_ENABLE
		range 0 1
		default 0  # 0: idle state is low, 1: idle state is high

	config BK_TRACE_PRINT_ENABLE
		bool "Enable BK TRACE PRINT"
		depends on GPIO_LOG_ENABLE
		default n

endmenu
```

## ap/components/bk_modem/Kconfig
```kconfig
# KCONFIG_GROUP: Network Services::Modem
#TODO add depens 
menu "Mcu_4g_modem"
	config BK_MODEM
	bool "Enable Beken Modem"
	default n

	config UART_NIC_MASTER_READY_GPIO
		int  "the gpio used to nodify 4G module, bk7258 ready to send data"
		depends on BK_MODEM
		default 255
		range 0 100
		
	config UART_NIC_SLAVE_READY_GPIO
		int  "the gpio used to nodify BK7258, 4G module ready to send data"
		depends on BK_MODEM
		default 255
		range 0 100
		
endmenu
```

## ap/components/bk_network_transfer/Kconfig
```kconfig
# KCONFIG_GROUP: Network Services::Transfer
menu "Bk Network Transfer"

	config BK_NTWK_TRANSFER
		bool "Enable BK Network Transfer"
		default y
		help
			Enable BK Network Transfer

	config MEDIA_DROP_STRATEGY_ENABLE
		bool "Enable Media Drop Strategy"
		default y
		help
			Enable media drop strategy

	config NTWK_VIDEO_FPS_CALC_ENABLE
		bool "Enable Network Video FPS Calculation"
		default y
		help
			Enable the common video transfer FPS calculation strategy.

	config NTWK_H264_DROP_POLICY
		bool "Enable Network H264 Backpressure Drop Policy"
		depends on BK_NTWK_TRANSFER
		default y
		help
			Enable H264 encoded frame dropping when the encoded-frame free queue is low.

	config NTWK_CS2_CONGESTION_DROP
		bool "Enable CS2 backlog-triggered per-session drop + force IDR"
		depends on BK_NTWK_TRANSFER
		depends on CS2_P2P_SERVER || CS2_P2P_CLIENT
		default n
		help
			CS2 backlog-triggered drop policy.
			The policy checks each subscribed session's CS2 TX buffer before
			fanout:
			  - sessions with room receive the current packet;
			  - congested sessions skip the whole frame, enter waiting_key,
			    and resume only on a keyframe after backlog drains;
			  - audio packets are skipped per session when the audio backlog
			    exceeds its threshold.
			If all subscribed sessions are congested, the encoder-output side
			can drop the whole H264 frame before it enters the ready queue.
			Recovery uses one shared force-IDR arbiter with gap/streak limits.

	config NTWK_CS2_DROP_START_THD
		int "CS2 congestion drop START watermark (bytes)"
		depends on NTWK_CS2_CONGESTION_DROP
		default 131072
		help
			Start dropping when the worst session video backlog reaches this
			high watermark. Suggested around CONFIG_CS2_TX_BUFFER_THD/2.

	config NTWK_CS2_DROP_STOP_THD
		int "CS2 congestion drop STOP watermark (bytes)"
		depends on NTWK_CS2_CONGESTION_DROP
		default 65536
		help
			Stop dropping and request a force IDR when the backlog drains to
			this low watermark. Must be lower than START to give hysteresis and
			leave room for one large I frame.

	config NTWK_CS2_HEALTHY_FRAMES
		int "CS2 congestion healthy frame count to reset force-IDR streak"
		depends on NTWK_CS2_CONGESTION_DROP
		default 25

	config NTWK_CS2_FORCE_IDR_MIN_GAP_MS
		int "CS2 congestion force IDR minimum interval (ms)"
		depends on NTWK_CS2_CONGESTION_DROP
		default 500

	config NTWK_CS2_FORCE_IDR_MAX_STREAK
		int "CS2 congestion force IDR max consecutive count"
		depends on NTWK_CS2_CONGESTION_DROP
		default 3
		help
			After this many consecutive forced IDRs without a healthy period,
			stop forcing IDR (persistently slow, T2) and fall back to natural
			keyframe recovery / business-layer degrade.

	config DATA_NODE_SIZE
		int "Video RX Node Size"
		default 1472
		help
			Video receive node size in bytes

	config DATA_POOL_LEN
		int "Video Pool Length"
		default 51520
		help
			Video pool length in bytes (default: 1472 * 35 = 51520)

	config NTWK_UNFRAGMENT_FRAME_SIZE
		int "Video RX unfragment frame buffer size"
		depends on BK_NTWK_TRANSFER
		default 102400
		help
			Buffer size in bytes allocated to reassemble one complete
			received video frame (default: 100 * 1024 = 102400).
			Independent of codec type (JPEG/H264/etc). Projects can
			override this via menuconfig or defconfig.

	config NTWK_USE_PSARM_MEM
		bool "Use PSRAM for Network Transfer Memory Allocation"
		depends on PSRAM
		default n
		help
			Use PSRAM for memory allocation in network transfer component

	config NTWK_CLIENT_SERVICE_ENABLE
		bool "Enable Network Client Service"
		default n
		help
			Enable network client service

	config NTWK_CTRL_CHAN_JSON
		bool "Enable control channel JSON framing"
		depends on BK_NTWK_TRANSFER
		default n
		help
			Frame control-channel JSON methods in the common network transfer layer.
			When enabled, one application JSON method can be split across multiple
			transport packets and is reassembled before the application callback.
			When disabled, the existing control-channel pack/unpack path is used.

	config NTWK_CTRL_JSON_RX_MAX_SIZE
		int "Control channel max JSON method size"
		depends on NTWK_CTRL_CHAN_JSON
		default 8192
		help
			Maximum complete JSON method size accepted by the common JSON
			reassembly layer.

	config NTWK_PKT_USE_PSARM_MEM
		bool "Use PSRAM for Network Transfer Packet Memory Allocation"
		depends on PSRAM
		default y
		help
			Use PSRAM for packet memory allocation in network transfer component

	config KVS_NTWK_BRIDGE
		bool "Bridge KVS WebRTC to bk_network_transfer (cmd=data channel, A/V=RTP)"
		depends on BK_NTWK_TRANSFER
		depends on KVS_AWS
		depends on KVS_AWS_DATA_CHANNEL
		default n
		help
			Maps SampleStreamingSession to ntwk_trans_* (passthrough payloads).
			Enables hooks in projects/kvs_aws_sample/ap/Common.c.

endmenu
```

## ap/components/bk_peripheral/Kconfig
```kconfig
# KCONFIG_GROUP: Device Drivers::Board Devices
menu "bk peripheral"

	config BK_PERIPHERAL
		bool "Enable bk peripheral"
		default n

	source "${ARMINO_AP_DIR}/components/bk_peripheral/src/lcd/rgb/Kconfig"
	source "${ARMINO_AP_DIR}/components/bk_peripheral/src/lcd/qspi/Kconfig"
	source "${ARMINO_AP_DIR}/components/bk_peripheral/src/lcd/spi/Kconfig"
	source "${ARMINO_AP_DIR}/components/bk_peripheral/src/lcd/dsi/Kconfig"
	source "${ARMINO_AP_DIR}/components/bk_peripheral/src/dvp/Kconfig"
	source "${ARMINO_AP_DIR}/components/bk_peripheral/src/tp/Kconfig"
	source "${ARMINO_AP_DIR}/components/bk_peripheral/src/csi/Kconfig"
endmenu
```

## ap/components/bk_peripheral/src/csi/Kconfig
```kconfig
# KCONFIG_GROUP: Multimedia::Camera
menu "CSI Camera"
    config CSI_CAMERA
        depends on BK_CAMERA
        bool "Enable csi camera"
        default n

    config CSI_F58
        depends on CSI_CAMERA
        bool "Enable CSI_F58"
        default n

    config CSI_GC2053
        depends on CSI_CAMERA
        bool "Enable CSI_GC2053"
        default n

    config CSI_CV2005
        depends on CSI_CAMERA
        bool "Enable CSI_CV2005"
        default n

    config CSI_GC4653
        depends on CSI_CAMERA
        bool "Enable CSI_GC4653"
        default n

    config CSI_OV2775
        depends on CSI_CAMERA
        bool "Enable CSI_OV2775"
        default n

    config CSI_SC4336
        depends on CSI_CAMERA
        bool "Enable CSI_SC4336"
        default n

    config CSI_SC3336
        depends on CSI_CAMERA
        bool "Enable CSI_SC3336"
        default n

endmenu
```

## ap/components/bk_peripheral/src/dvp/Kconfig
```kconfig
menu "DVP Camera"
    config DVP_CAMERA
        depends on BK_CAMERA
        bool "use dvp camera"
        default n

    config DVP_GC0308
        depends on DVP_CAMERA
        bool "Enable DVP_GC0308"
        default n

    config DVP_GC0328C
        depends on DVP_CAMERA
        bool "Enable DVP_GC0328C"
        default n

    config DVP_GC2053
        depends on DVP_CAMERA
        bool "Enable DVP_GC2053"
        default n

    config DVP_GC2145
        depends on DVP_CAMERA
        bool "Enable DVP_GC2145"
        default n

    config DVP_HM1055
        depends on DVP_CAMERA
        bool "Enable DVP_HM1055"
        default n

    config DVP_SC101
        depends on DVP_CAMERA
        bool "Enable DVP_SC101"
        default n

    config DVP_OV2640
        depends on DVP_CAMERA
        bool "Enable DVP_OV2640"
        default n
endmenu
```
