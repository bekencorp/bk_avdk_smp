## ap/components/coredump/Kconfig
```kconfig
# KCONFIG_GROUP: Debug::Coredump
menu "Coredump"
	config CM_BACKTRACE
		bool "Enable Cm Backtrace"
		default n

	config DUMP_ENABLE
			bool "Enable Dump Feature"
			default n
			help
				Dump all memory when exception happen

	config MEMDUMP_ALL
			bool "Enable Memdump All"
			default DEBUG_VERSION
			help
				Dump all memory when exception happen.
				Build-version driven: a Debug build dumps the full memory set,
				a Release build dumps only the minimal set. The full-vs-minimal
				selection also honors CONFIG_DEBUG_VERSION at compile time (see
				memdump_strategies/), so the developer environment gets full
				dumps even under BUILD_DEFAULT_VERSION while the released SDK
				(CONFIG_RELEASE_VERSION) stays minimal.

	config AP_HANDOFF_CP_REBOOT_BUDGET_MS
			int "AP wait budget for CP reboot after dump handoff (ms)"
			depends on DEBUG_VERSION || DUMP_ENABLE
			range 500 7500
			default 6000
			help
				After the AP hands its trap dump to the CP, it waits this long
				for the CP to dump AP memory and reset the board. If the CP does
				not reset within the budget the AP self-dumps its own memory and
				resets (P0-1 fallback). Board-tuned (FI-2): must exceed the
				worst-case healthy CP dump time yet stay below the AON-WDT period
				(8000ms) so the fallback runs before the AON-WDT fires.

	config CP_HANG_DUMP_BY_AP
			bool "Enable AP-side CP hang dump feature"
			depends on IPI
			default y
			help
				Production reliability feature. Intentionally independent of
				DUMP_ENABLE so it stays ON in a Release build (DUMP_ENABLE=n):
				the cross-core hang watchdog only uses the always-compiled
				coredump writer primitives (bk_coredump_uart/manifest), not the
				DUMP_ENABLE-gated self-exception dump path.
				CP sends a private IPI heartbeat to AP. If AP observes CP
				heartbeat timeout, AP dumps CP-visible context (from the
				unified manifest) and reboots the board without relying on the
				CP - covering the "CP wedged and not answering mailbox" case
				that the AP->CP handoff fallback (P0-1) cannot self-heal.

	config CP_HANG_DUMP_BY_AP_PERIOD_MS
			int "CP to AP debug heartbeat period(ms)"
			depends on CP_HANG_DUMP_BY_AP
			default 1000

	config CP_HANG_DUMP_BY_AP_MEMDUMP
			bool "Dump CP memory windows after CP heartbeat timeout"
			depends on CP_HANG_DUMP_BY_AP
			default y
			help
				Keep disabled until the CP memory ranges are verified on
				the target board. Register/peripheral dump remains enabled.

	config DUMP_UART_PRINT_PORT
		int "Config DumpUart Print Port"
		range 0 5
		default 0
		help
			Default 0 mean use UART0

	choice DUMP_UART_MEM_ENCODING
		prompt "Config DumpUart Memory Encoding"
		default DUMP_UART_MEM_ENCODING_ASCII
		help
			Default ASCII format

		config DUMP_UART_MEM_ENCODING_ASCII
			bool "ASCII"
			help
				Dump memory in ASCII format
		config DUMP_UART_MEM_ENCODING_BASE64
			bool "Base64"
			help
				Dump memory in Base64 format
	endchoice

	choice DUMP_BY_UART
		prompt "Dump output method"
		default DUMP_BY_LOG_UART
		help
			Dump output method
		config DUMP_BY_LOG_UART
			bool "Log UART"
			help
				Dump to log UART
		config DUMP_BY_FLASH
			bool "Flash"
			help
				Dump to flash
	endchoice

	config TRAP_TEST
			bool "Enable trap test"
			default n
			help
				trap test
endmenu
```

## ap/components/demos/peripheral/touch/Kconfig
```kconfig
# KCONFIG_GROUP: Demos::Peripheral::Touch
menu "Demos::Peripheral::Touch"
	config TOUCH_TEST
		bool "Enable Touch Test"
		default n
		help
			Enable touch demos
endmenu
```

## ap/components/dhara/Kconfig
```kconfig
# KCONFIG_GROUP: Storage::File System
menu "Dhara NAND FTL"
	config DHARA_FTL
		bool "Enable Dhara NAND FTL (block device over QSPI SPI-NAND)"
		depends on QSPI_NAND_FLASH
		default n
		help
			Flash translation layer (Dhara) that turns the raw QSPI SPI-NAND
			(2KB page / 128KB erase block, on-die ECC) into a 512-byte logical
			sector block device with page-level mapping, wear levelling,
			power-fail-safe recovery and bad-block handling.
			This is the backing required to run FatFS on NAND (enable
			FATFS_QSPI_0_FLASH / FATFS_QSPI_1_FLASH; disk_io.c auto-routes the
			QSPI drive to this FTL when QSPI_NAND_FLASH is set) and to expose the
			NAND as a USB MSC removable disk to a PC (see
			USBD_MSC_STORAGE_QSPI_NAND).

	config NAND_FTL_START_BLOCK
		int "FTL partition start block"
		depends on DHARA_FTL
		default 0
		help
			Index of the first 128KB physical block owned by the FTL. Use a
			non-zero value to leave room for another consumer (e.g. littlefs)
			at the start of the device. Must not overlap any other NAND user.

	config NAND_FTL_BLOCK_COUNT
		int "FTL partition block count (0 = to end of device)"
		depends on DHARA_FTL
		default 0
		help
			Number of 128KB blocks the FTL manages. 0 means from the start
			block to the end of the device. Larger partitions need more RAM
			for the bad-block cache and scale mount time.

	config NAND_FTL_GC_RATIO
		int "FTL garbage-collection ratio"
		depends on DHARA_FTL
		range 1 64
		default 8
		help
			Dhara garbage-collection aggressiveness: GC steps performed per
			real write. Higher values keep more free space (higher usable
			capacity) at the cost of slower, less predictable writes. Always
			use the same value for a given formatted device.
endmenu
```

## ap/components/embeded_gcov/Kconfig
```kconfig
# KCONFIG_GROUP: Debug::Coverage
menu "GCov"

	config GCOV
		bool "Enable GCOV"
		default n

endmenu
```

## ap/components/fatfs/Kconfig
```kconfig
# KCONFIG_GROUP: Storage::File System
menu "FATFS"
	config FATFS
		bool "Support FATFS"
		depends on FATFS_SDCARD || FATFS_SPI_0_FLASH || FATFS_SPI_1_FLASH || FATFS_QSPI_0_FLASH || FATFS_QSPI_1_FLASH
		default n

	config FATFS_SDCARD
		bool "Support FATFS with SDCARD"
		depends on SDCARD
		default n
		help
			BEKEN Chip sets SDIO as a master device, the slave device is a SDCARD/SD-NAND.
			The SDCARD/SD-NAND memory device is mounted with FATFS.
			The application can read/writes data to SDCARD/SD-NAND by FATFS file system API, or the upper layer of VFS posix API.

	config FATFS_INTERNAL_FLASH
		bool "Support FATFS with INTERNAL FLASH"
		default n
		help
			BEKEN Chip internal flash set the user's partition, which is mounted with FATFS.
			The application can read/writes data to user partition by FATFS file system API, or the upper layer of VFS posix API.
			Because the internal flash stores CPU instructions and data, it is not recommended to write data to it frequently.

	config FATFS_SPI_0_FLASH
		bool "Support FATFS with SPI-0 FLASH"
		depends on SPI_MST_FLASH
		default n
		help
			BEKEN Chip sets SPI-0 as master device, the slave device is a flash.
			The flash device is mounted with FATFS.
			The application can read/writes data to flash by FATFS file system API, or the upper layer of VFS posix API.

	config FATFS_SPI_1_FLASH
		bool "Support FATFS with SPI-1 FLASH"
		depends on SPI_MST_FLASH
		default n
		help
			BEKEN Chip sets SPI-1 as master device, the slave device is a flash.
			The flash memory device is mounted with FATFS.
			The application can read/writes data to flash by FATFS file system API, or the upper layer of VFS posix API.

	config FATFS_QSPI_0_FLASH
		bool "Support FATFS with QSPI-0 FLASH/NAND"
		depends on QSPI_NOR_FLASH || QSPI_NAND_FLASH
		default n
		help
			BEKEN Chip sets QSPI-0 as master device, the slave device is a flash.
			The flash device is mounted with FATFS.
			When the QSPI device is SPI-NAND (QSPI_NAND_FLASH), this drive is
			served through the Dhara FTL (see CONFIG_DHARA_FTL): 512B logical
			sectors with wear levelling, power-fail-safe mapping and bad-block
			handling, so FAT can be used safely on NAND and exported to a PC over
			USB MSC. With NOR (QSPI_NOR_FLASH) it uses the linear NOR path.
			The application can read/writes data to flash by FATFS file system API, or the upper layer of VFS posix API.

	config FATFS_QSPI_1_FLASH
		bool "Support FATFS with QSPI-1 FLASH/NAND"
		depends on QSPI_NOR_FLASH || QSPI_NAND_FLASH
		default n
		help
			BEKEN Chip sets QSPI-1 as master device, the slave device is a flash.
			The flash device is mounted with FATFS.
			When the QSPI device is SPI-NAND (QSPI_NAND_FLASH), this drive is
			served through the Dhara FTL (see CONFIG_DHARA_FTL); with NOR it uses
			the linear NOR path.
			The application can read/writes data to flash by FATFS file system API, or the upper layer of VFS posix API.
endmenu
```

## ap/components/json/Kconfig
```kconfig
# KCONFIG_GROUP: System Services::Utilities & Libraries
menu "json"
	config CJSON_USE
		bool "Enable CJSON"
		default n
endmenu
```

## ap/components/key/Kconfig
```kconfig
# KCONFIG_GROUP: Device Drivers::Keys & Buttons
config BUTTON
	bool "Enable Button"
	default n
```

## ap/components/lvgl/Kconfig
```kconfig
# KCONFIG_GROUP: Multimedia::Display & UI::LVGL
menu "LVGL"
    config LVGL
        bool "Enable Lvgl"
        default n

    choice LVGL_VERSION
        depends on LVGL
        prompt "Select LVGL Version"
        default LVGL_V8

        config LVGL_V8
            bool "LVGL V8"
        config LVGL_V9
            bool "LVGL V9"
    endchoice

    config LV_USE_PERF_MONITOR
        bool "Enable Lv Use Perf Monitor"
        default n
        help
            Show CPU usage and FPS count

    config LV_COLOR_16_SWAP
        depends on LVGL
        bool "Enable Swap the 2 bytes of RGB565 color"
        default n

    config LVGL_MEM_USE_PSRAM
        depends on LVGL
        bool "Use PSRAM for LVGL internal memory allocation"
        default n
        help
            Use PSRAM for LVGL's lv_malloc/lv_realloc/lv_free backend.
            The default is HSRAM for better latency.

    config LVGL_USE_KEYPAD
        depends on LVGL
        bool "Enable LVGL keypad input device"
        default n
        help
            Enable the generic LVGL keypad input device. Board-specific keypad
            drivers should translate hardware key events to LV_KEY_* values and
            submit them through lv_vendor_keypad_send_key*().

    config LV_IMG_UTILITY_CUSTOMIZE
        depends on LVGL && VFS
        bool "Enable custom image load utility for JPEG/PNG"
        default n

    config LVGL_TASK_PRIORITY
        depends on LVGL
        int "Set lvgl task priority"
        default 4

    config LVGL_TASK_STACK_SIZE
        depends on LVGL
        int "Set lvgl task stack size"
        default 8192
        help
            If LV_USE_DRAW_VG_LITE is enabled, the stack size require a larger size.

    config LVGL_TASK_SLEEP_TIME_CUSTOMIZE
        depends on LVGL
        bool "Enable lvgl task sleep time custimize"
        default n

    config LVGL_TASK_SLEEP_TIME
        depends on LVGL_TASK_SLEEP_TIME_CUSTOMIZE
        int "Set lvgl task sleep time"
        default 10

    config LVGL_FRAME_BUFFER_NUM
        depends on LVGL
        int "Set the display frame buffer number"
        default 2

    config LVGL_USE_GPU_ROTATE
        depends on LVGL
        bool "Enable LVGL Use GPU Rotate"
        default n
endmenu
```

## ap/components/media_service/Kconfig
```kconfig
# KCONFIG_GROUP: Multimedia::Media Service
config MEDIA_SERVICE
	bool "Enable Media Service"
	default n
```

## ap/components/media_service/h264d_fbpool/Kconfig
```kconfig
# KCONFIG_GROUP: Multimedia::Video Codec

config H264D_FBPOOL
	bool "Enable vcdec H.264 zero-copy frame pool (h264d_fbpool)"
	default n
	help
	  Standalone frame-buffer pool injected into the vcdec H.264 decoder
	  (frame mode) to provide zero-copy decode/reference/display buffers and
	  per-reference colocated MV regions required by B-frame direct mode.
```

## ap/components/ota/Kconfig
```kconfig
# KCONFIG_GROUP: System Services::Firmware Update
menu "Ota"
	config OTA_FUNCTION
		bool "Enable do ota function"
		default n
		help
			enable do ota function

	config HTTP_AB_PARTITION
		bool "Enable Http AB Partition"
		default n
		help
			enable http update ab partition
	config OTA_HTTP
		depends on HTTP
		bool "Enable Ota Http"
		default y if NO_HOSTED
		default n if !NO_HOSTED
		help
			Enable HTTP OTA. Requires CONFIG_HTTP (which itself requires LWIP_V2_1),
			because the implementation calls httpclient_common() from utils_httpc.c.
	config OTA_HTTPS
		depends on LWIP
		bool "Enable Https ota"
		default n
		help
			enable https ota
	config OTA_HASH_FUNCTION
		bool "Enable ota hash function"
		default n
		help
			enable ota hash function
	config OTA_DEBUG_LOG_OPEN
		bool "Enable ota debug log open"
		default n
		help
			enable ota debug log open
	config OTA_POSITION_INDEPENDENT_AB
		depends on HTTP_AB_PARTITION
		bool "Enable ota position independent update"
		default n
		help
			enable ota position independent update
	config BLE_OTA_WAIT_TIMEOUT
		int "ble ota wait time(ms)"
		default 3000

	config OTA_DISPLAY_PICTURE_DEMO
		bool "Enable display picture when do ota position independent update"
		default n
		help
			enable display picture when do ota position independent update
	config SECURE_OTA_XIP
		bool "Enable secure XIP A/B OTA on the non-secure OTA framework"
		default n
		help
			Secure OTA that stages the ciphertext image into the inactive
			DIRECT_XIP slot (secondary_all/primary_all) via non-secure flash
			writes and arms a boot_param TRIAL record; BL2 does EC-P256
			verification and rollback. Built on top of ota.c/ota_common.c/
			ota_base_drv.c, and does NOT use CONFIG_SECURITY_OTA / TFM FWU.
	config SECURE_OTA_OVERWRITE
		bool "Enable compressed-overwrite OTA on the non-secure OTA framework"
		default n
		help
			Secure OTA for the OVERWRITE_ONLY strategy (secureboot_overwrite):
			stages the compressed + BL2-signed image into the `ota` staging
			partition via non-secure flash writes and arms the OVERWRITE_CONFIRM
			magic in `ota_control`; on the next reset BL2 decompresses `ota`
			into `primary_all` and does EC-P256 verification. Built on top of
			ota.c/ota_common.c/ota_base_drv.c, and does NOT use
			CONFIG_SECURITY_OTA / TFM FWU. Mutually exclusive with
			CONFIG_SECURE_OTA_XIP.
endmenu
```

## ap/components/psa_mbedtls/Kconfig
```kconfig
menu "PSA Mbedtls"
	config PSA_MBEDTLS
		bool "Enable psa mbedtls v3.6.6"
		default n
		help
			enable psa mbedtls v3.6.6

	menu "PSA Mbedtls Options"
		depends on PSA_MBEDTLS

		config PSA_MBEDTLS_TEST
			bool "Enable psa interface test"
			default n
			help
				control PSA interface cli testing code

		config MBEDTLS_SSL_IN_CONTENT_LEN
			int "Config MBEDTLS_SSL_IN_CONTENT_LEN"
			default 4096

		config MBEDTLS_SSL_OUT_CONTENT_LEN
			int "Config MBEDTLS_SSL_OUT_CONTENT_LEN"
			default 4096

		config TRUSTENGINE
			bool "Enable TrustEngine hardware crypto"
			help
				Enable TrustEngine hardware acceleration for mbedtls.
				Mutually exclusive with SW_CRYPTO.

		config SW_CRYPTO
			bool "Enable software crypto"
			default y
			depends on !TRUSTENGINE
			help
				Pure software mbedtls crypto implementation.
				Cannot be enabled together with TRUSTENGINE.

		config TE200_ENTROPY
			bool "Enable TE200 entropy"
			depends on TRUSTENGINE
			default n

		config TRUSTENGINE_TEST
			bool "Enable psa mbedtls cli test"
			depends on PSA_MBEDTLS
			default n
			help
				control mbedtls cli testing code

		config MBEDTLS_USE_PSA_CRYPTO
			bool "Enable use PSA crypto"
			default n
			help
				tls use PSA interface to implement encryption

		config FULL_MBEDTLS
			bool "Enable Full Mbedtls"
			default n
			help
				mbedtls support more algorithms(enabled in xxx_config.h)

		config MBEDTLS_LOG_LEVEL
			string "Set Mbedtls Log Level"
			default "INFO"
			help
				Set mbedtls log level: OFF/ERROR/WARNING/INFO/DEBUG
	endmenu

	config MBEDTLS_USE_PSRAM
		bool "Enable use PSRAM"
		default n
		help
			mbedtls use PSRAM to allocate memory

	config MBEDTLS_CUSTOM_CONFIG_FILE
		bool "Enable custom mbedtls config file"
		default n
		help
			Enable custom mbedtls configuration file support.

endmenu
```
