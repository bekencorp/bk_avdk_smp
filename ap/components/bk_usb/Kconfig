## ap/components/bk_usb/Kconfig
```kconfig
menu "Bk_usb"

	config USB
		bool "Enable Usb"
		default n

	config USB_VBAT_CONTROL_GPIO_ID
		depends on USB
		hex "Vbat control gpio id"
		default 0xFF
		help
			USB VBAT CONTROL GPIO ID

	menu "Modify Usb Config"
		depends on USB

		config USB_HOST
			bool "Enable USB Host Mode"
			default y
	
		config USB_DEVICE
			bool "Enable USB Device Mode"
			default n

		config TASK_USB_PRIO
			int "Set Task Usb Prio"
			range 1 10
			default 7
			help
				Priority of USB task

		config USB_DMA_ENABLE
			bool "Enable usb ip DMA"
			default n

		config USB_HUB
			depends on USB_HOST
			bool "Enable USB hub"
			default y

		menu "USB_HUB_MULTIPLE_DEVICES_IDENTIFICATION"
			depends on USB_HUB
				config USB_HUB_MULTIPLE_DEVICES
					bool "Enable MULTIPLE DEVICE IDENTIFICATION by hub"
					default n
					help
						Enable MULTIPLE DEVICE IDENTIFICATION by hub
						
				config USB_HUB_MULTIPLE_DEVICES_DEBUG
					bool "Enable MULTIPLE DEVICE IDENTIFICATION by hub"
					default n
					help
						Enable MULTIPLE DEVICE IDENTIFICATION debug
						
				config USBHOST_HUB_MAX_EHPORTS
					int "Set hub port number"
					range 1 10
					default 4
					help
						HUB MAX EHPORTS

				config USBHOST_HUB_PORT_SUPPORT_MAX_DEVICE
					int "SUPPORT_MAX_DEVICE"
					range 1 10
					default 3
					help
						SUPPORT_MAX_DEVICE

				config USBHOST_HUB_PORT_1_VBAT_CONTROL_GPIO_ID
					hex "Vbat control gpio id"
					default 0xFF
					help
					USB usb hub port index Vbus control gpio_id
		endmenu

		config USBH_MSC
			bool "Enable Usb Host MSC"
			depends on FATFS
			default n

		config USBD_MSC
			bool "Enable Usb Device MSC"
			default n

		config USBD_MSC_CBW_DEBUG_LOG
			bool "Enable per-CBW bulk-OUT debug log (BK7259 bring-up)"
			depends on USBD_MSC
			default n
			help
				When enabled, mass_storage_bulk_out() prints a one-shot
				"[msc_cbw #N] ep=... SCSI op=..." line for the first 30
				CBWs it receives. Useful for bringing up a new host /
				re-enumerating SD-NAND as USB MSC, but very chatty under
				normal traffic (a Windows host fires READ_CAPACITY10 /
				READ10 hundreds of times per second). Keep disabled in
				production builds; the print runs from the bulk-OUT IRQ
				context and can starve other USB / IPC traffic if the
				UART TX FIFO backs up.

		config USBD_IRQ_DEBUG_LOG
			bool "Enable per-IRQ MUSB state debug log (BK7259 bring-up)"
			depends on USB_DEVICE
			default n
			help
				When enabled, USBD_IRQHandler() prints a verbose
				"[usbd_irq #N] IS=... TX=... RX=... LPM=... POWER=...
				DEVCTL=... FADDR=... RESET/SOF/RESUME/SUSPEND" line for
				the first USBD_IRQ_DEBUG_PRINT_COUNT interrupts (default
				8 in usb_dc_beken_musb_mhdrc.c). Useful for catching
				enumeration glitches (RESET -> SETADDR -> GET_DESCRIPTOR
				-> SET_CONFIG) on a new board without external tools.

				Disabled by default because the call sits inside the
				USBD IRQ; once SCSI traffic starts every block read is
				an IRQ on each EP, and even an USB_LOG_DBG that flushes
				through the UART TX FIFO can stretch the ISR enough to
				starve the CP heartbeat (see the bring-up notes above
				the call site). The g_usbd_irq_count / g_usbd_last_
				intrusb counters are always kept so the user-space
				watchdog can still snapshot state from outside the ISR.

		config USBH_UVC
			bool "Enable Usb Host Uvc"
			default n

		config USB_RISCV_BRIDGE
			depends on USB_HOST
			depends on IPI
			bool "Enable RISC-V USB bridge"
			default y
			help
				Enable the RISC-V USB bridge path. USB interrupt handling runs on
				RISC-V and events are reported back to AP through shared memory + IPI.

		config USB_RISCV_LOG_UART
			depends on USB_RISCV_BRIDGE
			bool "Enable RISC-V USB bridge UART init"
			default n
			help
				Initialize the AP-side UART used by RISC-V USB firmware logs.
		
		config USBD_UVC
			bool "Enable Usb Device Uvc"
			default n

		config USBH_UAC
			bool "Enable Usb Host Uac"
			default n

		config USBD_UAC
			bool "Enable Usb Device Uac"
			default n

		config USBH_HID
			bool "Enable Usb Hid"
			default n

		config USBD_HID
			bool "Enable Usb Hid"
			default n

        config USB_UPC
            bool "Enable Usb Upc"
            default n

		config USB_CDC
			bool "Enable Usb Cdc"
			default n

		config USB_CHARGE
			bool "Enable Usb Charge"
			default n

		config USBH_SERIAL_CH340
			bool "Enable Usbh simulate serial ch340"
			default n
		config USBH_SERIAL_CH340_TEST
			bool "Enable Usbh simulate serial ch340"
			default n
	endmenu

    config STANDARD_DUALSTREAM
        bool "Standard dual stream"
        default n
    
    config UVC_DUAL_DEVICE
        #depends on STANDARD_DUALSTREAM
        int "the num for uvc_device"
        range 1 2
        default 1 if !STANDARD_DUALSTREAM
        default 2 if STANDARD_DUALSTREAM

    config USB_CDC_MODEM
        bool "Enable device usb cdc for 4G module"
        help
            This macro needs to be opened on cp0 and cp1 when USB in cp1.
        default n

    config USBHOST_MAX_CDC_ACM_CLASS
    	depends on USB_CDC
        int "the num for CDC"
        default 1

endmenu
```

## ap/components/bk_uvc/Kconfig
```kconfig
# KCONFIG_GROUP: Multimedia::UVC
menu "USB Camera"

	config USB_CAMERA
		depends on USBH_UVC
		bool "Enable USB Camera"
		default n
		help
			Enable USB Camera

	config UVC_URB_NUM
		depends on USB_CAMERA
		int "UVC URB count"
		default 8
		help
			URB number advice large than camera_num * 4

	config UVC_NUM_PACKET_PER_URB
		depends on USB_CAMERA
		int "The packets per urb contain"
		default 8
		help
			because high speed 125us generate a packet

	config UVC_PROCESS_TASK_STACK_SIZE
		depends on USB_CAMERA
		int "UVC process task stack size"
		default 1024
		help
			UVC process task stack size in bytes. If set to 0, will use default value 1024.

	config UVC_STREAM_TASK_STACK_SIZE
		depends on USB_CAMERA
		int "UVC stream task stack size"
		default 1536
		help
			UVC stream task stack size in bytes. If set to 0, will use default value 1536.

	config UVC_FRAME_SIZE
		depends on USB_CAMERA
		int "UVC Stream output a complete frame size, unit: byte, for all format<mjpeg, h264, h265>"
		default 102400
		help
			UVC Stream output a complete frame size in bytes. If set to 0, will use default value 102400.

	config UVC_DEBUG_TIMER_ENABLE
		depends on USB_CAMERA
		bool "Enable UVC debug time"
		default n
		help
			Enable UVC debug time. If set to y, will print the UVC debug time.

	config UVC_USE_PSRAM_ALLOC
		depends on USB_CAMERA && PSRAM_AS_SYS_MEMORY
		bool "Use PSRAM Heap to allocate for UVC"
		default n
		help
			Use PSRAM Heap to allocate for UVC.
endmenu
```

## ap/components/bk_video_player/Kconfig
```kconfig
# KCONFIG_GROUP: Multimedia::Video Player
menu "Bk_video_player"

    config AVI_PLAYER
        bool "Enable AVI Player"
        default n

    if AVI_PLAYER

    config BK_VIDEO_PLAYER_ENABLE_AVI_PARSER
        bool "Enable AVI container parser"
        default y

    config BK_VIDEO_PLAYER_ENABLE_MP4_PARSER
        bool "Enable MP4 container parser"
        default y
    
    config BK_VIDEO_PLAYER_ENABLE_HW_JPEG_VIDEO_DECODER
        bool "Enable HW JPEG video decoder"
        default y
    config BK_VIDEO_PLAYER_ENABLE_HW_H264_VIDEO_DECODER
        bool "Enable HW H264 video decoder"
        default n
        help
            Enable the hardware H264 video decoder for bk_video_player.
            Requires CONFIG_BK_DECODER and BK7259-class SoC. The decoder
            wraps bk_h264_decode_ctlr (frame mode) and outputs NV12 with
            optional CPU conversion to YUYV/RGB565/RGB888.

    config BK_VIDEO_PLAYER_ENABLE_AAC_AUDIO_DECODER
        bool "Enable AAC software audio decoder"
        default n
        help
            Enable the Helix-based AAC software audio decoder for bk_video_player.
            Required to play the audio stream of typical MP4 (mp4a) files such
            as those produced by ffmpeg with the AAC encoder. Decoded output is
            16-bit PCM, interleaved when stereo. Pulls in the aacdec library
            from properties/modules/audio_codec/aacdec.

    endif # AVI_PLAYER

    config AVI_PLAYER_MAX_JPEG_FRAME_LEN
        depends on AVI_PLAYER
        int "Set AVI Player max jpeg frame length"
        default 102400

    config BK_VIDEO_PLAYER_VIDEO_PARSE_THREAD_PRIORITY
        int "video parse thread priority (vp_video_parse)"
        default 6

    config BK_VIDEO_PLAYER_VIDEO_PARSE_THREAD_STACK_SIZE
        int "video parse thread stack size (bytes)"
        default 2048

    config BK_VIDEO_PLAYER_AUDIO_PARSE_THREAD_PRIORITY
        int "audio parse thread priority (vp_audio_parse)"
        default 6

    config BK_VIDEO_PLAYER_AUDIO_PARSE_THREAD_STACK_SIZE
        int "audio parse thread stack size (bytes)"
        default 2048

    config BK_VIDEO_PLAYER_AUDIO_DECODE_THREAD_PRIORITY
        int "audio decode thread priority (audio_decode)"
        default 6

    config BK_VIDEO_PLAYER_AUDIO_DECODE_THREAD_STACK_SIZE
        int "audio decode thread stack size (bytes)"
        default 2048

    config BK_VIDEO_PLAYER_VIDEO_DECODE_THREAD_PRIORITY
        int "video decode thread priority (video_decode)"
        default 6

    config BK_VIDEO_PLAYER_VIDEO_DECODE_THREAD_STACK_SIZE
        int "video decode thread stack size (bytes)"
        default 2048

    config BK_VIDEO_PLAYER_EVENT_THREAD_PRIORITY
        int "event notify thread priority (vp_evt)"
        default 6

    config BK_VIDEO_PLAYER_EVENT_THREAD_STACK_SIZE
        int "event notify thread stack size (bytes)"
        default 4096
endmenu
```

## ap/components/bk_vpu/bk_decoder/Kconfig
```kconfig
menu "BEKEN CODEC DECODER"

	config BK_DECODER
		bool "Enable decoder (vcdec)"
		default n

	config BK_DECODER_TASK_PRIO
		depends on BK_DECODER
		int "BK_DECODER_TASK_PRIO"
		default 6

	config BK_DECODER_TASK_SIZE
		depends on BK_DECODER
		int "BK_DECODER_TASK_SIZE"
		default 4096
endmenu
```

## ap/components/bk_vpu/bk_encoder/Kconfig
```kconfig
# KCONFIG_GROUP: Multimedia::Video Codec::Encode
menu "BEKEN CODEC ENCODER"

	config BK_ENCODER
		bool "BEKEN CODEC ENCODER"
		default n
		help
			"BEKEN CODEC ENCODER for BK7259"

	config BK_ENCODER_H264_TASK_SIZE
		int "BK_ENCODER_H264_TASK_SIZE"
		default 10240
		
	config BK_ENCODER_MJPEG_TASK_SIZE
		int "BK_ENCODER_MJPEG_TASK_SIZE"
		default 10240

	config BK_ENCODER_H264_MAX_OUTPUT_BUFFER
		int "BK_ENCODER_H264_MAX_OUTPUT_BUFFER"
		default 512000
		depends on BK_ENCODER
		help
			"Maximum H.264 encoder output buffer size in bytes"

	config BK_ENCODER_MJPEG_MAX_OUTPUT_BUFFER
		int "BK_ENCODER_MJPEG_MAX_OUTPUT_BUFFER"
		default 262144
		depends on BK_ENCODER
		help
			"Maximum MJPEG/JPEG encoder output buffer size in bytes"

	config VIDEO_DTCM
		bool "Use DTCM video codec libraries"
		default n
		depends on BK_ENCODER
		help
			"Select DTCM prebuilt libraries for video codec helpers"

	config VIDEO_DTCM_ALL
		bool "Use full DTCM video codec libraries"
		default n
		depends on VIDEO_DTCM
		help
			"Select full DTCM prebuilt libraries instead of the partial DTCM variant"

	config H264_ENCODER_USE_OS_MALLOC
		bool "H264 Encoder Use OS Malloc"
		default n
		depends on BK_ENCODER
		help
			"Use OS malloc for encoder memory allocation instead of frame buffer"

	config H264E_STREAM_SESSION
		bool "H264E stream session (h264EScream RPC)"
		default n
		depends on BK_ENCODER
		depends on BK_NTWK_TRANSFER
		help
			"Enable H264E stream module. JSON-RPC control uses h264EScream.* methods; VIDEO channel sends H264 elementary stream."

	config ENCODER_H264_CLK_240M
		bool "H264 encoder clock 240MHz"
		default n
		depends on BK_ENCODER
		help
			"Select CKSEL_H264_240M (highest supported encoder frequency).
			When disabled, CKSEL_H264_80M is used."

	config BK_ENCODER_HW_TASK_PRIORITY
		int "Hardware encoder worker task priority (smaller = higher)"
		default 2
		range 0 9
		help
			"Priority of the shared hardware encoder worker task (hw_encoder),
			which runs vcenc_h264_encode_frame and the per-frame done callback.
			BEKEN convention: a SMALLER number means HIGHER scheduling priority.
			Default 2 matches the historical library value. Raising it (i.e.
			decreasing the number) above the network/WiFi tasks reduces the
			encode-start scheduling latency that can starve the ISP flexa FIFO."

	config BK_ENCODER_H264_FRAME_TASK_PRIORITY
		int "H.264 frame encode task priority (smaller = higher)"
		default 6
		range 0 9
		depends on BK_ENCODER
		help
			"Priority of the H.264 whole-frame control task (h264e_encoder,
			created in bk_h264_encode_frame_ctlr.c). BEKEN convention: a
			SMALLER number means HIGHER scheduling priority. Default 6 preserves
			the historical BEKEN_DEFAULT_WORKER_PRIORITY behavior."

	config BK_ENCODER_H264_HW_FLEXA_TASK_PRIORITY
		int "H.264 hardware-flexa encode task priority (smaller = higher)"
		default 2
		range 0 9
		depends on BK_ENCODER
		help
			"Priority of the H.264 HARDWARE-flexa control task (h264e_encoder,
			created in bk_h264_encode_hw_flexa_ctlr.c). This is distinct from the
			software-flexa path. BEKEN convention: a SMALLER number means HIGHER
			scheduling priority. Default 2 matches the historical library value."

	config BK_H264E_DEBUG_SEI
		bool "Insert debug SEI NAL into each H264 frame (transport diagnostics)"
		default n
		depends on BK_ENCODER
		help
			"Append a fixed user_data_unregistered SEI (payloadType=5) to every
			encoded H.264 frame carrying per-frame sequence/length/CRC32/timestamp
			so a receiver can detect frame loss, reorder, truncation and corruption
			without decoding. Disabled by default; enable only for debugging."

	config BK_H264E_DEBUG_SEI_CRC
		bool "Compute per-frame CRC32 in debug SEI (costly: scans whole frame)"
		default n
		depends on BK_H264E_DEBUG_SEI
		help
			"When enabled, the debug SEI carries a CRC32 over the whole encoded
			frame so a receiver can detect corruption. Computing it reads the
			entire frame from PSRAM byte by byte and is time-consuming (it eats
			into the encoder inter-frame slack). Disable to skip the scan and put
			payload_crc = 0 when only sequence/length diagnostics are needed."

endmenu
```

## ap/components/bk_vpu/legacy/bk_h264d/Kconfig
```kconfig
menu "BK_H264D"
	config BK_H264D
		bool "Enable BK_H264D"
		default n

	config BK_H264D_DEMO
		bool "Enable BK_H264D DEMO"
		depends on BK_H264D
		default n
endmenu
```

## ap/components/bk_vpu/legacy/bk_h264e/Kconfig
```kconfig
menu "BK_H264E"
	config BK_H264E
		bool "Enable BK_H264E"
		default n

	config BK_H264E_DEMO
		bool "Enable BK_H264E DEMO"
		depends on BK_H264E
		default n
endmenu
```

## ap/components/bk_websocket/Kconfig
```kconfig
# KCONFIG_GROUP: Network Services::WebSocket
menu "Bk_websocket"

	config WEBSOCKET
		bool "Enable Websocket"
		default n
	config WEBSOCKET_TLS
		depends on MBEDTLS || PSA_MBEDTLS
		bool "Enable Websocket"
		default n
	config WEBSOCKET_FULL_SIZE
		depends on WEBSOCKET
		bool "Enable Websocket Rx Max Size report"
		default n
	config WEBSOCKET_UPGRADE_MINIMAL_HEADERS
		depends on WEBSOCKET
		bool "Use minimal WebSocket upgrade headers"
		default n
		help
		  Sends only the RFC 6455 upgrade headers (GET/Host/
		  Authorization/Upgrade/Connection/Sec-WebSocket-Version/
		  Sec-WebSocket-Key) with a port-less Host. The default header
		  set additionally sends Origin and User-Agent and appends
		  the port to Host ("host:443"). Some server-side edge
		  proxies reject requests carrying an Origin header or a
		  ported Host with HTTP 401; enable this when the peer
		  requires the minimal form.
endmenu
```
