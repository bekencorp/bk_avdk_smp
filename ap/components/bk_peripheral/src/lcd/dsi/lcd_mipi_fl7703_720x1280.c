// Copyright 2020-2021 Beken
//
// Licensed under the Apache License, Version 2.0 (the "License");
// you may not use this file except in compliance with the License.
// You may obtain a copy of the License at
//
//     http://www.apache.org/licenses/LICENSE-2.0
//
// Unless required by applicable law or agreed to in writing, software
// distributed under the License is distributed on an "AS IS" BASIS,
// WITHOUT WARRANTIES OR CONDITIONS OF ANY KIND, either express or implied.

/**
 * @file lcd_mipi_fl7703_720x1280.c
 * @brief FL7703 MIPI DSI panel driver for the current 720x1280 panel.
 *
 * This panel requires its initialization table to be sent with MIPI Generic
 * packets. The custom init hook keeps that requirement local to this driver,
 * so other panels continue to use standard DCS packets.
 */

#include <components/bk_lcd_panel.h>
#include <driver/mipi_dsi.h>
#include <driver/mipi_dsi_types.h>
#include <common/avdk_pixel_types.h>
#include <os/os.h>

#if CONFIG_LCD_FL7703_MIPI_720x1280

static const lcd_mipi_init_cmd_t fl7703_mipi_720x1280_init_cmds[] = {
    {0xB9, (const uint8_t []){0xF1, 0x12, 0x87}, 3},
    {0xB2, (const uint8_t []){0x40, 0x03, 0x78}, 3},
    {0xB3, (const uint8_t []){0x10, 0x10, 0x28, 0x28, 0x03, 0xFF, 0x00, 0x00, 0x00, 0x00}, 10},
    {0xB4, (const uint8_t []){0x20}, 1},
    {0xB5, (const uint8_t []){0x08, 0x08}, 2},
    {0xB6, (const uint8_t []){0x51, 0x51}, 2},
    {0xB8, (const uint8_t []){0x26, 0x22, 0xF0, 0x13}, 4},
    {0xBA, (const uint8_t []){0x33, 0x81, 0x05, 0xF9, 0x0E, 0x0E, 0x20, 0x00, 0x00, 0x00, 0x00, 0x00, 0x00, 0x00,
                              0x44, 0x25, 0x00, 0x91, 0x0A, 0x00, 0x00, 0x01, 0x4F, 0x01, 0x00, 0x00, 0x37}, 27},
    {0xBC, (const uint8_t []){0x47}, 1},
    {0xBF, (const uint8_t []){0x02, 0x11, 0x00, 0x80, 0x04}, 5},
    {0xC0, (const uint8_t []){0x73, 0x73, 0x50, 0x50, 0x20, 0x00, 0x12, 0x73, 0x00}, 9},
    {0xC1, (const uint8_t []){0x85, 0x80, 0x32, 0x32, 0x77, 0xF4, 0xF7, 0xF7, 0xCC, 0xCC, 0x7F, 0x7F, 0x11, 0x11,
                              0x00, 0x00, 0x32}, 17},
    {0xC7, (const uint8_t []){0xB0, 0x00, 0x0A, 0x10, 0x01, 0x09, 0x00, 0x80, 0xED, 0xC7, 0x00, 0xA5}, 12},
    {0xC8, (const uint8_t []){0x10, 0x40, 0x1E, 0x03}, 4},
    {0xCC, (const uint8_t []){0x0B}, 1},
    {0xE0, (const uint8_t []){0x00, 0x07, 0x0D, 0x32, 0x32, 0x3F, 0x45, 0x3F, 0x08, 0x0C, 0x0E, 0x12, 0x14, 0x13,
                              0x14, 0x10, 0x15, 0x00, 0x07, 0x0D, 0x32, 0x32, 0x3F, 0x45, 0x3F, 0x08, 0x0C, 0x0E, 0x12,
                              0x14, 0x13, 0x14, 0x10, 0x15}, 34},
    {0xE1, (const uint8_t []){0x11, 0x11, 0x91, 0x00, 0x00, 0x00, 0x00}, 7},
    {0xE3, (const uint8_t []){0x07, 0x07, 0x0B, 0x0B, 0x0B, 0x0B, 0x00, 0x00, 0x00, 0x00, 0xFF, 0x84, 0xC0, 0x10}, 14},
    {0xE9, (const uint8_t []){0xC8, 0x10, 0x07, 0x05, 0x04, 0x80, 0x81, 0x12, 0x31, 0x23, 0x5F, 0x85, 0x80, 0xAE,
                              0x37, 0x08, 0x03, 0x00, 0x0D, 0x00, 0x00, 0x12, 0x03, 0x00, 0x0D, 0x00, 0x00, 0x12,
                              0x99, 0x45, 0xFB, 0xA8, 0x32, 0x10, 0x76, 0x54, 0x01, 0x88, 0x88, 0x99, 0x45, 0xFB,
                              0xA8, 0x32, 0x10, 0x76, 0x54, 0x01, 0x88, 0x88, 0x00, 0x00, 0x00, 0x01, 0x00, 0x00,
                              0x00, 0x00, 0x00, 0x00, 0x00, 0x00, 0x00}, 63},
    {0xEA, (const uint8_t []){0x97, 0x13, 0x01, 0x01, 0x07, 0x64, 0x00, 0x00, 0x00, 0x00, 0x00, 0x00, 0x9F, 0x10,
                              0x9B, 0xA8, 0x45, 0x67, 0x01, 0x23, 0x45, 0x88, 0x88, 0x9F, 0x10, 0x9B, 0xA8, 0x45,
                              0x67, 0x01, 0x23, 0x45, 0x88, 0x88, 0x23, 0x30, 0x00, 0x00, 0x96, 0x00, 0x00, 0x00,
                              0x00, 0x00, 0x00, 0x00, 0x00, 0x00, 0x00, 0x05, 0x05, 0x00, 0x00, 0x50, 0x80, 0x81,
                              0x50, 0x80, 0x81, 0x00}, 61},
    {0xEF, (const uint8_t []){0xFF, 0xFF, 0x01}, 3},
    {0x11, NULL, 0},
    {0x00, (const uint8_t []){250}, 0xFF},
    {0x29, NULL, 0},
    {0x00, (const uint8_t []){50}, 0xFF},
    {0x00, NULL, 0},
};

static const lcd_mipi_init_cmd_t fl7703_mipi_720x1280_off_cmds[] = {
    {0x28, NULL, 0},
    {0x00, (const uint8_t []){50}, 0xFF},
    {0x10, NULL, 0},
    {0x00, (const uint8_t []){120}, 0xFF},
    {0x00, NULL, 0},
};

static bk_err_t fl7703_mipi_720x1280_init(bk_avdk_lcd_panel_t *panel)
{
    uint8_t packet[64];
    (void)panel;

    for (uint32_t i = 0;
         fl7703_mipi_720x1280_init_cmds[i].cmd != 0 ||
         fl7703_mipi_720x1280_init_cmds[i].data != NULL;
         i++) {
        const lcd_mipi_init_cmd_t *entry = &fl7703_mipi_720x1280_init_cmds[i];

        if (entry->cmd == 0 && entry->data_len == 0xFF && entry->data != NULL) {
            rtos_delay_milliseconds(((const uint8_t *)entry->data)[0]);
            continue;
        }

        packet[0] = entry->cmd;
        if (entry->data_len > 0 && entry->data != NULL) {
            os_memcpy(&packet[1], entry->data, entry->data_len);
        }
        if (!mipi_dsi_gen_write((uint16_t)entry->data_len + 1, packet)) {
            return BK_FAIL;
        }
    }

    return BK_OK;
}

static const uint8_t fl7703_mipi_720x1280_read_id_regs[] = {0x04, 0};

const bk_display_dsi_panel_t lcd_device_fl7703_mipi_720x1280 = {
    .id = 0x38211F,
    .name = "fl7703_mipi_720x1280",
    .n_lanes = DSI_ACTIVE_LANES_4,
    .fps = 36,
    .timing = {
        .h_size = PIXEL_720,
        .v_size = PIXEL_1280,
        .hsync_pulse_width = 30,
        .vsync_pulse_width = 4,
        .hsync_back_porch = 40,
        .hsync_front_porch = 40,
        .vsync_back_porch = 16,
        .vsync_front_porch = 16,
    },
    .init_cmds = fl7703_mipi_720x1280_init_cmds,
    .off_cmds = fl7703_mipi_720x1280_off_cmds,
    .read_id_regs = fl7703_mipi_720x1280_read_id_regs,
    .read_id_bytes = 3,
    .reset_active_level = false,
    .reset = bk_lcd_mipi_default_reset,
    .init = fl7703_mipi_720x1280_init,
    .off = bk_lcd_mipi_default_off,
};

BK_LCD_PANEL_DEVICE_SECTION(lcd_device_fl7703_mipi_720x1280,
                            "fl7703_mipi_720x1280",
                            BK_LCD_PANEL_BUS_DSI);
#endif
