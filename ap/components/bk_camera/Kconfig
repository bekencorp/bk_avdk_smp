## ap/components/bk_camera/Kconfig
```kconfig
# KCONFIG_GROUP: Multimedia::Camera
menu "BK Camera"

	config BK_CAMERA
		bool "Enable bk camera"
		default n

	config ISP_CAM_STREAM_CHECK_FRAMES
		int "ISP open-time stream check frame count"
		range 0 24
		default 3
		depends on BK_CAMERA
		help
			Consecutive frames read after a frame-mode ISP channel opens,
			used to detect a stalled stream. 0 disables the check and lets
			the caller validate the first frame itself (AOV pops its own
			frame through BK_CAM_IOCTL_FRAME_POP).

	config ISP_CAM_STREAM_CHECK_RETRY
		int "ISP open-time stream check retry count"
		range 1 24
		default 24
		depends on BK_CAMERA
		help
			Channel close/reopen attempts when the stream check fails.
			Each attempt costs one check timeout, so a short-duty-cycle
			application can lower it to bound how long the AP stays awake.

	config ISP_FRAME_SESSION
		bool "ISP frame capture session (ispFrame RPC)"
		default n
		depends on BK_CAMERA
		depends on BK_NTWK_TRANSFER
		help
			Enable ISP frame module. JSON-RPC control matches H264E methods;
			VIDEO channel sends NV12/YUV image frames.

endmenu
```

## ap/components/bk_websocket/Kconfig
```kconfig
# KCONFIG_GROUP: Network Services::WebSocket
menu "Bk_websocket"

	config WEBSOCKET
		bool "Enable Websocket"
		default n
	config WEBSOCKET_TLS
		depends on MBEDTLS || PSA_MBEDTLS
		bool "Enable Websocket"
		default n
	config WEBSOCKET_FULL_SIZE
		depends on WEBSOCKET
		bool "Enable Websocket Rx Max Size report"
		default n
	config WEBSOCKET_UPGRADE_MINIMAL_HEADERS
		depends on WEBSOCKET
		bool "Use minimal WebSocket upgrade headers"
		default n
		help
                  Sends only the RFC 6455 upgrade headers (GET/Host/
                  Authorization/Upgrade/Connection/Sec-WebSocket-Version/
                  Sec-WebSocket-Key) with a port-less Host. The default header
                  set additionally sends Origin and User-Agent and appends
                  the port to Host ("host:443"). Some server-side edge
                  proxies reject requests carrying an Origin header or a
                  ported Host with HTTP 401; enable this when the peer
                  requires the minimal form.
        config WEBSOCKET_KEEP_CONN_ON_SEND_TIMEOUT
                depends on WEBSOCKET
                bool "Keep websocket connection on send poll timeout"
                default n
                help
                  Default (n): a send poll timeout is treated as fatal and
                  the connection is torn down (legacy behaviour, unchanged).
                  When enabled, a poll timeout (ws_write() returning 0, i.e.
                  transient TX congestion with the socket itself healthy)
                  only fails the send call; the caller decides whether to
                  retry or abort. Real socket errors still disconnect.
endmenu
```
