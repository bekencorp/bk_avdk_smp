## ap/components/adc_key/Kconfig
```kconfig
# KCONFIG_GROUP: Device Drivers::Keys & Buttons
menu "Adc_key"

	config ADC_KEY
		bool "Enable Adc Key"
		default n

	config ADC_KEY_MAX_CHANNELS
		int "Maximum active ADC key channels"
		default 4
		range 1 4
		depends on ADC_KEY
		help
		  Maximum number of ADC channels scanned by the generic adc_key
		  component. The CP sampler currently supports up to 4 channels.

	config ADC_KEY_MAX_ITEMS
		int "Maximum logical ADC keys"
		default 16
		range 1 16
		depends on ADC_KEY
		help
		  Size of the static logical-key object pool. Each voltage window
		  registered on an ADC channel consumes one item.

	config ADC_KEY_MAX_ITEMS_PER_CHANNEL
		int "Maximum logical keys per ADC channel"
		default 8
		range 1 8
		depends on ADC_KEY
		help
		  Software limit for non-overlapping voltage windows on one ADC
		  resistor ladder. Hardware designs should normally use no more
		  than 4 keys per channel to preserve noise margin.

	config ADC_KEY_SAMPLE_PERIOD_MS
		int "ADC key scan period (ms)"
		default 20
		range 20 100
		depends on ADC_KEY
		help
		  Period of one complete scan over all active ADC key channels.

	config ADC_KEY_DUAL_CHANNEL
		bool "Enable Dual ADC Channel Key (for next PCB revision)"
		default n
		depends on ADC_KEY
		help
		  Enable this option when PCB is fixed and KEY1 is rewired
		  to an ADC-capable GPIO. Both KEY1 and KEY2 will use ADC
		  for button detection, allowing all 4 buttons (S2-S5) to
		  be individually identified.

	menu "KEY2 (ADC Key) Pin Config"
		depends on ADC_KEY

		config ADC_KEY2_GPIO
			int "KEY2 GPIO pin number"
			default 28
			help
			  GPIO pin number for KEY2 (ADC input). Default: GPIO28.

		config ADC_KEY2_ADC_CHAN
			int "KEY2 ADC channel number"
			default 4
			help
			  SARADC channel number for KEY2. Default: ADC_4.

		config ADC_KEY_S4_VOLTAGE_LOW
			int "S4 button voltage lower bound (mV)"
			default 500
			help
			  ADC voltage lower bound for S4 button detection.

		config ADC_KEY_S4_VOLTAGE_HIGH
			int "S4 button voltage upper bound (mV)"
			default 1500
			help
			  ADC voltage upper bound for S4 button detection.

		config ADC_KEY_S5_VOLTAGE_LOW
			int "S5 button voltage lower bound (mV)"
			default 4500
			help
			  ADC voltage lower bound for S5 button detection.

		config ADC_KEY_S5_VOLTAGE_HIGH
			int "S5 button voltage upper bound (mV)"
			default 6000
			help
			  ADC voltage upper bound for S5 button detection.

		config ADC_KEY_LONG_PRESS_MS
			int "ADC key long press threshold (ms)"
			default 1000
			help
			  Time in ms to hold an ADC key before long press is triggered.

	endmenu

	menu "KEY1 (GPIO Key) Pin Config"
		depends on ADC_KEY

		config GPIO_KEY1_PIN
			int "KEY1 GPIO pin number"
			default 39
			help
			  GPIO pin number for KEY1 (GPIO-only input). Default: GPIO39.

		config GPIO_KEY1_ACTIVE_LEVEL
			int "KEY1 active level (0=low, 1=high)"
			default 0
			help
			  GPIO active level when KEY1 is pressed. 0=active low, 1=active high.

		config GPIO_KEY_LONG_PRESS_TICKS
			int "GPIO key long press ticks"
			default 100
			help
			  Number of timer ticks to hold GPIO key before long press.
			  Actual tick interval is ~10ms (6ms configured + OS overhead),
			  so 100 ticks is approximately 1 second.

	endmenu

	menu "Dual Channel KEY1 ADC Config"
		depends on ADC_KEY_DUAL_CHANNEL

		config ADC_KEY1_GPIO
			int "KEY1 ADC GPIO pin number (dual channel mode)"
			default 25
			help
			  GPIO pin for KEY1 when rewired to ADC-capable pin.

		config ADC_KEY1_ADC_CHAN
			int "KEY1 ADC channel number (dual channel mode)"
			default 1
			help
			  SARADC channel number for KEY1 in dual channel mode.

	endmenu

endmenu
```

## ap/components/app/Kconfig
```kconfig
# KCONFIG_GROUP: System Services::Application Services
menu "App"

	config DEMO_TEST
		bool "Enable Demo Test"
		default n

	#TODO does UPGRADE here means OTA?
	config FTPD_UPGRADE
		bool "Enable Ftpd Upgrade"
		default n

	#TODO what's the relationship between HTTP and TFTP OTA, exculsive?
	config OTA_TFTP
		bool "Enable Ota Tftp"
		default n

	config NTP_SYNC_RTC
		depends on AON_RTC
		bool "Enable Ntp Sync Rtc"
		default n

	config AP_EMUBOOT
		bool "Enable AP EMUBOOT project"
		default n

	config NTP_SYNC_RTC_TASK_STACK_SIZE
		int "Set NTP Sync Task Stack Size"
		default 3072
		help
			Stack size of NTP Sync task

	config RTC_NTP_TIMEZONE
		int "NTP local timezone offset from UTC (hours)"
		default 8
		range -12 14
		depends on NTP_SYNC_RTC
		help
			Applied after NTP returns UTC: local_time = utc + (RTC_NTP_TIMEZONE * 3600).
			Example: 8 for China Standard Time (UTC+8), -5 for US Eastern standard time.

	config FTP_SERVER
		bool "Enable FTP server"
		default n

	config FTP_USE_PSARM_MEM
		bool "FTP use psram memory"
		depends on PSRAM
		default y

	config ALI_MQTT
		depends on LWIP
		bool "Enable Ali Mqtt"
		default n

	config COREMQTT
		depends on LWIP
		bool "Enable coreMQTT Client (MQTT 5.0)"
		default n
		help
			Enable Amazon coreMQTT v5 library with lightweight FreeRTOS port.
			Do not enable together with Paho MQTT.

	config COREMQTT_THREAD_STACK_SIZE
		depends on COREMQTT
		int "coreMQTT worker thread stack size (bytes)"
		default 6144 if COREMQTT_TLS
		default 4096
		range 2048 8192

	config COREMQTT_NETWORK_BUFFER_SIZE
		depends on COREMQTT
		int "coreMQTT network buffer size (bytes)"
		default 1024
		range 512 4096

	config COREMQTT_MAX_INFLIGHT
		depends on COREMQTT
		int "Max in-flight QoS1/2 messages"
		default 5
		range 1 10

	config COREMQTT_TLS
		depends on COREMQTT && PSA_MBEDTLS
		bool "Enable coreMQTT MQTTS (TLS)"
		default y
		help
			Enable TLS transport for coreMQTT (mqtts:// or port 8883).

	config COREMQTT_TLS_VERIFY_SERVER
		depends on COREMQTT_TLS
		bool "Verify MQTTS server certificate"
		default n
		help
			When disabled, broker certificate is not verified (dev only).

	config PAHO_MQTT
		depends on LWIP
		bool "Enable Paho MQTT Client"
		default n
		help
			Enable Eclipse Paho MQTT client library for IoT communication

	config PAHO_MQTT_TLS
		depends on PAHO_MQTT && PSA_MBEDTLS
		bool "Enable Paho MQTT TLS Support"
		default n
		help
			Enable TLS/SSL encryption support for Paho MQTT client
endmenu
```

## ap/components/audio_algorithm/aec/Kconfig
```kconfig
# KCONFIG_GROUP: Multimedia::Audio::Algorithm::AEC
config AUDIO_AEC_TEST
	bool "Enable Audio AEC Test"
	default n
```

## ap/components/audio_algorithm/agc/Kconfig
```kconfig
# KCONFIG_GROUP: Multimedia::Audio::Algorithm::AGC
config AUDIO_AGC_TEST
	depends on FATFS
	bool "Enable Audio AGC Test"
	default n
```

## ap/components/audio_algorithm/aud_ns/Kconfig
```kconfig
# KCONFIG_GROUP: Multimedia::Audio::Algorithm::NS
config AUDIO_NS_TEST
	depends on FATFS
	bool "Enable Audio NS Test"
	default n
	help
		Enable Audio Noise Suppression Test.
```

## ap/components/audio_algorithm/aud_vad/Kconfig
```kconfig
# KCONFIG_GROUP: Multimedia::Audio::Algorithm::VAD
config AUDIO_VAD_TEST
	depends on FATFS
	bool "Enable Audio VAD Test"
	default n
	help
		Enable Audio Voice Activity Detection Test.
```

## ap/components/audio_algorithm/rsp/Kconfig
```kconfig
# KCONFIG_GROUP: Multimedia::Audio::Algorithm::RSP
config AUDIO_RSP_TEST
	bool "Enable Audio RSP Test"
	default n
	help
		Enable Audio Resample Test.
```

## ap/components/audio_algorithm/wanson_asr/Kconfig
```kconfig
# KCONFIG_GROUP: Multimedia::Audio::Algorithm::Wanson ASR
config WANSON_ASR_TEST
	depends on WANSON_ASR
	depends on FATFS
	bool "Enable Wanson ASR Test"
	default n
```

## ap/components/audio_codec/aac_decode/Kconfig
```kconfig
# KCONFIG_GROUP: Multimedia::Audio::Codec::aac_decode
config AUDIO_AACDEC_TEST
	#depends on FATFS
	bool "Enable Audio AacDec Test"
	default n
```

## ap/components/audio_codec/aac_encode_demo/Kconfig
```kconfig
# KCONFIG_GROUP: Multimedia::Audio::Codec::aac_encode_demo
menu "Audio_codec::AAC_encode_demo"
	config AAC_ENCODE_TEST
		depends on FATFS
		bool "Enable AAC Encode Test"
		default n
endmenu
```

## ap/components/audio_codec/adpcm/Kconfig
```kconfig
# KCONFIG_GROUP: Multimedia::Audio::Codec::adpcm
menu "Demos::Media::Audio::Adpcm"
	config AUDIO_ADPCM_TEST
		bool "Enable Audio Adpcm Test"
		default n
endmenu
```

## ap/components/audio_codec/g711/Kconfig
```kconfig
# KCONFIG_GROUP: Multimedia::Audio::Codec::g711
menu "Demos::Media::Audio::G711"
	config AUDIO_G711_TEST
		bool "Enable Audio G711 Test"
		default n
endmenu
```

## ap/components/audio_codec/opus/Kconfig
```kconfig
# KCONFIG_GROUP: Multimedia::Audio::Codec::opus
menu "Demos::Media::Audio::Opus"
	config AUDIO_OPUS_TEST
		depends on FATFS
		bool "Enable Audio Opus Test"
		default n
endmenu
```

## ap/components/audio_codec/sbc_decode/Kconfig
```kconfig
# KCONFIG_GROUP: Multimedia::Audio::Codec::sbc_decode
menu "Demos::Media::Audio::Sbc_decode"
	config SBC_TEST
		bool "Enable Sbc Test"
		default n
		help
			Enable sbc decode demos
endmenu
```

## ap/components/audio_play/Kconfig
```kconfig
menu "Audio Play"

	config AUDIO_PLAY
		depends on AUDIO_DAC && ADK && ADK_RAW_STREAM && ADK_ONBOARD_SPEAKER_STREAM_V2
		bool "Enable Audio Play"
		default n

	config AUDIO_PLAY_SUPPORT_SBC_DECODER
		depends on AUDIO_PLAY && ADK_SBC_DECODER
		bool "Enable SBC decoder path in audio_play"
		default y

	config AUDIO_PLAY_SUPPORT_AAC_DECODER
		depends on AUDIO_PLAY && ADK_AAC_DECODER
		bool "Enable AAC decoder path in audio_play"
		default y

endmenu
```

## ap/components/audio_record/Kconfig
```kconfig
# KCONFIG_GROUP: Multimedia::Audio::Record
menu "Audio Record"

	config AUDIO_RECORD
		depends on AUDIO_ADC && ADK && ADK_RAW_STREAM && ADK_ONBOARD_MIC_STREAM_V2
		bool "Enable Audio Record"
		default n

endmenu
```

## ap/components/avdk_driver/Kconfig
```kconfig
# KCONFIG_GROUP: Multimedia::AVDK Driver
menu "AVDK Driver"

	config ISP
		bool "ISP Drvier"
		default n

	config ISP_DUAL_MIPI_LOGICAL_PORT
		bool "Enable dual MIPI logical ISP ports"
		default n
		depends on ISP
		depends on MIPI_CSI
		help
			Enable the additional logical MIPI port, per-port ISP context
			storage, and dual-camera frame tagging. Keep disabled for
			single-camera products to preserve their original memory usage.

	config GPU
		bool "GPU Driver"
	default n

	config MIPI
		bool "MIPI Driver"
	default n

	config MIPI_CSI
		bool "MIPI CSI Driver"
	default n

	config DPU_DRIVER
		bool "Enable display process unit driver"
		default n

	config DSI_DRIVER
		bool "Enable mipi dsi"
		default n
endmenu
```

## ap/components/bk_asr_service/Kconfig
```kconfig
# KCONFIG_GROUP: Multimedia::Audio::ASR
menu "ASR Service"

	config ASR_SERVICE
		bool "Enable ASR Service"
		depends on ADK && ADK_RAW_STREAM && (ADK_ONBOARD_MIC_STREAM || ADK_ONBOARD_DUAL_DMIC_MIC_STREAM)
		default n
		help
			Enable ASR Service Interface API used for ASR
	
	choice ASR_SERVICE_USE_MEMORY
		depends on ASR_SERVICE
		prompt "Select asr service use memory"
		default ASR_SERVICE_USE_SRAM

		config ASR_SERVICE_USE_SRAM
			bool "Enable asr service use sram"
			help
				asr service use sram memory

		config ASR_SERVICE_USE_PSRAM
			depends on PSRAM
			bool "Enable asr service use psram"
			help
				asr service use psram memory
	endchoice

	choice ASR_SERVICE_MIC
		depends on ASR_SERVICE
		prompt "Select asr service with mic"
		default ASR_SERVICE_WITH_MIC

		config ASR_SERVICE_WITH_MIC
			bool "Enable asr service with mic"
			help
				asr service with mic

		config ASR_SERVICE_NO_MIC
			bool "Enable asr service no mic"
			help
				the mic will be opened by other modules, the asr src is from the mic multioutput.
	endchoice

	config AUD_ASR_READ_SERVICE
		depends on ASR_SERVICE 
		bool "Enable Audio ASR Service"
		default n
		help
			Enable Aud asr Service to read service mic data

	config ASR_SERVICE_THREAD_BIND_CPU
		bool "Enable ASR service thread bind cpu"
		depends on ASR_SERVICE
		default n
		help
			Enable ASR service thread bind cpu

	config ASR_SERVICE_THREAD_BIND_CPU_ID
		int "ASR service thread bind cpu id"
		depends on ASR_SERVICE_THREAD_BIND_CPU
		default 1
		help
			ASR service thread bind cpu id

	config BEKEN_KWS
		bool "Enable CONFIG_BEKEN_KWS"
		depends on TFLITE_MICRO && ASR_SERVICE
		default n

	config BEKEN_KWS_MODEL_BUFFER_USE_PSRAM
		depends on BEKEN_KWS && PSRAM
		bool "Place KWS model file buffer in PSRAM"
		default y if BEKEN_KWS_MODEL_FROM_UDISK
		default n
		help
			Allocate the KWS model file buffer from PSRAM when models are loaded
			from the file system.

	config BEKEN_KWS_ARENA_USE_PSRAM
		depends on BEKEN_KWS && PSRAM
		bool "Place KWS TFLM tensor arena in PSRAM"
		default y
		help
			Allocate the TFLM tensor arena (~70 KB) from PSRAM via psram_malloc.
			This is the highest-priority placement; if y, BEKEN_KWS_ARENA_USE_HSRAM
			is ignored.

	config BEKEN_KWS_ARENA_USE_HSRAM
		depends on BEKEN_KWS && !BEKEN_KWS_ARENA_USE_PSRAM
		bool "Place KWS TFLM tensor arena in HSRAM"
		default n
		help
			Allocate the TFLM tensor arena (~70 KB) from HSRAM via hsram_malloc.
			Falls back to os_malloc when both _USE_PSRAM and _USE_HSRAM are n.

	config BEKEN_KWS_SCRATCH_USE_PSRAM
		depends on BEKEN_KWS && PSRAM
		bool "Place KWS NPU fast-memory scratch in PSRAM"
		default y
		help
			Allocate the Ethos-U NPU scratch_fast buffer (~28 KB) from PSRAM via
			psram_malloc. This is the highest-priority placement; if y,
			BEKEN_KWS_SCRATCH_USE_HSRAM is ignored.

	config BEKEN_KWS_SCRATCH_USE_HSRAM
		depends on BEKEN_KWS && !BEKEN_KWS_SCRATCH_USE_PSRAM
		bool "Place KWS NPU fast-memory scratch in HSRAM"
		default n
		help
			Allocate the Ethos-U NPU scratch_fast buffer (~28 KB) from HSRAM via
			hsram_malloc. HSRAM has lower latency than PSRAM, so for performance
			this is preferable when HSRAM has enough free space. Falls back to
			os_malloc when both _USE_PSRAM and _USE_HSRAM are n.

endmenu
```

## ap/components/bk_audio/audio_decoders/opus_dec/Kconfig
```kconfig
menu "Adk::Audio_decoders::Opus_dec"
	config ADK_OPUS_DEC
		depends on ADK
		bool "Enable Audio Opus Decoder"
		default n

	config ADK_OPUS_DEC_TEST
		depends on ADK_OPUS_DEC && ADK_FRAME_ARRAY_STREAM && ADK_UART_STREAM
		bool "Enable Audio Opus Decoder test"
		default n

endmenu
```
