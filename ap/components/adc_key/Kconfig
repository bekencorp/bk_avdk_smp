## ap/components/bk_batt_monitor/Kconfig
```kconfig
# KCONFIG_GROUP: Device Drivers::Battery Monitor
menu "bk_bat_monitor"

config BAT_MONITOR
	bool "Enable battery monitor component"
	default n
	help
	  Enable the bk_batt_monitor component. The component itself is
	  hardware-agnostic; all board-specific parameters (charge-detect
	  GPIOs, ADC channel for VBAT, voltage divider ratio, thresholds,
	  poll period, etc.) must be configured by the solution via the
	  options below or via the LUT override API in bat_monitor.h.

if BAT_MONITOR

	menu "Charging-detect GPIO"

		config BAT_MONITOR_GPIO_CHARGE
			int "5V / VBUS detect GPIO pin number"
			default 55
			help
			  GPIO pin connected to the 5V_DET / VBUS-presence net
			  (often driven by a resistive divider off the USB VBUS).

		config BAT_MONITOR_CHARGE_ACTIVE_HIGH
			bool "5V_DET pin reads HIGH when external power is present"
			default y
			help
			  y : VBUS present -> GPIO reads 1 (default for resistive
			      divider VBUS -> R -> GPIO -> R -> GND).
			  n : VBUS present -> GPIO reads 0.

		config BAT_MONITOR_GPIO_FULL
			int "Charge-full status GPIO pin number"
			default 13
			help
			  GPIO pin connected to the charger STDBY / FULL_DET net.

		config BAT_MONITOR_FULL_PULL_UP
			bool "Enable internal pull-up on FULL_DET pin"
			default n
			help
			  Enable when the FULL_DET net has no reliable external
			  pull-up (e.g. open-drain charger STDBY going through a
			  Schottky diode to the MCU). With no internal pull-up
			  the pin would float in the non-active state and produce
			  random readings.

		config BAT_MONITOR_FULL_ACTIVE_HIGH
			bool "FULL_DET pin reads HIGH when battery is actively charging"
			default y
			help
			  y (default): charging -> FULL_DET = 1,
			               battery full -> FULL_DET = 0.
			  n          : charging -> FULL_DET = 0,
			               battery full -> FULL_DET = 1.

	endmenu

	menu "Battery voltage sensing"

		config BAT_MONITOR_ADC_CHAN
			int "ADC channel used for battery voltage"
			default 13
			help
			  SARADC channel number connected (directly or via an
			  external divider) to the battery.

		config BAT_MONITOR_ADC_DIVIDER_X100
			int "External voltage divider ratio x100 (VBAT / V_pin * 100)"
			default 430
			help
			  Set to (R_top + R_bottom) / R_bottom * 100. For
			  R_top = 3.3M, R_bottom = 1M => 4.3 * 100 = 430.
			  Use 100 when the ADC pin is connected directly to
			  the battery (no divider).

		config BAT_MONITOR_VBAT_SANITY_MAX_MV
			int "Sanity max VBAT (mV) before falling back to V_pin"
			default 4500
			help
			  If the divider-compensated VBAT exceeds this value
			  (impossible for a healthy single-cell Li-ion), the
			  driver assumes the divider has been bypassed/DNP on
			  this board and uses V_pin directly as VBAT.

		config BAT_MONITOR_VBAT_HARD_CLAMP_MV
			int "Hard upper clamp on reported VBAT (mV)"
			default 5000

		config BAT_MONITOR_BAT_MIN_MV
			int "Battery minimum voltage (mV)"
			default 3000

		config BAT_MONITOR_BAT_MAX_MV
			int "Battery maximum voltage (mV)"
			default 4100

	endmenu

	menu "Monitor task & thresholds"

		config BAT_MONITOR_POLL_PERIOD_MS
			int "Monitor task poll period (ms)"
			default 5000
			help
			  Interval at which the monitor task re-reads charging
			  GPIOs and battery voltage. Note that
			  iot_battery_chargeLevel() also reads the GPIO live
			  on every call, so this value mostly controls the
			  rate of background voltage averaging and event
			  notification.

		config BAT_MONITOR_LOW_PERCENT
			int "Low battery warning threshold (%)"
			default 20

		config BAT_MONITOR_SHUTDOWN_PERCENT
			int "Shutdown threshold (%)"
			default 2

		config BAT_MONITOR_FULL_PERCENT
			int "Full charge threshold (%)"
			default 95

	endmenu

endif # BAT_MONITOR

endmenu
```

## ap/components/bk_bluetooth/Kconfig
```kconfig
# KCONFIG_GROUP: Wireless Connectivity::Bluetooth
menu "Bk_ble"
	config BLUETOOTH_AP
		bool "bluetooth ap"
		default y

    config BLUETOOTH_HOST_ONLY
		bool "bluetooth host only"
		depends on BLUETOOTH_AP
		default y

	config BT
		bool "Enable Bt"
		depends on BLUETOOTH_HOST_ONLY
		default n

	config BLUETOOTH_ENABLE_BT_DUT_TEST
		bool "Enable manual Bluetooth DUT test"
		depends on BT && CLI
		default n
		help
			Register the bt_dut_test CLI command used to start and stop
			Classic Bluetooth DUT mode without a USB HCI connection.

	config BLE
		bool "Enable Ble"
		depends on (BLUETOOTH_HOST_ONLY || BLUETOOTH_SUPPORT_AP_PWD_ALL)
		default y

	config BLE_LE_AUDIO
		bool "Enable LE Audio"
		depends on BLE && BLUETOOTH_BTDM_COMPONENT_ENABLE
		default n
		help
			Enable LE Audio BAP/Broadcast APIs on top of the dual-mode
			Ethermind host. This is required by projects/bluetooth/le_audio.
			When enabled, the AP side links the Ethermind host_dm library even
			if classic BT application APIs are disabled with CONFIG_BT=n.

	config BLUETOOTH_AUTO_ENABLE
		bool "bluetooth auto enable"
		depends on BLUETOOTH_AP
		default y


	config BLUETOOTH_MULTI_CONTROLLER
		bool "multi bluetooth controller"
		depends on (BLE || BT)
		default n

	choice BLUETOOTH_MULTI_CONTROLLER_MODE
		prompt "multi bluetooth controller mode"
		depends on BLUETOOTH_MULTI_CONTROLLER
		default BLUETOOTH_MULTI_CONTROLLER_MODE_PRI_ALL_SEC_NONE

		config BLUETOOTH_MULTI_CONTROLLER_MODE_PRI_ALL_SEC_NONE
			bool "primary all, secondary none"
		config BLUETOOTH_MULTI_CONTROLLER_MODE_PRI_NONE_SEC_ALL
			bool "primary none, secondary all"
		config BLUETOOTH_MULTI_CONTROLLER_MODE_PRI_BLE_SEC_BT
			bool "primary ble, secondary bt"
		config BLUETOOTH_MULTI_CONTROLLER_MODE_PRI_BT_SEC_BLE
			bool "primary bt, secondary ble"
	endchoice

	config BLUETOOTH_HOST_ENABLE_H5
		bool "host enable h5"
		depends on (BLUETOOTH_MULTI_CONTROLLER_MODE_PRI_NONE_SEC_ALL || BLUETOOTH_MULTI_CONTROLLER_MODE_PRI_BLE_SEC_BT || BLUETOOTH_MULTI_CONTROLLER_MODE_PRI_BT_SEC_BLE)
		default n

	config BLUETOOTH_RELEASE_CODESIZE
		bool "reduce ble stack size"
		depends on BLE
		default n
		help
			This option is used to reduce ble stack size for IoT scenarios that
			only use ble provisioning network.It supports two ble advertise,
			one ble link, and ble scan at the same time.it does not support SMP and central role.
			when config this option,BLUETOOTH_BLE_SLAVE_ONLY will be invalid.

	config BLUETOOTH_BLE_SLAVE_ONLY
		bool "only supports ble slave"
		depends on !BLUETOOTH_RELEASE_CODESIZE
		default n

	config BLUETOOTH_BLE_SLAVE_OBSERVER
		bool "only supports ble slave and observer"
		depends on !BLUETOOTH_RELEASE_CODESIZE
		default n

    config BLUETOOTH_BLE_DISCOVER_AUTO
        bool "auto ble discover. Only used when single ble host"
        default y

    config BLUETOOTH_SUPPORT_IPC
        bool "bt support ipc"
		depends on BLUETOOTH_AP
        default y

    config SUPPORT_BLE_RECONNECTION_STRATEGY
        bool "automatically initialize ble reconnection due to connection establishment failed"
        default y

    config BLE_MAX_LATENCY
        int "max latency."
        default 20
        range 0 499

    config BLUETOOTH_SUPPORT_AP_PWD_ALL
        bool "bluetooth support ap power down all"
		depends on BLUETOOTH_SUPPORT_IPC
        default n

	menu "BK_MESH"
		depends on BLE && BLUETOOTH_HOST_ONLY && BLUETOOTH_SUPPORT_IPC

		config BLE_MESH_ZEPHYR
			bool "Enable Zephyr Bluetooth Mesh host"
			default n
			help
				Enable the Zephyr BLE Host and Bluetooth Mesh stack on AP. The
				controller still runs on CP and is reached through HCI over IPC.

		config BT_MESH_ADV_LEGACY
			bool "enable BT_MESH_ADV_LEGACY"
			depends on BLE_MESH_ZEPHYR
			default n

		config BT_MESH_ADV_EXT
			bool "enable BT_MESH_ADV_EXT"
			depends on BLE_MESH_ZEPHYR
			default y

		config BT_MESH_SETTINGS
			bool "enable BT_SETTINGS"
			depends on BLE_MESH_ZEPHYR
			default n

		config BT_MESH_LOW_POWER
			bool "enable BT_MESH_LOW_POWER"
			depends on BLE_MESH_ZEPHYR
			default y

		config BT_MESH_FRIEND
			bool "enable BT_MESH_FRIEND"
			depends on BLE_MESH_ZEPHYR
			default y

		config BT_MESH_PROV
			bool "enable BT_MESH_PROV"
			depends on BLE_MESH_ZEPHYR
			default y

		config BT_MESH_GATT_PROXY
			bool "enable BT_MESH_GATT_PROXY"
			depends on BLE_MESH_ZEPHYR
			default y

		config BT_MESH_PROV_DEVICE
			bool "enable BT_MESH_PROV_DEVICE"
			depends on BLE_MESH_ZEPHYR
			default y

		config BT_MESH_PROVISIONER
			bool "enable BT_MESH_PROVISIONER"
			depends on BLE_MESH_ZEPHYR
			default y

		config BT_MESH_PB_ADV
			bool "enable BT_MESH_PB_ADV"
			depends on BLE_MESH_ZEPHYR
			default y

		config BT_MESH_PB_GATT
			bool "enable BT_MESH_PB_GATT"
			depends on BLE_MESH_ZEPHYR
			default y

		config BT_MESH_GATT_SERVER
			bool "enable BT_MESH_GATT_SERVER"
			depends on BLE_MESH_ZEPHYR
			default y

		config BT_MESH_GATT
			bool "enable BT_MESH_GATT"
			depends on BLE_MESH_ZEPHYR
			default y

		config BT_MESH_CFG_CLI
			bool "enable BT_MESH_CFG_CLI"
			depends on BLE_MESH_ZEPHYR
			default y

		config BT_MESH_HEALTH_CLI
			bool "enable BT_MESH_HEALTH_CLI"
			depends on BLE_MESH_ZEPHYR
			default y

		config BT_MESH_SELF_TEST
			bool "enable BT_MESH_SELF_TEST"
			depends on BLE_MESH_ZEPHYR
			default y

		config BT_MESH_SHELL
			bool "enable BT_MESH_SHELL"
			depends on BLE_MESH_ZEPHYR
			default n

		config BT_MESH_CDB
			bool "enable BT_MESH_CDB"
			depends on BLE_MESH_ZEPHYR
			default y

		config BT_MESH_DEBUG
			bool "enable BT_MESH_DEBUG"
			depends on BLE_MESH_ZEPHYR
			default y

		config BT_MESH_CONN
			bool "enable BT_MESH_CONN"
			depends on BLE_MESH_ZEPHYR
			default y

		config BT_MESH_SMP
			bool "enable BT_MESH_SMP"
			depends on BLE_MESH_ZEPHYR
			default y

		config BT_MESH_ISO
			bool "enable BT_MESH_ISO"
			depends on BLE_MESH_ZEPHYR
			default n

		config BT_MESH_HOST_CCM
			bool "enable BT_MESH_HOST_CCM"
			depends on BLE_MESH_ZEPHYR
			default y

		config ACLSEMI_BT_MESH_DEBUG_LEVEL
			int "set ACLSEMI_BT_MESH_DEBUG_LEVEL"
			depends on BLE_MESH_ZEPHYR
			default 2
			range 0 5
	endmenu

	config BLUETOOTH_BTDM_COMPONENT_ENABLE
		bool "bluetooth dual component enable"
		default n

	menu "bluetooth dm BLE Modules"
		depends on BLE && BT

		config BLUETOOTH_BTDM_COMPONENT_BLE_GATT
			bool "Enable bt_dm/ble/gatt public framework"
			default y
			help
				Public GATT framework (dm_gatt / dm_gatts / dm_gattc / dm_gatt_connection
				/ dm_gap_utils) used by AT Server and by downstream demos such as
				dashboard wifi_boarding and bt_dm/ble/hogpd. Its include directory
				(bt_dm/ble/gatt) is exposed to other components that PRIV_REQUIRES
				bk_bluetooth.

		config BLUETOOTH_BTDM_COMPONENT_BLE_USE_STORAGE
			bool "GATT uses bluetooth_storage to persist bond information"
			depends on BLUETOOTH_BTDM_COMPONENT_BLE_GATT
			default n

		config BLUETOOTH_BTDM_COMPONENT_BLE_GATTS_TEST_ATTR
			bool "Enable GATTS test attribute table"
			depends on BLUETOOTH_BTDM_COMPONENT_BLE_GATT
            default n

		config BLUETOOTH_BTDM_COMPONENT_BLE_GATT_LOG_LEVEL
			int "GATT module log level (0=ERR..4=VERBOSE)"
			depends on BLUETOOTH_BTDM_COMPONENT_BLE_GATT
			range 0 4
			default 2

		config BLUETOOTH_BTDM_COMPONENT_BLE_HOGPD
			bool "Enable bt_dm/ble/hogpd demo (HID-over-GATT keyboard)"
			depends on BLUETOOTH_BTDM_COMPONENT_BLE_GATT
			default n

		config BLUETOOTH_BTDM_COMPONENT_BLE_HOGPD_LOG_LEVEL
			int "HOGPD demo log level (0=ERR..4=VERBOSE)"
			depends on BLUETOOTH_BTDM_COMPONENT_BLE_HOGPD
			range 0 4
			default 2
	endmenu

	menu "bluetooth dm BT Modules"
		depends on BLUETOOTH_BTDM_COMPONENT_ENABLE

		config BLUETOOTH_BTDM_COMPONENT_BT_A2DP_SOURCE_AAC
			bool "Enable A2DP source AAC-LC encoding (FDK-AAC)"
			default n
			help
				Advertise and encode AAC-LC for the A2DP source role, in
				addition to SBC. This links the FDK-AAC encoder library which
				adds roughly 230 KB of flash, so it is disabled by default to
				keep code size down. When disabled, the A2DP source is SBC-only.

		config BLUETOOTH_BTDM_COMPONENT_HFP_AG
			bool "Enable HFP AG (Audio Gateway) role service"
			default n
			help
				Build the componentized HFP AG service (bk_hfp_ag_service +
				hfp_ag_audio) so the device can act as the Audio Gateway
				(phone/gateway side) of a Hands-Free call. Needs the HFP AG
				host support enabled too (CONFIG_HFP_AG). Disabled by default;
				enable it in the project that needs the AG role (e.g.
				bluetooth/central).
	endmenu

	menu "bluetooth CTKD Modules"
		depends on BLUETOOTH_BTDM_COMPONENT_ENABLE
		depends on BLE && BT

		config BLUETOOTH_CTKD_BLE_TO_BT
			bool "Enable BLE to BR/EDR CTKD"
			default n
			help
				Enable Cross-Transport Key Derivation from a BLE LTK key
				to a BR/EDR link key.

		config BLUETOOTH_CTKD_BT_TO_BLE
			bool "Enable BR/EDR to BLE CTKD"
			depends on !BLUETOOTH_MULTI_CONTROLLER
			default n
			help
				Enable Cross-Transport Key Derivation from a BR/EDR link
				key to a BLE LTK key.
	endmenu
endmenu
```

## ap/components/bk_camera/Kconfig
```kconfig
menu "BK Camera"

	config BK_CAMERA
		bool "Enable bk camera"
		default n

	config ISP_FRAME_SESSION
		bool "ISP frame capture session (ispFrame RPC)"
		default n
		depends on BK_CAMERA
		depends on BK_NTWK_TRANSFER
		help
			Enable ISP frame module. JSON-RPC control matches H264E methods;
			VIDEO channel sends NV12/YUV image frames.

endmenu
```

## ap/components/bk_display/Kconfig
```kconfig
# KCONFIG_GROUP: Multimedia::Display & UI
menu "BK Display"

	config BK_DISPLAY
		bool "BK Display"
		default n

		config MIPI_DSI
                depends on DSI_DRIVER
		bool "MIPI DSI Driver"
		default n

	config DPU_FLUSH_TIMER_DEBUG
		depends on BK_DISPLAY
		bool "dpu flush fps printf"
	default n
endmenu
```

## ap/components/bk_frame_buffer/Kconfig
```kconfig
# KCONFIG_GROUP: Multimedia::Display & UI
menu "frame Buffer"
	config FRAME_BUFFER
		bool "enable psram as frame buffer for saving image"
		default n

	config ISP_FLEXA_BUFFER_USE_HSRAM
		bool "allocate the ISP flexa buffer from HSRAM instead of SRAM"
		default y
		help
		    The ISP flexa buffer is one of the larger single allocations
		    on the AP, so moving it to HSRAM is a way to relieve the
		    general SRAM heap.

		    Callers need no change either way: hsram_free is defined as
		    os_free, so one free path serves both heaps.
endmenu
```
