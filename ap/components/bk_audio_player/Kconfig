## ap/components/bk_audio_player/Kconfig
```kconfig
menu "Bk_audio_player"
	config AUDIO_PLAYER
		bool "Enable bk_audio_player"
		default n

	choice AUDIO_PLAYER_USE_MEMORY
		depends on AUDIO_PLAYER
		prompt "Select audio player use memory"
		default AUDIO_PLAYER_USE_SRAM

		config AUDIO_PLAYER_USE_SRAM
			bool "Enable audio player use sram"
			help
				audio player use sram memory

		config AUDIO_PLAYER_USE_PSRAM
			depends on PSRAM
			bool "Enable audio player use psram"
			help
				audio player use psram memory
	endchoice

endmenu
```

## ap/components/bk_cli/Kconfig
```kconfig
menu "Bk_cli"

	menu "Modify Cli Config"

		config CLI
			bool "Enable Cli"
			default y

		config CLI_USER_CONFIG
			depends on CLI
			bool "Enable Cli User Config"
			default n
			help
				support cli user configuration header


		config LOG_LEVEL
			int "Set LOG LEVEL"
			range 0 6
			default 6
			help
				set log compile and default print level, log level map:
				0 BK_LOG_NONE, no log output.
				1 BK_LOG_ERROR, output error level or above
				2 BK_LOG_WARN, output warning level or above
				3 BK_LOG_INFO, output info level or above
				4 BK_LOG_DEBUG, output debug level or above
				5 BK_LOG_VERBOSE, output debug level or above
				6 BK_LOG_DEFAULT, BK_LOG_INFO in release version, BK_LOG_DEBUG in debug version

		config BKREG
			depends on CLI
			bool "Enable Bkreg"
			default y
			help
				Enable BK Reg read/write

		config BKREG_SHOW_CALI
			depends on BKREG
			bool "Enable Show Cali Table"
			default n
			help
				Enable Show Cali Table

		config MAX_COMMANDS
			depends on CLI
			int "Set Max Commands"
			range 0 65535
			default 255
			help
				MAX number of commands is configured by default

		config CLI_TASK_PRIO
			depends on CLI
			int "Set Cli Task Prio"
			range 1 10
			default 4
			help
				priority of cli task

		config SHELL_TASK_STACK_SIZE
			depends on CLI
			int "Set Shell Task Stack Size"
			range 0 65535
			default 7168
			help
				Set Shell Task Stack Size

		config LOG_TASK_PRIO
			int "Set Log Task Prio"
			range 1 10
			default 4
			help
				priority of log task

		config LOG_TASK_STACK_SIZE
			int "Set Log Task Stack Size"
			range 0 65535
			default 512
			help
				Set Log Task Stack Size


		config IPERF_TEST
			depends on CLI && DEMOS_IPERF
			bool "Enable Iperf Test"
			default y

		config WIFI_CLI_ENABLE
			depends on CLI && WIFI_VNET_CONTROLLER
			bool "Enable Wifi Cli Enable"
			default y

		config TCP_SERVER_TEST
			depends on CLI
			bool "Enable Tcp Server Test"
			default n

		config AIRKISS_TEST
			depends on CLI
			bool "Enable Airkiss Test"
			default n

		config WIFI_RAW_TX_TEST
			depends on CLI
			bool "Enable Wifi Raw Tx Test"
			default n

		config WIFI_CLI_RAW_LINK_ENABLE
			depends on CLI
			bool "Enable Wifi CLI Raw Link enable"
			default n

		config CONNECT_THROUGH_PSK_OR_SAE_PASSWORD
			depends on CLI
			bool "Enable connect through psk or sae password"
			default n

		config VFS_TEST
			depends on CLI
			bool "Enable Vfs Test"
			default n

		#TODO Exculsive??
		config I2C1_TEST
			depends on CLI
			bool "Enable I2C1 Test"
			default n

		config I2C2_TEST
			depends on CLI
			bool "Enable I2C2 Test"
			default n

		config UART_TEST
			depends on CLI
			bool "Enable Uart Test"
			default n

		config SPI_TEST
			depends on CLI
			bool "Enable SPI Test"
			default n

		config PERI_TEST
			depends on CLI
			bool "Enable Peri Test"
			default n

		config RF_OTA_TEST
			depends on CLI
			bool "Enable Rf Ota Test"
			default n

		config SHELL_ASYNCLOG
			bool "Enable Shell Asynclog"
			default n
			help
				Enable Shell and Async log optimize

		config DYM_LOG_MEM_MAX
			depends on SHELL_ASYNCLOG
			hex "Limit Of Log Dynamic Memory"
			default 0x2000
			help
				Dynamic Log Memory Maximum

		config UART_RING_BUFF
			depends on SHELL_ASYNCLOG
			bool "Enable uart ring buffer"
			default n
			help
				Enable uart ring buffer

		config TOUCH_TEST
			depends on CLI
			bool "Enable Touch Test"
			default n

		config PSRAM_TEST
			depends on CLI && PSRAM
			bool "Enable Psram Test"
			default n

		config BATTERY_TEST
			depends on CLI && BAT_MONITOR
			bool "Enable Battery Test"
			default n

		config INTERRUPT_TEST
			depends on CLI
			bool "Enable Interrupt Test"
			default n

		config AON_PMU_TEST
			depends on CLI
			bool "Enable Aon Pmu Test"
			default n

		config PM_TEST
			depends on CLI
			bool "Enable Pm Test"
			default n

		config PUF_TEST
			depends on CLI
			bool "Enable PUF Test"
			default n

		config ICU
			bool "Enable Icu"
			default y

		config KEYVALUE
			bool "Enable Keyvalue"
			default n

		config IDLE_UART_OUT_TEST
			bool "Enable Idle Uart Out Test"
			default n

		config COMPONENTS_WPA2_ENTERPRISE
			bool "Enable Components Wpa2 Enterprise"
			default n

		config COMPONENTS_WPA_TWT_TEST
			bool "Enable Wpa Twt Test"
			default n

		config COMPONENTS_WFA_CA
			bool "Enable Components Wfa Ca"
			default n

		config ENABLE_WIFI_DEFAULT_CONNECT
			bool "Enable Wifi Default Connect"
			default n

		config RTC_TIMER_PRECISION_TEST
			bool "Enable RTC Timer precision test"
			default n

		config RTC_TIMER_PRECISION_TEST_BY_GPIO
			bool "Enable RTC Timer precision test"
			default n

		config RWNX_PROTO_DEBUG
			bool "Enable Rwnx Proto Debug"
			default n

		config OTP_TEST
			depends on OTP_V1
			bool "Enable OTP Test"
			default n
	endmenu
endmenu
```

## ap/components/bk_dma2d/Kconfig
```kconfig
menu "Media::DMA2D_Draw"

	config MEDIA_DAM2D
		depends on DMA2D
		bool "Enable DMA2D Service"
		default n
		help
			Enable DMA2D service

endmenu
```

## ap/components/bk_draw_osd/Kconfig
```kconfig
menu "Media::Draw_osd"

	config MEDIA_OSD
		bool "Enable software draw osd component"
		default n
		help
			This option enables the software draw osd component.

endmenu
```

## ap/components/bk_dvp/Kconfig
```kconfig
menu "DVP"
	config DVP_CAMERA
		bool "Enable Camera"
		depends on YUV_BUF
		depends on GENERAL_DMA
		default n
		help
			Enable camera interface

	config DVP_CAMERA_I2C_ID
		depends on DVP_CAMERA
		int "Set Camera I2c Id"
		range 0 2
		default 0
		help
			The value should be changed if need to change i2c id

	config DVP_CTRL_POWER_GPIO_ID
		depends on DVP_CAMERA
		int "the gpio id control dvp camera power"
		default 9

	config DVP_THREAD_STACK_SIZE
		depends on DVP_CAMERA
		int "DVP work thread stack size (bytes)"
		range 1024 8192
		default 2048
		help
			Stack size for DVP work thread that handles frame callbacks and module reset.
			Increase if stack overflow occurs.

endmenu
```

## ap/components/bk_jpeg_decoder/Kconfig
```kconfig
menu "JPEG Decoder"

	config JPEG_DECODER
		bool "Enable JPEG Decoder"
		default y
		help
			Enable jpeg decoder service
	
	config JPEG_DECODER_SW
		depends on JPEG_DECODER
		bool "Enable JPEG Decoder Software"
		default y
		help
			Enable jpeg decoder software service

	config SW_JPEG_DECODE_TASK_STACK_SIZE
		int "Software JPEG decode task stack size"
		default 1024
		depends on JPEG_DECODER_SW
		help
			Stack size in bytes for software JPEG decode task (default: 1024)

	config JPEG_DECODER_HW
		depends on JPEG_DECODER
		bool "Enable JPEG Decoder Hardware"
		default y
		help
			Enable jpeg decoder hardware service

	config HW_JPEG_DECODE_TASK_STACK_SIZE
		int "Hardware JPEG decode task stack size"
		default 1024
		depends on JPEG_DECODER_HW
		help
			Stack size in bytes for hardware JPEG decode task (default: 1024)

	config HW_JPEG_DECODE_TASK_PRIORITY
		int "Hardware JPEG decode task pirority"
		default 6
		depends on JPEG_DECODER_HW
		help task pirority
			

endmenu
```

## ap/components/bk_network_provisioning/Kconfig
```kconfig
menu "Beken Components Network Provisioning"
	config BK_NETWORK_PROVISIONING
		bool "Enable Beken Network Provisioning"
		default n

	config BK_BLE_PROVISIONING
		bool "Enable BLE Service for Network Provisioning"
		depends on BK_NETWORK_PROVISIONING
		default n

	config BK_NETWORK_PROVISIONING_BLE_EXAMPLE
		bool "Enable Network Provisioning BLE Example"
		depends on BK_BLE_PROVISIONING
		default n
endmenu
```

## ap/components/bk_nfc/Kconfig
```kconfig
menu "bk_nfc"

	config NFC_ENABLE
		bool "Enable nfc"
		default n

	config NFC_TEST_EN
		depends on NFC_ENABLE
		bool "Enable nfc test"
		default n

	config NFC_DEMO_EN
		depends on NFC_ENABLE
		bool "Enable nfc demo"
		default n

	config NFC_MFRC522_ENABLE
		depends on NFC_ENABLE
		bool "Enable nfc IP"
		default n

	config NFC_MFRC522_COMM_SERIAL_PORT
		int "Config MFRC522 Uart Communication  Port"
		range 0 2
		default 1
		help
		Default 1 mean use UART1

	config NFC_POLLING_PERIOD_MS
		int "nfc polling time Period(ms)"
		default 1000
endmenu
```

## ap/components/bk_peripheral/src/lcd/qspi/Kconfig
```kconfig
menu "QSPI LCD"

	config LCD_QSPI_SH8601A
		depends on LCD_QSPI
		bool "Enable LCD_QSPI_SH8601A API"
		default n

    config SH8601A_PARTIAL
        depends on LCD_QSPI_SH8601A
        bool "Enable Lcd Qspi SH8601A_PARTIAL Test"
        default n

	config LCD_QSPI_ST77903_WX20114
		depends on LCD_QSPI
		bool "Enable LCD_QSPI_ST77903_WX20114 API"
		default n

	config LCD_QSPI_ST77903_SAT61478M
		depends on LCD_QSPI
		bool "Enable LCD_QSPI_ST77903_SAT61478M API"
		default n

	config LCD_QSPI_ST77903_H0165Y008T
		depends on LCD_QSPI
		bool "Enable LCD_QSPI_ST77903_H0165Y008T API"
		default n

	config LCD_QSPI_SPD2010
		depends on LCD_QSPI
		bool "Enable LCD_QSPI_SPD2010 API"
		default n

	config LCD_QSPI_GC9C01
		depends on LCD_QSPI
		bool "Enable LCD_QSPI_GC9C01 API"
		default n

	config LCD_QSPI_JD9855
		depends on LCD_QSPI
		bool "Enable LCD_QSPI_JD9855 API"
		default n

	config LCD_QSPI_JD9855_K18XJ15
		depends on LCD_QSPI
		bool "Enable LCD_QSPI_JD9855_K18XJ15 API"
		default n

	config LCD_QSPI_ST77916
		depends on LCD_QSPI
		bool "Enable LCD_QSPI_ST77916 API"
		default n

	config LCD_QSPI_JD9853A
		depends on LCD_QSPI
		bool "Enable LCD_QSPI_JD9853A API"
		default n
endmenu
```

## ap/components/bk_player_service/Kconfig
```kconfig
menu "Bk_player_service"

	depends on ADK

	config PLAYER_SERVICE
		bool "Enable bk_player_service"
		depends on ADK_ARRAY_STREAM || ADK_VFS_STREAM
		default n
		help
			Enable the bk_player_service Interface API for playing prompt tones or music

	config PLAYER_SERVICE_TEST
		depends on PLAYER_SERVICE
		bool "Enable bk_player_service Test"
		default n
		help
			Enable bk_player_service test to test bk_player_service by cli command

	config PLAYER_SERVICE_SUPPORT_ARRAY_STREAM
		depends on PLAYER_SERVICE && ADK_ARRAY_STREAM
		bool "Enable bk_player_service support array stream"
		default n
		help
			Enable bk_player_service to support playing audio file stored in arrays

	config PLAYER_SERVICE_SUPPORT_VFS_STREAM
		depends on PLAYER_SERVICE && ADK_VFS_STREAM
		bool "Enable bk_player_service support vfs stream"
		default n
		help
			Enable bk_player_service to support playing audio file stored in vfs file system

	config PLAYER_SERVICE_SUPPORT_MP3_DECODER
		depends on PLAYER_SERVICE && ADK_MP3_DECODER
		bool "Enable bk_player_service support mp3 decoder"
		default n
		help
			Enable bk_player_service to support playing MP3 format audio files

	config PLAYER_SERVICE_SUPPORT_G711_DECODER
		depends on PLAYER_SERVICE && ADK_G711_DECODER
		bool "Enable bk_player_service support g711 decoder"
		default n
		help
			Enable bk_player_service to support playing g711a/u format audio files

	config PLAYER_SERVICE_SUPPORT_WAV_DECODER
		depends on PLAYER_SERVICE && ADK_WAV_DECODER
		bool "Enable bk_player_service support wav decoder"
		default n
		help
			Enable bk_player_service to support playing wav format audio files

endmenu
```

## ap/components/bk_thirdparty/VolcEngineRTCLite/Kconfig
```kconfig
#TODO remove all kconfigs which are defined in armino libs

menu "VolcEngineRTCLite"

	config VOLC_RTC_EN
		bool "Enable Volc RTC"
		default n
		help
			Enable Volc RTC

	config VOLC_RTC_ENABLE_LICENSE
		bool "Enable volc RTC license check"
		depends on VOLC_RTC_EN
		default n
		help
			Enable volc RTC license check

	config VOLC_RTC_THREAD_BIND_CPU
		bool "Enable volc RTC thread bind cpu"
		depends on VOLC_RTC_EN
		default n
		help
			Enable volc RTC thread bind cpu

	config VOLC_RTC_THREAD_BIND_CPU_ID
		int "Volc RTC thread bind cpu id"
		depends on VOLC_RTC_THREAD_BIND_CPU
		default 0
		help
			Volc RTC thread bind cpu id
endmenu
```

## ap/components/bk_thirdparty/asr/wanson_armino/Kconfig
```kconfig
menu "Bk_thirdparty::Wanson_armino"

	config WANSON_ARMINO_ASR
		bool "Enable Wanson ASR"
		default n
		help
			Enable Wanson Automatic Speech Recognition

	config WANSON_ASR_GROUP_VERSION
		depends on WANSON_ARMINO_ASR
		bool "Enable Wanson ASR_GROUP_VERSION"
		default n
		help
			Enable Wanson ASR_GROUP_VERSION

	config WANSON_CN_LICENSE
		bool "Enable Wanson CN License"
		default n
		help
			Enable Wanson CN License for authentication and usage rights

	choice WANSON_ASR_WORDS_VERSION
		depends on WANSON_ARMINO_ASR
		prompt "Select Words Version"
		default WANSON_ASR_GROUP_VERSION_WORDS_V1

		config WANSON_ASR_WORDS_VERSION_V1
		bool "Enable Words Version V1"
		help
			support wakeword "a er mi nuo"

		config WANSON_ASR_WORDS_VERSION_V2
		bool "Enable Words Version V2"
		help
			support wakeword "hi armino"

		config WANSON_ASR_GROUP_VERSION_WORDS_V1
		bool "Enable Wanson ASR Group Version_V1"
		help
			support wakeword "hi armino"

		config WANSON_ASR_GROUP_VERSION_WORDS_V2
		bool "Enable Wanson ASR Group Version_V2"
		help
			support wakeword "nihao armino"


	endchoice

endmenu
```

## ap/components/bk_thirdparty/zlib/Kconfig
```kconfig
menu "Bk_thirdparty::zlib"

	config ZLIB_ENABLE
		bool "Enable zlib"
		default n
		help
			Enable zlib
endmenu
```

## ap/components/bk_video_pipeline/Kconfig
```kconfig
menu "Video Pipeline"

	config VIDEO_PIPELINE
		bool "Enable Video Pipeline"
		default y
		help
			Enable video pipeline service
	



endmenu
```

## ap/components/bk_video_recorder/Kconfig
```kconfig
menu "Bk_video_record"

    config VIDEO_RECORDER
        bool "Enable video recorder"
        default n
    
    config VIDEO_RECORDER_TASK_STACK_SIZE
        int "video recorder task stack size"
        default 2048
        depends on VIDEO_RECORDER
        help
            Stack size in bytes for video recorder task (default: 2048)

    config VIDEO_RECORDER_TASK_PRIORITY
        int "video recorder task priority"
        default 6
        depends on VIDEO_RECORDER
        help
            Task priority for video recorder thread (default: 6)
endmenu
```

## ap/components/bk_wifi_driver/Kconfig
```kconfig
menu "WiFi Driver"
	config WIFI_VNET_CONTROLLER
		bool "Enable Wifi WIFI_VNET_CONTROLLER"
		default n
	config CONTROLLER_RX_DIRECT_PSH
		bool "Controller RX Buf Directly push to AP"
		default y
	config CONTROLLER_DEBUG
		bool "Controller Debug"
		default n
	config CONTROLLER_AP_BUFFER_COPY
		bool "Controller AP buffer copy to CP buffer"
		default n
	config WIFI_DRIVER_DEBUG
		bool "Enable Wifi Driver Debug"
		depends on CLI && WIFI_VNET_CONTROLLER
		default y
endmenu
```
