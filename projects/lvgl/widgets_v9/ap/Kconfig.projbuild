## projects/multimedia/asr_service_example/ap/Kconfig
```kconfig
menu "BK7259_ASR_DEBUG"
	config BK7259_ASR_DEBUG
		bool "Enable DEBUG"
		default n
endmenu
```

## projects/multimedia/audio_example_ap/ap/Kconfig
```kconfig
menu "AUDIO_RSP_BENCH"

        config AUD_RSP_BENCH_CLI
                bool "Enable rsp_bench CLI (only needed when running the bench test)"
                default n
                help
                    Compiles the rsp_bench CLI in this project. Enable it only when
                    you want to run the bench test; the normal case is measuring the
                    B2 (production) performance, and B1 additionally keeps the original
                    speex loop for the bit-exact comparison.

                    The CLI needs a bench-capable libresample.a, i.e. the internal
                    library must be built with CONFIG_AUD_RSP_MVE_BENCH=y (see
                    sdk/ap/properties/soc/bk7259_ap/bk7259_ap.defconfig). Otherwise the
                    build fails with an undefined reference to aud_rsp_bench_run_tone.

endmenu

menu "AUDIO_OPUS_BENCH"

        config AUD_OPUS_BENCH_CLI
                bool "Enable opus_bench CLI (only needed when running the bench test)"
                default n
                help
                    Compiles the opus_bench CLI in this project. Enable it only when
                    you want to run the benchmark; the normal case is measuring the
                    B2 (production) performance, and B1 additionally keeps the
                    original CELT inner-product loops for the bit-exact comparison.

                    The CLI needs a bench-capable libopus.a, i.e. the internal
                    library must be built with CONFIG_AUD_OPUS_MVE_BENCH=y (see
                    sdk/ap/properties/soc/bk7259_ap/bk7259_ap.defconfig). Otherwise the
                    build fails with an undefined reference to aud_opus_bench_run_case.

endmenu

menu "AUDIO_CODEC_LOOPBACK"

        config AUD_CODEC_LOOPBACK_CLI
                bool "Enable codec_loopback CLI (voice path loopback test)"
                depends on VOICE_SERVICE && VOICE_READ_SERVICE && VOICE_WRITE_SERVICE && \
                           VOICE_SERVICE_OPUS_ENCODER && VOICE_SERVICE_OPUS_DECODER
                default n
                help
                    Compiles the codec_loopback CLI in this project. It runs
                    mic -> voice_service (encode) -> voice_write (decode) -> speaker
                    so a codec can be verified on the real voice path by listening.

                    Enable this only for loopback tests; when disabled the CLI source
                    is not compiled at all. Opus support additionally needs
                    CONFIG_ADK_OPUS_ENCODER / CONFIG_ADK_OPUS_DECODER and
                    CONFIG_VOICE_SERVICE_OPUS_ENCODER / CONFIG_VOICE_SERVICE_OPUS_DECODER.

endmenu
```

## projects/multimedia/cp_audio_kws_example/cp/Kconfig
```kconfig
menu "CP Audio KWS Example"

	config CP_KWS_CPU_LIB
		bool "Enable CP CPU KWS model library"
		default n
		help
			Reserved for a future CP-compatible KWS model library.
			The current imported AP/M55 hard-float KWS archive must not be
			linked into the CP image.

	config CP_KWS_MODEL_FROM_UDISK
		bool "Use CP KWS model from VFS/file"
		depends on CP_KWS_CPU_LIB
		default n
		help
			Use the CP CPU KWS model library variant that loads model data
			from VFS/file. The default CP KWS path uses built-in model data.

	config CP_KWS_TEST
		bool "Enable CP KWS validation CLI"
		default n
		help
			Register the cp_kws CLI. It currently runs in stub mode because
			there is no CP/M52-compatible KWS algorithm library yet.

	config CP_PROMPT_TEST
		bool "Enable CP voice/player prompt validation CLI"
		default n
		depends on VOICE_SERVICE && PLAYER_SERVICE && ADK_ONBOARD_SPEAKER_STREAM_SUPPORT_MULTIPLE_SOURCE
		help
			Register the migrated AP component voice and player CLI commands.
			The prompt_tone flow uses the bk_voice_service speaker handle and
			bk_player_service not-playback output port through the onboard
			speaker multi-input framework.

endmenu
```

## projects/multimedia/h264_decode_example/ap/Kconfig.projbuild
```kconfig
menu "H264 Decode Example Configuration"

	config H264_DECODE_ENABLE_1080P
		bool "Enable 1080p test streams"
		default n
		help
			Embed 1920x1080 H.264 elementary streams. Disable to save
			flash when only 720p streams are needed.

	config H264_DECODE_DPB_COVER
		bool "Enable decoder DPB write-through cover"
		default y
		select PSRAM_WRITE_THROUGH
		help
			Give the decoder DPB a PSRAM write-through window (CLI
			"cover" + boot default pool). Applies to any stream
			resolution, not only 1080p.

endmenu
```

## projects/multimedia/h264d_gpu_display_example/ap/Kconfig.projbuild
```kconfig
menu "H264D GPU Display Example Configuration"

	config H264D_GPU_DISPLAY_ENABLE_MIPI_DISPLAY
		bool "Enable MIPI display output"
		default y
		help
			Enable the MIPI panel output path. Disable this to run the
			H.264 decoder to GPU pipeline without flushing frames to display.

	choice H264D_GPU_DISPLAY_TEST_STREAM_CHOICE
		prompt "H.264 test stream"
		default H264D_GPU_DISPLAY_TEST_STREAM_1280X720

		config H264D_GPU_DISPLAY_TEST_STREAM_720X1280
			bool "720x1280"

		config H264D_GPU_DISPLAY_TEST_STREAM_1280X720
			bool "1280x720"
	endchoice

	config H264D_GPU_DISPLAY_ENABLE_ISP_PIP
		bool "Enable ISP picture-in-picture overlay"
		default y
		help
			Bring up the on-board CSI sensor and ISP channel, then
			composite the ISP small picture onto the H.264 decoded big
			picture via the GPU blit overlay path. Disable to run
			the demo with H.264 + GPU + MIPI only.

	config H264D_GPU_DISPLAY_ENABLE_ISP_PIP_ROTATE
		bool "Enable ISP picture-in-picture rotation"
		depends on H264D_GPU_DISPLAY_ENABLE_ISP_PIP
		default y
		help
			Rotate the ISP small picture during the GPU blit overlay
			stage. This keeps the sensor/ISP output in landscape while
			displaying the PIP correctly on a portrait panel.

	choice H264D_GPU_DISPLAY_ISP_PIP_ROTATE_CHOICE
		prompt "ISP picture-in-picture rotation angle"
		depends on H264D_GPU_DISPLAY_ENABLE_ISP_PIP_ROTATE
		default H264D_GPU_DISPLAY_ISP_PIP_ROTATE_90

		config H264D_GPU_DISPLAY_ISP_PIP_ROTATE_90
			bool "90 degrees"

		config H264D_GPU_DISPLAY_ISP_PIP_ROTATE_270
			bool "270 degrees"
	endchoice

	config H264D_GPU_DISPLAY_ISP_SENSOR_DEFAULT_WIDTH
		int "Default sensor input width"
		depends on H264D_GPU_DISPLAY_ENABLE_ISP_PIP
		default 1280

	config H264D_GPU_DISPLAY_ISP_SENSOR_DEFAULT_HEIGHT
		int "Default sensor input height"
		depends on H264D_GPU_DISPLAY_ENABLE_ISP_PIP
		default 720

	config H264D_GPU_DISPLAY_ISP_SENSOR_DEFAULT_FPS
		int "Default sensor frame rate"
		depends on H264D_GPU_DISPLAY_ENABLE_ISP_PIP
		default 20

	config H264D_GPU_DISPLAY_ISP_PIP_DEFAULT_WIDTH
		int "Default ISP (PIP) output width"
		depends on H264D_GPU_DISPLAY_ENABLE_ISP_PIP
		default 640
		help
			Default output width

	config H264D_GPU_DISPLAY_ISP_PIP_DEFAULT_HEIGHT
		int "Default ISP (PIP) output height"
		depends on H264D_GPU_DISPLAY_ENABLE_ISP_PIP
		default 360

	config H264D_GPU_DISPLAY_ISP_PIP_DEFAULT_DST_X
		int "Default overlay X position on GPU output frame"
		depends on H264D_GPU_DISPLAY_ENABLE_ISP_PIP
		default 696 if H264D_GPU_DISPLAY_ENABLE_ISP_PIP_ROTATE
		default 416

	config H264D_GPU_DISPLAY_ISP_PIP_DEFAULT_DST_Y
		int "Default overlay Y position on GPU output frame"
		depends on H264D_GPU_DISPLAY_ENABLE_ISP_PIP
		default 32

endmenu
```
