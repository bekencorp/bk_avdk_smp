## projects/multimedia/pp_example/ap/Kconfig.projbuild
```kconfig
menu "PP Example Configuration"

	config PP_EXAMPLE_ENABLE_MIPI_DISPLAY
		bool "Enable MIPI display output after PP conversion"
		default y
		help
			After bk_pp_process() completes, scale/rotate the output frame
			via GPU and flush it to the MIPI panel (same path as
			h264d_gpu_display_example start_dec_scale_cvt).

endmenu
```

## projects/pm/ap_fast_boot_audio_test/ap/config/bk7259_ap/defconfig
```kconfig
# ap_fast_boot_audio_test AP defconfig
# Lean: voice + player + asr(service only) + AP fast boot. No camera/display/KWS.

# AP SMP is required by CONFIG_PM_AP_FAST_BOOT_ENABLE
CONFIG_SOC_SMP=y
CONFIG_FREERTOS_SMP=y

CONFIG_MEDIA_SERVICE=y
CONFIG_CONTROLLER_AP_BUFFER_COPY=y
CONFIG_LWIP_MEM_LIBC_MALLOC_USE_PSRAM=y

# ---- ADK / audio ----
CONFIG_ADK=y
CONFIG_ADK_USE_PSRAM=y
CONFIG_ADK_AEC_V3_ALGORITHM=y
CONFIG_ADK_AEC_V3_ALGORITHM_COMPONENT_V2=y
CONFIG_ADK_RSP_ALGORITHM=y
CONFIG_ADK_EQ_ALGORITHM=y
CONFIG_ADK_G711_ENCODER=y
CONFIG_ADK_G711_DECODER=y
CONFIG_ADK_G722_ENCODER=y
CONFIG_ADK_G722_DECODER=y
CONFIG_ADK_MP3_DECODER=y
CONFIG_ADK_WAV_DECODER=y
CONFIG_ADK_ARRAY_STREAM=y
CONFIG_ADK_ONBOARD_MIC_STREAM=y
CONFIG_ADK_ONBOARD_MIC_STREAM_V2=y
CONFIG_ADK_ONBOARD_SPEAKER_STREAM=y
CONFIG_ADK_ONBOARD_SPEAKER_STREAM_SUPPORT_MULTIPLE_SOURCE=y
CONFIG_ADK_ONBOARD_SPEAKER_STREAM_V2=y
CONFIG_ADK_RAW_STREAM=y
CONFIG_ADK_UAC_MIC_STREAM=y
CONFIG_ADK_UAC_SPEAKER_STREAM=y
# CONFIG_ADK_VFS_UTIL is not set

CONFIG_AUDIO=y
CONFIG_AUD_DRIVER_V2=y
CONFIG_AUDIO_ADC=y
CONFIG_AUDIO_DAC=y
CONFIG_I2S=y

# ---- services ----
CONFIG_VOICE_SERVICE=y
CONFIG_VOICE_SERVICE_USE_PSRAM=y
CONFIG_VOICE_READ_SERVICE=y
CONFIG_VOICE_WRITE_SERVICE=y
CONFIG_VOICE_SERVICE_TEST=y
CONFIG_VOICE_SERVICE_EQ=y

CONFIG_PLAYER_SERVICE=y
CONFIG_PLAYER_SERVICE_SUPPORT_ARRAY_STREAM=y
CONFIG_PLAYER_SERVICE_SUPPORT_MP3_DECODER=y
CONFIG_PLAYER_SERVICE_SUPPORT_WAV_DECODER=y

CONFIG_ASR_SERVICE=y
CONFIG_ASR_SERVICE_USE_PSRAM=y
CONFIG_ASR_SERVICE_WITH_MIC=y
CONFIG_TFLITE_MICRO=y
CONFIG_NPU=y
CONFIG_NPU_CACHE=y
CONFIG_BEKEN_KWS=y

# ---- os / print ----
CONFIG_CLI_TASK_STACK_SIZE=2048
CONFIG_FREERTOS_USE_QUEUE_SETS=y
# CONFIG_FREERTOS_V10 is not set
CONFIG_TASK_STACK_IN_PSRAM=y
CONFIG_QUEUE_IN_PSRAM=y
# CONFIG_SYS_PRINT_DEV_UART is not set
CONFIG_SYS_PRINT_DEV_MAILBOX=y
CONFIG_UART_PRINT_BAUD_RATE=115200
CONFIG_EASY_FLASH_V4=y
CONFIG_FLASH=y
# CONFIG_FLASH_TEST is not set
CONFIG_DMA_LOGIC_CHAN_ID_MIN=0
CONFIG_XTAL_FREQ=26000000

# ---- AP fast boot ----
CONFIG_SLAVE_HEART_BEAT=n
CONFIG_FREERTOS_USE_TICKLESS_IDLE=2
CONFIG_GPIO_WAKEUP_SUPPORT=y
CONFIG_GPIO_DYNAMIC_WAKEUP_SUPPORT=y
CONFIG_PM_AP_WFI_ENABLE=y
CONFIG_PSRAM_DATA_RETENTION_ENABLE=y
CONFIG_PM_AP_FAST_BOOT_ENABLE=y
CONFIG_AUD_PM_FAST_COLD=y
```
