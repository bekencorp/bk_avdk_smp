## projects/tflite_micro/gesture_detection/ap/Kconfig.projbuild
```kconfig
menu "Gesture Detection Application Configuration"

	choice GESTURE_DET_PROMPT_TONE_LANG
		prompt "Select prompt tone language"
		default GESTURE_DET_PROMPT_TONE_LANG_CHINESE
		help
			Select which language is used for prompt tones.

		config GESTURE_DET_PROMPT_TONE_LANG_CHINESE
			bool "Chinese prompt tones"
			help
				Use Chinese prompt tones for the gesture detection demo.

		config GESTURE_DET_PROMPT_TONE_LANG_ENGLISH
			bool "English prompt tones"
			help
				Use English prompt tones for the gesture detection demo.

	endchoice

endmenu
```

## projects/tflite_micro/palm_recognition_ai_car/ap/Kconfig.projbuild
```kconfig
menu "Palm Recognition AI Car Configuration"

	choice PALM_AI_CAR_CONTROL_MODE
		prompt "Select AI car control mode"
		default PALM_AI_CAR_CONTROL_MODE_DIRECT
		help
			Select how palm recognition results are used by the AI car.

		config PALM_AI_CAR_CONTROL_MODE_DIRECT
			bool "Directly control AI car"
			help
				Use palm recognition results to directly drive the AI car.

		config PALM_AI_CAR_CONTROL_MODE_SEND_COORD
			bool "Send recognition coordinates"
			help
				Send palm recognition coordinates instead of directly controlling the AI car.

	endchoice

endmenu
```
