## projects/bluetooth/hfp_ag/ap/Kconfig.projbuild
```kconfig
menu "HFP AG Example Configuration"

    config HFP_AG_DEMO
        bool "hfp ag (audio gateway) demo"
        depends on BT
        default y
        help
            HFP AG (Hands-Free Profile - Audio Gateway) demo.
            Consumes the SDK public components/bluetooth/bk_dm_hfp_ag.h API
            (bridge lives in the SDK: ble_pub/ui/bt_hfp_ag_*, dispatched on
            ui_ethermind_ctx_thread) and registers CLI commands to drive
            AG-side call control.
endmenu
```

## projects/bluetooth/le_audio/ap/Kconfig.projbuild
```kconfig
menu "LE Audio Robot Broadcast Demo Configuration"

    choice LE_AUDIO_DEFAULT_ROLE
        prompt "default LE Audio role"
        default LE_AUDIO_ROLE_SINK

        config LE_AUDIO_ROLE_SOURCE
            bool "Broadcast source (master robot)"

        config LE_AUDIO_ROLE_SINK
            bool "Broadcast sink (slave robot)"
    endchoice

    config LE_AUDIO_BROADCAST_NAME
        string "LE Audio broadcast name"
        default "BK7259_LE_AUDIO_ROBOT"

    config LE_AUDIO_SAMPLE_RATE
        int "LC3 sample rate"
        default 48000

    config LE_AUDIO_FRAME_US
        int "LC3 frame duration in us"
        default 10000

    config LE_AUDIO_FRAME_BYTES
        int "LC3 frame bytes"
        default 120

    config LE_AUDIO_PROTOCOL_DEMO
        bool "Enable LE Audio protocol demo"
        default n

endmenu
```

## projects/bluetooth/le_audio/ap/config/bk7259_ap/defconfig
```kconfig
#
# LE Audio robot broadcast demo AP default config.
#

# CONFIG_SOC_SMP is not set
# CONFIG_ALL_CODE_IN_PSRAM is not set
CONFIG_BLUETOOTH_AP=y
CONFIG_BT=n
CONFIG_BLE=y
CONFIG_BLE_LE_AUDIO=y
CONFIG_FREERTOS_V10=y
# CONFIG_FREERTOS_SMP is not set
CONFIG_FREERTOS_USE_QUEUE_SETS=y
CONFIG_MEDIA_SERVICE=y

# CONFIG_SPI is not set
# CONFIG_SPI_DMA is not set
CONFIG_AUDIO=y
CONFIG_AUD_DRIVER_V2=y
CONFIG_AUDIO_ADC=y
CONFIG_AUDIO_DAC=y

CONFIG_ADK=y
CONFIG_ADK_USE_PSRAM=y
CONFIG_ADK_MIX_ALGORITHM=y
CONFIG_ADK_RAW_STREAM=y
CONFIG_ADK_VFS_UTIL=n
CONFIG_ADK_ONBOARD_SPEAKER_STREAM=y
CONFIG_ADK_ONBOARD_SPEAKER_STREAM_V2=y

CONFIG_AUDIO_PLAY=y
CONFIG_SUPPORT_WWDT=n

CONFIG_GENERAL_DMA=y
CONFIG_GENERAL_DMA_V2P6=y
CONFIG_DMA_LOGIC_CHAN_CNT=4
CONFIG_DMA_LOGIC_CHAN_ID_MIN=4
CONFIG_XTAL_FREQ=12000000

CONFIG_ADK_SBC_DECODER=y
CONFIG_ADK_AAC_DECODER=n

CONFIG_BLUETOOTH_BTDM_COMPONENT_ENABLE=y
CONFIG_LE_AUDIO_ROLE_SINK=y
CONFIG_LE_AUDIO_PROTOCOL_DEMO=y
```

## projects/bluetooth/le_audio/unicast_client/ap/Kconfig.projbuild
```kconfig
menu "LE Audio Unicast Client Configuration"

    config LE_AUDIO_BROADCAST_NAME
        string "LE Audio device name"
        default "BK Unicast Client"

    config LE_AUDIO_SAMPLE_RATE
        int "LC3 sample rate"
        default 48000

    config LE_AUDIO_FRAME_US
        int "LC3 frame duration in us"
        default 10000

    config LE_AUDIO_FRAME_BYTES
        int "LC3 frame bytes"
        default 120

endmenu
```

## projects/bluetooth/le_audio/unicast_server/ap/Kconfig.projbuild
```kconfig
menu "LE Audio Unicast Server Configuration"

    config LE_AUDIO_BROADCAST_NAME
        string "LE Audio device name"
        default "BK Unicast Server"

    config LE_AUDIO_SAMPLE_RATE
        int "LC3 sample rate"
        default 48000

    config LE_AUDIO_FRAME_US
        int "LC3 frame duration in us"
        default 10000

    config LE_AUDIO_FRAME_BYTES
        int "LC3 frame bytes"
        default 120

    config LE_AUDIO_STREAM_COUNT
        int "Audio streams (1 mono, 2 stereo: one LC3 stream per channel)"
        default 2
        range 1 2

    config LE_AUDIO_VCP
        bool "Volume Control Profile (renderer)"
        default y
        help
            Lets the peer read and change the speaker volume through VCS.

    config LE_AUDIO_MCP
        bool "Media Control Profile (client)"
        default y
        help
            Drives play / pause / next / previous on the peer's media player
            through its GMCS. This is the LE Audio counterpart of AVRCP.

endmenu
```

## projects/bluetooth/pbap_pce/ap/Kconfig.projbuild
```kconfig
menu "PBAP PCE Example Configuration"

    config PBAP_PCE_DEMO
        bool "pbap pce demo"
        depends on BT
        default y
        help
            PBAP PCE (Phone Book Access Profile - Phone Book Client) CLI demo.
            Enables pbap CLI commands for bk_dm_pbap_pce.h API functional testing.
endmenu
```

## projects/bluetooth/spp/ap/Kconfig.projbuild
```kconfig
menu "SPP Example Configuration"

    config SPP_DEMO
        bool "spp demo"
        depends on BT
        default y
        help
            SPP (Serial Port Profile) CLI demo.
            Enables spp CLI commands for bk_dm_spp.h API functional testing.
endmenu
```

## projects/common_components/avdk_nn_module/Kconfig
```kconfig
menu "AVDK NN Module"

	config TFLM_PERSON_DETECTION_GRAY
		depends on TFLITE_MICRO
		bool "Use tflm person detection gray model with NV12 MP input"
		default n

	config TFLM_PERSON_DETECTION_RGB
		depends on TFLITE_MICRO
		bool "Use tflm person detection RGB model with BGRA MP input"
		default n

	config TFLM_PET_DETECTION_V1
		depends on TFLITE_MICRO
		bool "Enable tflm PET (cat/dog YOLOv8) detection"
		default n

	config TFLM_HAND_GESTURE_DETECTION_V1
		depends on TFLITE_MICRO
		bool "Enable tflm hand gesture (YOLOv8) detection"
		default n

	config TFLM_FACE_DETECTION_V1
		depends on TFLITE_MICRO
		bool "Enable tflm FACE_DETECTION_V2"
		default n

	config TFLM_GESTURE_DETECTION_V1
		depends on TFLITE_MICRO
		bool "Enable tflm GESTURE_DETECTION_V1"
		default n

	config TFLM_MOBILEFACENET_V1
		depends on TFLITE_MICRO
		bool "Enable tflm MOBILEFACENET_V1"
		default n

	config TFLM_YOLOFACE_V1
		depends on TFLITE_MICRO
		bool "Enable tflm YOLOFACE_V1"
		default n

	config TFLM_PALM_DETECTION_V1
		depends on TFLITE_MICRO
		bool "Enable tflm PALM_V1"
		default n

	config COMMON_LVGL_UI
		bool "Enable common LVGL UI"
		default y

	config AVDK_VIDEO_REATOR_OSD_WORKER_PRIORITY
		int "AVDK video reator OSD worker task priority"
		default 6

	config AVDK_VIDEO_REATOR_OSD_WORKER_STACK_SIZE
		int "AVDK video reator OSD worker task stack size"
		default 10240
endmenu
```

## projects/common_components/detection_service/Kconfig
```kconfig
menu "Doorbell Service"
    config INTEGRATION_DOORBELL_CS2
        bool "Doorbell integration CS2"
        default n
    config SUPPORTED_IMAGE_MAX_720P
        bool "Supported image max 720P"
        default n

    config MEDIA_PIPELINE_APP
        bool "app layer need enable pipeline"
        default y
endmenu
```

## projects/common_components/smart_lock/Kconfig
```kconfig
menu "Smart Lock"

    config INTEGRATION_DOORBELL
        bool "Doorbell integration"
        default n
endmenu
```

## projects/dhrystone_test/ap/Kconfig
```kconfig
config DHRYSTONE_TEST
	depends on CLI
	bool "Enable Dhrystone 2.1 (DMIPS) CLI command"
	default n
	help
		Register the dhrystone command, which runs the Dhrystone 2.1
		benchmark shipped with this project and reports Dhrystones/s
		and DMIPS. The benchmark sources live in ap/dhrystone.
```

## projects/kvs_aws_sample/ap/config/bk7259_ap/defconfig
```kconfig
#
# kvs_aws_sample: enable KVS AWS WebRTC component (differences vs board defconfig).
# Build with: make -C projects/kvs_aws_sample
#
CONFIG_KVS_AWS=y
CONFIG_KVS_GET_CA_FROM_ARRAY=y
CONFIG_KVS_AWS_DATA_CHANNEL=y

CONFIG_LIBWEBSOCKETS=y
CONFIG_LIBSRTP=y
CONFIG_USRSCTP=y

CONFIG_CLI=y
#CONFIG_CLI_TASK_STACK_SIZE=12288

CONFIG_DUMP_BY_LOG_UART=y
CONFIG_PSA_MBEDTLS=y
CONFIG_FULL_MBEDTLS=y
CONFIG_SW_CRYPTO=y
CONFIG_MBEDTLS_SSL_IN_CONTENT_LEN=16384
CONFIG_MBEDTLS_SSL_OUT_CONTENT_LEN=16384
CONFIG_MBEDTLS_LOG_LEVEL="INFO"
CONFIG_SDCARD=y
CONFIG_FATFS=y
CONFIG_FATFS_SDCARD=y
CONFIG_VFS=y
CONFIG_VFS_TEST=y
# Required by bk_cli/cli_vfs.c (bk_flash_partition_get_info)
CONFIG_FLASH=y
CONFIG_NTP_SYNC_RTC=y
CONFIG_FREERTOS_POSIX=y
CONFIG_MBEDTLS_USE_PSA_CRYPTO=y
CONFIG_KVS_PTHREAD_CANCEL_DETACH=y
CONFIG_MEMDUMP_ALL=y
CONFIG_SHELL_TASK_STACK_SIZE=51200
CONFIG_RTC_NTP_TIMEZONE=0
CONFIG_MBEDTLS_USE_PSRAM=y
CONFIG_TASK_STACK_IN_PSRAM=y
CONFIG_QUEUE_IN_PSRAM=y
CONFIG_SPINLOCK_DYNAMIC_CNT=320
#CONFIG_IPV6=y
CONFIG_TRNG_SUPPORT=y
```

## projects/lvgl/launcher_v9/ap/Kconfig.projbuild
```kconfig
menu "LVGL Launcher_v9 Configuration"

config LAUNCHER_JS_FROM_FS
    bool "Load the launcher application from the file system"
    depends on BK_JERRYSCRIPT && BK_JERRYSCRIPT_FS
    default n
    help
        When enabled, the launcher loads the JavaScript application from the
        littlefs image stored in the usr_config flash partition. See
        ap/components/bk_jerryscript/README.md for how to build and flash
        that image, so the UI can be updated without rebuilding the firmware.

        When disabled (default), the bundle converted to C
        (ap/js_bundle.c, generated by js2c.py) is compiled into the firmware
        and executed at startup.

endmenu
```
