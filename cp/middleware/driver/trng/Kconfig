## cp/middleware/driver/trng/Kconfig
```kconfig
menu "TRNG"
	config TRNG_SUPPORT
		bool "Support hardware TRNG"
		default y

	config TRNG_PM_CB_SUPPORT
		bool "trng pm support"
		default n

	config TRNG_TEST
		depends on TRNG_SUPPORT && DRIVER_TEST
		bool "Enable trng test"
		default y
endmenu
```

## cp/middleware/driver/wakeup/Kconfig
```kconfig
menu "Wakeup"
	config WAKEUP
		bool "Enable Interrupt Wakeup"
		default n

	config WAKEUP_TEST
		depends on WAKEUP
		bool "Enable wakeup test"
		default n
endmenu
```

## cp/middleware/driver/wdt/Kconfig
```kconfig
menu "Task & INT Watchdog"
	config WDT_EN
		bool "Enable Watchdog"
		default n

	config INT_WDT
		depends on WDT_EN
		bool "Enable AON_WDT Interrupt Watchdog"
		default y

	config SUPPORT_AON_WDT
		depends on WDT_EN
		bool "Use AON Watchdog backend"
		default y

	config INT_WDT_PERIOD_MS
		depends on WDT_EN
		int "AON_WDT Interrupt Watchdog Period(ms)"
		default 1000

	config TASK_WDT
		depends on WDT_EN
		bool "Enable Task Watchdog"
		default y

	config TASK_WDT_PERIOD_MS
		depends on WDT_EN
		int "Task Watchdog Period(ms)"
		default 60000

	config TASK_WDT_TEST
		depends on TASK_WDT && DRIVER_TEST
		bool "Enable task watchdog test"
		default y

	config WDT_TEST
		depends on INT_WDT && DRIVER_TEST
		bool "Enable watchdog test"
		default y

	config WDT_API_TEST
		depends on INT_WDT && DRIVER_TEST
		bool "Enable watchdog api test"
		default n
endmenu
```

## cp/middleware/driver/wwdt/Kconfig
```kconfig
menu "Watchdog"
	config SUPPORT_WWDT
		depends on WDT_EN
		bool "Enable Window Watchdog"
		default n

	config INT_WWDT_PERIOD_MS
		depends on SUPPORT_WWDT
		int "Interrupt Watchdog Period(ms)"
		default 2000

	config WWDT_TEST
		depends on SUPPORT_WWDT && DRIVER_TEST
		bool "Enable window watchdog test"
		default y
endmenu
```

## cp/middleware/soc/Kconfig
```kconfig
	choice SOC
		prompt "ARMINO SoC"
		default SOC_BK7259 if "$ARMINO_SOC" = "bk7259"
		default SOC_BK7258 if "$ARMINO_SOC" = "bk7258"
		default SOC_BK7257 if "$ARMINO_SOC" = "bk7257"
		help
			Select the target chip family used by this build. The default is
			derived from ARMINO_SOC and normally should not be changed by users.

		config SOC_BK7259
			bool "BK7259"
		config SOC_BK7258
			select SOC_BK7236XX
			bool "BK7258"

		config SOC_BK7257
			select SOC_BK7236XX
			bool "BK7257"



	endchoice

	config CPU_CNT
			int "System CPU count: 1: single core, 2: dual core, etc."
			default 1
			help
				Total CPU count described by the target SoC/platform. This is a
				hardware/platform capability value and can include CPUs that are
				not managed by the current SMP OS instance.

	config PLL_ENABLE
		bool "Enable pll in soc"
		default y
		help
			Enable the SoC PLL during low-level clock initialization. Keep this
			enabled unless the target board has a validated alternate clock plan.

	config SOC_STR
		string "SoC string"
		default "bk7259_cp"  if SOC_BK7259
		default "bk7258_cp"  if SOC_BK7258
		default "bk7257_cp"  if SOC_BK7257
		default "$ARMINO_SOC"
		help
			String form of the selected SoC target. Build scripts and generated
			configuration files may use this value to locate target-specific
			resources.

	config SOC_ARCH
		string "Soc arch"
		default "unknown"
		help
			CPU architecture name for the selected SoC, such as cm52. This is
			normally provided by the target defconfig.

	config SOC_BK7236XX
		bool "For bk7236 series chipset"
		default n
		help
			Internal compatibility flag for BK7236-family chips. It is selected
			automatically by the matching SoC option.

	config SOC_CORTEX_M_UART_DEBUG
		bool "For Cortex-M uart debug based on DWT"
		default n
		help
			Enable Cortex-M UART debug support that relies on DWT resources.
			Use only on targets where the DWT-based debug path is available.

	config SOC_SMP
		bool "For soc smp feature"
		default n
		help
			Enable Symmetric Multi-Processing support for SoCs and projects that
			run multiple CPU cores under one OS instance.

	config CPU_ID_OFFSET
		int "CPU ID offset"
		default 2
		depends on SOC_SMP
		help
			Base CPU ID used by the SMP runtime when mapping logical CPU indexes
			to hardware CPU IDs.

	config SMP_CORE_CNT
		int "SMP core count"
		default 2
		depends on SOC_SMP
		help
			Number of CPU cores that participate in the SMP OS scheduler. This
			is the runtime SMP core count and may be smaller than CPU_CNT when
			some CPUs are reserved for another core domain or firmware.

	config PRODUCT_ID
		bool "Enable product ID"
		default n
		help
			Enable Product ID insertion for anti-channel-conflict builds.

	config BK_PID_BOOT_CHECK
		bool "Enable product ID boot check"
		depends on PRODUCT_ID
		default n
		help
			Compare firmware and OTP Product IDs during boot for production builds.
```

## cp/middleware/soc/bk7259/Kconfig
```kconfig
	config SRAM_DIRECT_ADDR
		bool "Use SRAM direct address"
		default n
		help
			Use the direct SRAM address mapping for memory access. This is a
			low-level memory layout option and should match the linker script
			and boot configuration.

	config ANA_REG_WRITE_POLL_REG_B
		bool "Write analog register polls sys reg0xb"
		default y
		help
			Use system register 0xb as the polling register when writing analog
			registers. This is a SoC-level hardware workaround and normally
			should keep the default value.

	config PM_HAL_DEBUG
		bool "Enable PM hal debug"
		default n
		help
			Enable extra debug output in the power-management HAL. This is
			intended for low-power debugging and should normally be disabled in
			product builds.

	config PM_HAL_CTRL
		bool "Enable PM HAL control"
		default n
		help
			Enable additional power-management HAL control paths for BK7259 CP.
			Use this only when the project explicitly needs PM HAL control
			debug or validation.

	config SYS_PM_ANA_VANALDO_STEP_CTRL
		bool "Enable analog LDO voltage step control on low-power enter/exit"
		default n
		help
			When enabled, sys_hal_enter_low_analog() will step down the analog
			LDO (t/r_vanaldosel) to 0 and sys_hal_exit_low_analog() will ramp
			it back up in small increments with a 10us settling delay between
			each step. Disable this if the hardware does not require the stepped
			voltage transition.

	config TZ
		bool "Supported TrustZone"
		default y
		help
			Enable TrustZone support for the BK7259 CP target. This should
			match the secure/non-secure memory layout and boot configuration.

	config SPE
		int "Enable SPE"
		default 0
		help
			Secure Processing Environment mode selector. This is a low-level
			boot/security setting and should match the target security layout.

	config RX_OPTIMIZE
		bool "Optimize rx current"
		default n
		help
			Enable receive-path current optimization for BK7259 CP. Use this
			only after validating RF/current behavior on the target board.
```

## projects/agora_demo/ap/Kconfig
```kconfig
menu "app_event"
	config APP_EVT
		bool "Enable APP_EVT"
		default y
endmenu

menu "countdown"
	config COUNTDOWN
		bool "Enable COUNTDOWN"
		default n
endmenu

menu "BK Factory Config"
	config BK_FACTORY_CONFIG
		bool "Enable BK factory config"
		default y
endmenu

menu "key_app"
	config USR_KEY_CFG_EN
		bool "Enable user-defined KEY config for each project"
		default n
endmenu

menu "Dual_screen_avi_player"
	config DUAL_SCREEN_AVI_PLAYER
		depends on AVI_PLAYER
		bool "Enable DUAL_SCREEN_AVI_PLAYER"
		default n
endmenu

menu "BK Smart Config"
	config BK_SMART_CONFIG
		bool "Enable beken sramt config module"
		default y
endmenu

menu "motor"
	config MOTOR
		depends on PWM
		bool "Enable MOTOR"
		default n
endmenu

menu "led_blink"
	config LED_BLINK
		bool "Enable LED_BLINK"
		default n
endmenu

menu "net_transfer"
	config BK_NETWORK_TRANSFER
		bool "Enable BEKEN Network Transfer"
		default y

	config BK_WSS_TRANS
		bool "Enable Beken Websocket Transmit for AI"
		default n

	config BK_WSS_TRANS_NOPSRAM
		bool "Enable Websocket Transmit for AI without PSRAM"
		default n

	config VOLC_ENABLE_VISION_BY_DEFAULT
		bool "Enable visual recognition for volc_rtc by default"
		default n

	config VOLC_ENABLE_SUBTITLE_BY_DEFAULT
		bool "Enable subtitle for volc_rtc by default"
		default n

	config SENSENOVA_ENABLE
		bool "Enable sensenova with aogra by default"
		default n

	config STARTUP_AGENT_FROM_BK_SERVER
		bool "Start agent from BK server if enable, otherwise start agent from Custom-built server"
		default y
endmenu

menu "Audio Engine"
	config BK_AUDIO_ENGINE
		bool "enable audio engine"
		default y

	config AE_AUDIO_FRAME_DURATION_MS
		int "default audio frame duration in ms"
		range 20 60
		default 20

	config AE_AUDIO_ADC_SAMP_RATE
		int "ADC sample rate"
		default 16000

	config AE_AUDIO_DAC_SAMP_RATE
		int "DAC sample rate"
		default 16000

	choice AE_AUDIO_ENCODER
		prompt "Audio encoder type"
		default AE_AUDIO_ENCODER_G722
		config AE_AUDIO_ENCODER_G722
			bool "G722"
			depends on ADK_G722_ENCODER && VOICE_SERVICE_G722_ENCODER
		config AE_AUDIO_ENCODER_G711A
			bool "G711A"
			depends on ADK_G711_ENCODER && VOICE_SERVICE_G711_ENCODER
		config AE_AUDIO_ENCODER_G711U
			bool "G711U"
			depends on ADK_G711_ENCODER && VOICE_SERVICE_G711_ENCODER
		config AE_AUDIO_ENCODER_OPUS
			bool "OPUS"
			depends on ADK_OPUS_ENCODER && VOICE_SERVICE_OPUS_ENCODER
		config AE_AUDIO_ENCODER_PCM
			bool "PCM"
	endchoice

	config AE_AUDIO_ENCODER_TYPE
		string
		default "G722" if AE_AUDIO_ENCODER_G722
		default "G711A" if AE_AUDIO_ENCODER_G711A
		default "G711U" if AE_AUDIO_ENCODER_G711U
		default "OPUS" if AE_AUDIO_ENCODER_OPUS
		default "PCM" if AE_AUDIO_ENCODER_PCM
		default "G722"

	choice AE_AUDIO_DECODER
		prompt "Audio decoder type"
		default AE_AUDIO_DECODER_G722
		config AE_AUDIO_DECODER_G722
			bool "G722"
			depends on ADK_G722_DECODER && VOICE_SERVICE_G722_DECODER
		config AE_AUDIO_DECODER_G711A
			bool "G711A"
			depends on ADK_G711_DECODER && VOICE_SERVICE_G711_DECODER
		config AE_AUDIO_DECODER_G711U
			bool "G711U"
			depends on ADK_G711_DECODER && VOICE_SERVICE_G711_DECODER
		config AE_AUDIO_DECODER_OPUS
			bool "OPUS"
			depends on ADK_OPUS_DECODER && VOICE_SERVICE_OPUS_DECODER
		config AE_AUDIO_DECODER_PCM
			bool "PCM"
	endchoice

	config AE_AUDIO_DECODER_TYPE
		string
		default "G722" if AE_AUDIO_DECODER_G722
		default "G711A" if AE_AUDIO_DECODER_G711A
		default "G711U" if AE_AUDIO_DECODER_G711U
		default "OPUS" if AE_AUDIO_DECODER_OPUS
		default "PCM" if AE_AUDIO_DECODER_PCM
		default "G722"

	config AE_ENABLE_PA_CNTRL
		bool "enable PA control"
		default y

	config AE_PA_CNTRL_GPIO
		int "PA control GPIO"
		depends on AE_ENABLE_PA_CNTRL
		default 50
		range 0 100

	config AE_PA_ON_LEVEL
		int "PA on level"
		depends on AE_ENABLE_PA_CNTRL
		default 1
		range 0 1

	config AE_PA_ON_DELAY
		int "PA on delay in ms"
		depends on AE_ENABLE_PA_CNTRL
		default 10

	config AE_PA_OFF_DELAY
		int "PA off delay in ms"
		depends on AE_ENABLE_PA_CNTRL
		default 30

	config AE_DEFAULT_DIG_GAIN
		hex "audio dac digital gain"
		default 0x16

	config AE_DEFAULT_ANA_GAIN
		hex "audio dac analog gain"
		default 0xA

	config AE_SUPPORT_PROMPT_TONE
		depends on ADK_ONBOARD_SPEAKER_STREAM_SUPPORT_MULTIPLE_SOURCE && PLAYER_SERVICE && BK_AUDIO_ENGINE
		bool "Enable audio engine support playback prompt tone"
		default n

	choice AE_PROMPT_TONE_SOURCE
		depends on AE_SUPPORT_PROMPT_TONE
		prompt "Select audio engine prompt tone Source"
		default AE_PROMPT_TONE_SOURCE_ARRAY

		config AE_PROMPT_TONE_SOURCE_ARRAY
		depends on PLAYER_SERVICE_SUPPORT_ARRAY_STREAM
		bool "Select prompt tone stored in array"

		config AE_PROMPT_TONE_SOURCE_VFS
		depends on PLAYER_SERVICE_SUPPORT_VFS_STREAM
		bool "Select prompt tone stored in vfs file system"
	endchoice

	choice AE_PROMPT_TONE_DECODER_TYPE
		depends on AE_SUPPORT_PROMPT_TONE
		prompt "Select audio engine prompt tone decoder type"
		default AE_PROMPT_TONE_DECODER_WAV

		config AE_PROMPT_TONE_DECODER_PCM
		bool "Select PCM Prompt Tone"

		config AE_PROMPT_TONE_DECODER_MP3
		depends on PLAYER_SERVICE_SUPPORT_MP3_DECODER
		bool "Select MP3 Prompt Tone"

		config AE_PROMPT_TONE_DECODER_WAV
		depends on PLAYER_SERVICE_SUPPORT_WAV_DECODER
		bool "Select WAV Prompt Tone"
	endchoice


endmenu

menu "video_engine"

	config BK_VIDEO_ENGINE
	bool "enable video engine"
	default y
		
	choice VIDEO_ENGINE_USE_CAMERA_TYPE
		prompt "Select video engine use camera type"
		default VIDEO_ENGINE_USE_UVC_CAMERA

		config VIDEO_ENGINE_USE_DVP_CAMERA
		bool "Select DVP camera"
		help
			Select DVP camera

		config VIDEO_ENGINE_USE_UVC_CAMERA
		bool "Select UVC camera"
		help
			Select UVC camera
	endchoice

	choice VIDEO_ENGINE_IMAGE_FORMAT
		prompt "Select video engine image format"
		default VIDEO_ENGINE_JPEG_FORMAT

		config VIDEO_ENGINE_JPEG_FORMAT
		bool "Select JPEG image format"
		help
			Select JPEG image format

		config VIDEO_ENGINE_H264_FORMAT
		bool "Select H264 image format"
		help
			Select H264 image format
	endchoice

	config VIDEO_ENGINE_RESOLUTION_WIDTH
	int "Default size of the width"
	range 1 2000
	default 1280
	help
		Set the size of the resolution width, The recommended value is 1280 .

	config VIDEO_ENGINE_RESOLUTION_HEIGHT
	int "Default size of the height"
	range 1 2000
	default 720
	help
		Set the size of the resolution height, The recommended value is 720 .

	config VIDEO_ENGINE_INIT_ON_BOOT
	bool "Initialize video engine at application boot"
	depends on BK_VIDEO_ENGINE
	default n
	help
		When disabled, video_engine_init() runs only when entering vision mode
		(e.g. ap_cmd sconf vision or IR toggle).

endmenu
```

## projects/ap_powerdown_keepalive/cp/config/bk7259/defconfig
```kconfig
#
# Project default config for bk7259 CP side.
# This file contains only differences compared to board defconfig.
#

CONFIG_SOC_SMP=n
CONFIG_FREERTOS_V10=y
CONFIG_FREERTOS_SMP=n
CONFIG_FREERTOS_USE_TICKLESS_IDLE=2

CONFIG_CLI=y
CONFIG_CLI_TASK_PRIO=4
CONFIG_CLI_TASK_STACK_SIZE=1536
CONFIG_WIFI_CLI_ENABLE=y

CONFIG_AT=y
CONFIG_WIFI_AT_ENABLE=y
CONFIG_BT_AT_ENABLE=y
CONFIG_AT_MAX_PORT_CNT=1

CONFIG_BLUETOOTH=y
CONFIG_BTDM_5_2=y
CONFIG_BTDM_CONTROLLER_ONLY=y
CONFIG_BLUETOOTH_BLE_SLAVE_ONLY=y
CONFIG_BLUETOOTH_BLE_DISCOVER_AUTO=y
CONFIG_BLUETOOTH_SUPPORT_IPC=y

CONFIG_PM_ENABLE=y
CONFIG_PM_SUPER_DEEP_SLEEP=y
CONFIG_PM_ENTER_LV_TIME_OUT_PERIOD_MS=30000
CONFIG_PM_V2=y
CONFIG_PM_LV_SUBCORES_ON=y
CONFIG_PM_AP_POWERDOWN_WHEN_LV=y
CONFIG_LDO_SELF_LOW_POWER_MODE_ENA=y
CONFIG_CPU_DEFAULT_FREQ_60M=y
CONFIG_AON_WDT=n
CONFIG_DEEP_LV=y
CONFIG_DEEP_LV_DEBUG=y

CONFIG_WIFI_ENABLE=y
CONFIG_WIFI_TX_RAW_ENABLE=y
CONFIG_WIFI6_CODE_STACK=y
CONFIG_WIFI4=y
CONFIG_WIFI6=y
CONFIG_WIFI6_IP_DEBUG=y
CONFIG_WIFI_AUTO_COUNTRY_CODE=y
CONFIG_WIFI_SCAN_COUNTRY_CODE=y
CONFIG_WIFI_FAST_CONNECT=y
CONFIG_WIFI_VNET_CONTROLLER=y
CONFIG_WIFI_MAC_SUPPORT_STAS_MAX_NUM=2
CONFIG_STA_PS=y

CONFIG_EASY_FLASH=y
CONFIG_EASY_FLASH_V4=y
CONFIG_FLASH=y
CONFIG_FLASH_QUAD_ENABLE=y
CONFIG_FLASH_MB=y
CONFIG_FLASH_TEST=y
CONFIG_FLASH_PARTITION_CHECK_VALID=y

CONFIG_LWIP=y
CONFIG_LWIP_V2_1=y
CONFIG_LWIP_MEM_TRX_DYNAMIC_EN=y
CONFIG_LWIP_MEM_LIBC_MALLOC=y
CONFIG_LWIP_MEMP_MEM_MALLOC=y
CONFIG_LWIP_MEMP_STATS=y
CONFIG_LWIP_MEM_STATS=y
CONFIG_LWIP_UDP_RECVMBOX_SIZE=24
CONFIG_LWIP_MEM_SIZE=51200
CONFIG_LWIP_MEM_MAX_RX_SIZE=38400
CONFIG_LWIP_MEM_MAX_TX_SIZE=42666
CONFIG_LWIP_TCP_MSS=1400
CONFIG_LWIP_TCP_SND_BUF=21900
CONFIG_LWIP_TCP_WND=21900
CONFIG_LWIP_MEMP_NUM_NETBUF=32
CONFIG_LWIP_PBUF_POOL_SIZE=10
CONFIG_LWIP_TCP_SND_QUEUELEN=40
CONFIG_LWIP_MEMP_NUM_TCP_SEG=80
CONFIG_LWIP_TCP_RTO_TIMEOUT=3000
CONFIG_LWIP_TCP_SYNMAXRTX=6
CONFIG_LWIP_TCP_QUEUE_OOSEQ=y
CONFIG_LWIP_TCPIP_THREAD_STACKSIZE=768

CONFIG_RTC_ANA_WAKEUP_SUPPORT=y
CONFIG_AON_RTC=y
CONFIG_GPIO_WAKEUP_SUPPORT=y
CONFIG_GPIO_DYNAMIC_WAKEUP_SUPPORT=y

CONFIG_PSRAM=y
CONFIG_PSRAM_AS_SYS_MEMORY=y
CONFIG_PSRAM_WRITE_THROUGH=y
CONFIG_PSRAM_CALIBRATE=y
CONFIG_PSRAM_AUTO_DETECT=y

CONFIG_MAILBOX=y
CONFIG_MAILBOX_V2_0=y
CONFIG_MAILBOX_IPC=y

CONFIG_SPINLOCK=y
CONFIG_SPINLOCK_SECTION=y
CONFIG_SPINLOCK_DYNAMIC_CNT=512
CONFIG_SPINLOCK_STATIC_CNT=128
```
