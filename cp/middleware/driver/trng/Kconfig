## projects/bluetooth/dut/ap/config/bk7259_ap/defconfig
```kconfig
#
# BK7259 AP defaults for the Bluetooth DUT test project.
#

# CONFIG_SOC_SMP is not set
# CONFIG_ALL_CODE_IN_PSRAM is not set
CONFIG_BLUETOOTH_AP=y
CONFIG_BLUETOOTH_HOST_ONLY=y
CONFIG_BLUETOOTH_AUTO_ENABLE=y
CONFIG_BLUETOOTH_SUPPORT_IPC=y
CONFIG_BT=y
CONFIG_BLE=y
CONFIG_CLI=y
CONFIG_BLUETOOTH_ENABLE_BT_DUT_TEST=y
CONFIG_FREERTOS_V10=y
# CONFIG_FREERTOS_SMP is not set
CONFIG_FREERTOS_USE_QUEUE_SETS=y

# CONFIG_SPI is not set
# CONFIG_SPI_DMA is not set
CONFIG_GENERAL_DMA=y
CONFIG_GENERAL_DMA_V2P6=y
CONFIG_DMA_LOGIC_CHAN_CNT=4
CONFIG_DMA_LOGIC_CHAN_ID_MIN=4
CONFIG_XTAL_FREQ=12000000
```

## projects/bluetooth/headset/ap/Kconfig.projbuild
```kconfig
menu "Headset Example Configuration"

    config A2DP_SINK_DEMO
        bool "a2dp sink demo"
        depends on BT
        default y

    config HFP_HF_DEMO
        bool "hfp hf demo"
        depends on BT
        default n

    config PBAP_PCE_DEMO
        bool "pbap pce demo"
        depends on BT
        default n
        help
            PBAP PCE (Phone Book Access Profile - Phone Book Client) demo.
            Enables pbap CLI commands for bk_dm_pbap_pce.h API functional testing.
endmenu
```
