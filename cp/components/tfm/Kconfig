## cp/middleware/driver/irda/Kconfig
```kconfig
menu "IRDA"
	config SUPPORT_IRDA
		bool "Enable IRDA"
		default n

	config IRDA_TEST
		depends on SUPPORT_IRDA && DRIVER_TEST
		bool "Enable IRDA TEST"
		default n
endmenu
```

## cp/middleware/driver/lpvad/Kconfig
```kconfig
menu "LPVAD"
	config LPVAD
		bool "Enable LP VAD"
		default y
		depends on SOC_BK7259
endmenu
```

## cp/middleware/driver/mailbox/Kconfig
```kconfig
menu "MAILBOX"
	config MAILBOX
		bool "Enable mail_box"
		default n

	config MAILBOX_V2_0
		bool "Use mailbox v2.0 driver"
		default n

	config MAILBOX_IPC
		bool "Enable mailbox socket ipc driver"
		default y

	config IPC_STRESS_TEST
		depends on MAILBOX_IPC
		bool "Enable cross-core IPC stress test echo server (CP side)"
		default n
		help
			Start a CPU0 echo server on a free server port that echoes payloads
			back to AP-side stress clients. Pairs with the AP "ipc_stress" CLI.
    
    config SLAVE_HEART_BEAT
		depends on MAILBOX
		bool "Enable heartbeat mechanism when dual core communication"
		default n

	config SLAVE_HEART_BEAT_USE_IPI
		depends on SLAVE_HEART_BEAT && IPI
		bool "Use IPI for heartbeat transport"
		default y
		help
			Send heartbeat notifications through IPI_DOMAIN_HEARTBEAT instead of mailbox.
endmenu
```

## cp/middleware/driver/multicore/Kconfig
```kconfig
menu "multicore"
	config SUPPORT_MULTICORE
		bool "Enable multicore"
		default n

	config MULTICORE_TEST
		depends on SUPPORT_MULTICORE && DRIVER_TEST
		bool "Enable multicore test"
		default n

	config CPU_HOTPLUG
		depends on SUPPORT_MULTICORE && SOC_SMP
		bool "Enable CPU Hotplug"
		default y

	config CPU_HOTPLUG_BOOT_OFFLINE
		depends on CPU_HOTPLUG
		bool "Keep secondary hotplug CPU offline at power-on (online via cpu online <id>)"
		default y

	config CPU_HP_GOVERNOR
		depends on CPU_HOTPLUG
		bool "Enable dynamic CPU load governor (auto online/offline CP1)"
		default y

	if CPU_HP_GOVERNOR

		config CPU_HP_GOVERNOR_AUTOSTART
			bool "Start auto-adjust immediately at boot"
			default y

		config CPU_HP_GOVERNOR_UP_THRESHOLD
			int "CP0 load%% above which CP1 is brought online"
			default 80

		config CPU_HP_GOVERNOR_DOWN_THRESHOLD
			int "Combined CP0+CP1 load%% below which CP1 is taken offline"
			default 60

		config CPU_HP_GOVERNOR_LOAD_EMA_DIV
			int "Load EMA divisor (default: 1/2 = 50% weight)"
			default 2

		config CPU_HP_GOVERNOR_PERIOD_MS
			int "Load sampling period (ms)"
			default 100

		config CPU_HP_GOVERNOR_UP_DEBOUNCE
			int "Consecutive overloaded samples required to online CP1"
			default 2

		config CPU_HP_GOVERNOR_DOWN_DEBOUNCE
			int "Consecutive underloaded samples required to offline CP1"
			default 5

		config CPU_HP_GOVERNOR_COOLDOWN_MS
			int "Minimum dwell time after a transition (ms)"
			default 1000
	
	endif

endmenu
```

## cp/middleware/driver/psram/Kconfig
```kconfig
menu "PSRAM"
	config PSRAM
		bool "Enable PSRAM"
		default n

	config PSRAM_AS_SYS_MEMORY
		depends on PSRAM
		bool "Enable psram_malloc API"
		default n

	config USE_PSRAM_HEAP_AT_SRAM_OOM
		depends on PSRAM_AS_SYS_MEMORY
		bool "Fallback to PSRAM heap when SRAM heap is exhausted"
		help
		  When SRAM heap allocation fails, retry the allocation from the
		  PSRAM heap so os_malloc can still succeed.
		default n

	config PSRAM_WRITE_THROUGH
		depends on PSRAM
		bool "Enable PSRAM write through"
		default n

	config PSRAM_CALIBRATE
		depends on PSRAM
		bool "Enable PSRAM calibrate"
		default n

	config PSRAM_INTERLEAVE
		depends on PSRAM
		bool "Enable PSRAM interleave mode"
		help
		  Interleave mode: merge two PSRAMs into one virtual PSRAM via virtual address 0x80000000.
		  Data is arranged as: psram0:0-255 | psram1:0-255 | psram0:256-511 | psram1:256-511 | ...
		  Interleave granularity can be 32/64/128/256 bytes. Default is 256 bytes.
		default n

	config PSRAM_INTERLEAVE_OFFSET
		depends on PSRAM_INTERLEAVE
		hex "PSRAM interleave offset"
		help
		  Interleave virtual address offset.
		default 0x20000000

	config PSRAM_INTERLEAVE_STEP
		depends on PSRAM_INTERLEAVE
		int "PSRAM interleave step (0=256B 1=128B 2=64B 3=32B)"
		help
		  Hardware interleave block size. 0=256 bytes, 1=128 bytes, 2=64 bytes, 3=32 bytes.
		  Must match AP/ram_regions if AP uses interleave PSRAM.
		default 0
		range 0 3

	config PSRAM_AUTO_DETECT
		depends on PSRAM && EASY_FLASH && EASY_FLASH_V4
		bool "Enable PSRAM id auto detect function"
		default n

	config PSRAM_TEST
		depends on CLI && PSRAM
		bool "Enable Psram Test"
		default n

	config PSRAM_CAPACITY_32M
		depends on PSRAM
		bool "Use 32M PSRAM layout (ram_regions_32M.csv)"
		default n
		help
			Select the 32MB PSRAM map (high 16MB reserved per chip).
			Save as project default ([D] in menuconfig) or pass
			PSRAM_CAPACITY=32M on the make command line. Images go to
			build/<soc>/<project>_psram32M/ (combined with FLASH_CAPACITY
			suffix, e.g. app_16M_psram32M) so they do not overwrite
			the 16M package.

endmenu
```

## cp/middleware/driver/pwm/Kconfig
```kconfig
menu "PWM"
	config PWM
		bool "Enable pwm"
		default n

	config PWM_PM_CB_SUPPORT
		bool "PWM PM Support"
		default n

	config PWM_PHASE_SHIFT
		bool "PWM phase shift Support"
		default n

	config PWM_FADE
		bool "PWM fade mode support"
		default n

	config PWM_TEST
		depends on PWM && DRIVER_TEST
		bool "Enable pwm test"
		default y

endmenu
```

## cp/middleware/driver/qspi/Kconfig
```kconfig
menu "QSPI"
	config QSPI
		bool "Enable QSPI"
		default n

	config QSPI_STATIS
		bool "Enable QSPI Statis"
		default n

	config QSPI_MST_PSRAM
		bool "Enable QSPI PSRAM"
		depends on QSPI
		default n

	choice
		prompt "QSPI Flash type"
		optional
		depends on QSPI
		help
			Select NOR or NAND for the QSPI master flash. They are mutually
			exclusive; leave unselected if QSPI flash is not used.
			NOR and NAND share the same bk_qspi_flash_* API and only one driver
			is linked at a time. If both are force-enabled outside this choice,
			NAND takes precedence.

		config QSPI_NOR_FLASH
			bool "Enable QSPI NOR Flash"
			help
				BEKEN Chip sets QSPI interface as a master device, the slave device is a NOR flash,
				then BEKEN Chip can access the flash with QSPI interface.
				The application can read/writes data to flash directly by QSPI Flash API,
				or reads/writes by file system API if enable relates macro, I.E. CONFIG_FATFS, CONFIG_LITTLEFS, CONFIG_VFS...

		config QSPI_NAND_FLASH
			bool "Enable QSPI NAND Flash"
	endchoice

	config QSPI_NAND_FLASH_SIZE
		hex "NAND Flash Size (Bytes)"
		depends on QSPI_NAND_FLASH
		default 0x8000000
		help
			Set the total size of the SPI NAND Flash in bytes.
			Default is 128MB (0x8000000).

	config QSPI_TEST
		depends on QSPI && DRIVER_TEST
		bool "Enable qspi test"
		default n

	config QSPI_LINE_MODE
		int "qspi line mode choose"
		range 1 8
		default 4
		help
		The value should be changed if need to change qspi line mode
endmenu
```

## cp/middleware/driver/saradc/Kconfig
```kconfig
menu "SARADC"
	config SARADC
		bool "Enable saradc"
		default y
	config SARADC_INIT
		depends on SARADC
		bool "Enable saradc init"
		default y

	config SARADC_SERVER
		bool "Enable SARADC server"
		depends on SARADC
		default y

	config SARADC_NEED_FLUSH
		bool "SARADC whether need flush data"
		default y

	config SARADC_RANGE_DIVIDE
		bool "Enable saradc measure range divide"
		default n

	config SARADC_PM_CB_SUPPORT
		bool "saradc pm support"
		depends on SARADC
		default n

	config ADC_SAMPLE_CAPACITY_CNT
		int "config adc receive sample count"
		default 32

	config ADC_BUF_SIZE
		int "config adc receive buffer size"
		default 32

	choice SARADC_VERSION
		prompt "ASIC SARADC IP Version"
		default SARADC_V1P1

		config SARADC_V1P1
			bool "SARADC_V1P1"
			help
				ASIC SARADC Version ID: V1.1

		config SARADC_V1P2
			bool "SARADC_V1P2"
			help
				ASIC SARADC Version ID: V1.2
	endchoice

	config SARADC_V1P2_COMPATIBLE_MODE
		bool "Enable v1p2 compatible mode, and adapte the compatible interfaces"
		depends on SARADC_V1P2
		default n
		
	config SARADC_TEST
		depends on SARADC && DRIVER_TEST
		bool "Enable saradc test"
		default y

	config SADC_API_TEST
		bool "saradc api test"
		depends on SARADC
		default n

	config SARADC_REVISION
		bool "revision raw data"
		depends on SARADC
		default n

	config ADC_API_TEST
		depends on SARADC
		bool "Enable adc api test"
		default n

	config SARADC_MB
		bool "Enable SARADC mailbox"
		depends on SARADC
		default n
	
	config CLI_SARADC_TEST
		bool "Enable saradc test"
		default n

	choice SARADC_VERSION
		prompt "ASIC SARADC IP Version"
		default SARADC_V1P2

		config SARADC_V1P1
			bool "SARADC_V1P1"
			help
				ASIC SARADC Version ID: V1.1

		config SARADC_V1P2
			bool "SARADC_V1P2"
			help
				ASIC SARADC Version ID: V1.2
	endchoice
endmenu	
```

## cp/middleware/driver/scr/Kconfig
```kconfig
menu "SCR"
	config SCR
		bool "Enable smart_card_reader"
		default n

	config SCR_TEST
		depends on SCR && DRIVER_TEST
		bool "Enable smart_card_reader test"
		default n
endmenu
```

## cp/middleware/driver/spi/Kconfig
```kconfig
menu "SPI"
    #TODO optimize SPI_DMA and GENERAL_DMA when optimize driver
	config SPI
		bool "SPI ENABLE"
		default y

	config SOC_SPI_UNIT_NUM
		int "Number of SPI units (1-4)"
		depends on SPI
		range 1 4
		default 2
		help
			Number of SPI units supported by the hardware.
			Valid values: 1, 2, 3, or 4.

	config SPI_DMA
		bool "Enable SPI DMA"
		default y

	config SPI_STATIS
		bool "Enable SPI Statis"
		default y

	config SPI_SUPPORT_TX_FIFO_WR_READY
		bool "Support TX FIFO Write Ready"
		default y

	config SPI_MST_FLASH
		bool "SPI MST Flash"
		default n

	config SPI_MST_PSRAM
		bool "SPI MST PSRAM"
		default n

	config SPI_PM_CB_SUPPORT
		bool "SPI PM Support"
		default n

	config SPI_BYTE_INTERVAL
		bool "SPI byte interval"
		default n

	config SPI_TEST
		depends on SPI && DRIVER_TEST
		bool "Enable spi test"
		default n

	config SPI_API_TEST
		depends on SPI && DRIVER_TEST
		bool "Enable spi_api test"
		default n

endmenu
```

## cp/middleware/driver/sys_sw_regs/Kconfig
```kconfig
menu "SYS_SW_REGS"
	config SYS_SW_REGS
		bool "Enable SYS_SW_REGS"
		default y
endmenu
```

## cp/middleware/driver/timer/Kconfig
```kconfig
menu "TIMER"
	config TIMER
		bool "Enable TIMER"
		default y

	config TIMER_COUNTER
		bool "Enable timer counter"
		default y

	config TIMER_SUPPORT_ID_BITS
		int "timer support id bits"
		range 0 4095
		default 0
		help
		Bitmask of supported timer IDs. 0 means all IDs are supported.
		For 12 channels use 4095 (0xFFF).

	config TIMER_US
		bool "Enable timer0 as microsecond timer"
		default n

	config TIMER_PM_CB_SUPPORT
		bool "Enable TIMER enter low voltage callback support"
		default n

	config TIMER_TEST
		depends on TIMER && DRIVER_TEST
		bool "Enable timer test"
		default y
endmenu
```

## cp/middleware/driver/touch/Kconfig
```kconfig
menu "TOUCH"
	config TOUCH
		bool "Enable TOUCH"
		default n
	config TOUCH_INTERNAL_SERIAL_CAP
		bool "Enable TOUCH INTERNAL SERIAL CAP"
		default n
	config TOUCH_PM_SUPPORT
		bool "Enable TOUCH PM SUPPORT"
		default n
	config TOUCH_TEST
		depends on TOUCH && DRIVER_TEST
		bool "Enable Touch Test"
		default n
endmenu
```
