## cp/components/tfm/Kconfig
```kconfig
menu "TFM (Trusted Firmware-M)"

config TFM
    bool "Enable TF-M secure firmware (TrustZone-M SPE)"
    default n
    help
        Build Trusted Firmware-M (TF-M 2.1.0 baseline) as the secure world
        (SPE) on the CP (M52). Enables BL2 (MCUboot) secure boot and the
        secure partition manager. Requires CONFIG_PSA_MBEDTLS.

config SECURITY_FIRMWARE
    bool "Build security firmware (signed image + secure pack)"
    default n
    help
        Master switch that makes the build produce a signed/secure-packed
        firmware via beken_utils (BL2 + tfm_s + primary_all). Read by the
        board wrapper (bk7259.wrapper) to select the secure pack path.

menu "TF-M Options"
    depends on TFM

config TFM_PROFILE
    string "TF-M profile"
    default "profile_medium"

config TFM_BUILD_TYPE
    string "TF-M cmake build type"
    default "minsizerel"

config TFM_BL2
    string "Build BL2 (MCUboot)"
    default "ON"

config TFM_BL2_DOWNLOAD
	bool "Enable BL2 download"
	default y
	help
		Enable BL2 Download

config TFM_ISOLATION_LEVEL
    int "TF-M isolation level (1/2/3)"
    default 2

config TFM_TEST_S
    string "Build TF-M secure tests"
    default "OFF"

config TFM_TEST_NS
    string "Build TF-M non-secure tests"
    default "OFF"

config TFM_FPGA
    string "TF-M FPGA target"
    default "OFF"

config TFM_LOG_LEVEL
    string "TF-M secure log level"
    default "INFO"

config TFM_BL2_LOG_LEVEL
    string "BL2/MCUboot log level"
    default "INFO"

config TFM_HEAP_SIZE
    hex "TF-M heap size"
    default 0x6000

config BL2_UPGRADE_STRATEGY
    string "MCUboot upgrade strategy"
    default "DIRECT_XIP"

config DEBUG_OTA_INSTALL
    bool "DEBUG: overwrite install erase/write read-back checks"
    default n
    help
        Debug-only OVERWRITE_ONLY checks (default off):
        erase 0xFF read-back + CBUS write round-trip compare.
        Production relies on whole-image hash. Enable with:
        CONFIG_DEBUG_OTA_INSTALL=y

config XIP_NO_VERSION
    bool "XIP image without version header"
    default y

config TFM_CRYPTO
    bool "Enable TF-M Crypto partition (PSA Crypto)"
    default y

config TFM_PS
    bool "Enable TF-M Protected Storage partition"
    default n

config TFM_FWU
    bool "Enable TF-M Firmware Update partition"
    default n

config INITIAL_ATTESTATION
    bool "Enable TF-M Initial Attestation"
    default n

config TFM_REG_ACCESS_NSC
    bool "Enable NSC register access gateway (psa_reg_read/write)"
    default n
    help
        Beken ARMv8-M CMSE non-secure-callable (NSC) register access. When set,
        the secure world builds reg_nsc.c and exports psa_reg_read/psa_reg_write/
        psa_reg_dump into libtfm_s_veneers.a so the non-secure cpu0_app can reach
        registers through the secure world. Forwarded to the TF-M build as
        CONFIG_REG_ACCESS_NSC.

config TFM_AP_BOOT_NSC
    bool "Enable NSC AP secure-prepare gateway (psa_ap_secure_prepare)"
    default n
    help
        Let the CP Non-Secure power manager own the AP start sequence while TF-M
        performs only the Secure-privilege steps through a narrow NSC. When set,
        the secure world exports psa_ap_secure_prepare / psa_ap_secure_cancel /
        psa_ap_secure_boot_addr into libtfm_s_veneers.a. CP NS drives AON PMU,
        analog high-voltage domain, AP power-on and the AP SYS/AHBP registers
        (via the NS alias) and releases the AP core reset; the NSC only applies
        the AP MPC/PPHS, installs the verified boot shim and opens the Secure
        PPRO master gate. Forwarded to the TF-M build as CONFIG_AP_BOOT_NSC.

config TFM_AP_CACHE_NSC
    bool "Enable resident AP Secure L2 cache gateway"
    depends on TFM_AP_BOOT_NSC
    default n
    help
        Add a fixed Non-Secure Callable entry to the resident AP Secure boot
        shim. AP Non-Secure software can request PL310 clean-all,
        invalidate-all or clean-and-invalidate-all operations without
        receiving direct access to the PL310 register window. Forwarded to the
        TF-M build as CONFIG_AP_CACHE_NSC.

config TFM_SLEEP_RETENTION_NSC
    bool "Enable TF-M sleep secure context retention"
    depends on SOC_BK7259
    default n
    help
        Build a fixed TF-M security-boundary retention snapshot at cold boot
        and restore it from tfm_s Reset_Handler on sleep fast-boot wake.
        Sleep entry performs no register scan. Forwarded to the TF-M build as
        CONFIG_SLEEP_RETENTION_NSC.

config TFM_ENCP_NSC
    bool "Enable TE200 quiesce/resume NSC gateways"
    depends on SOC_BK7259 && TFM_CRYPTO && TFM_SLEEP_RETENTION_NSC
    default y if TFM_CRYPTO
    help
        Expose psa_encp_quiesce()/psa_encp_resume() to the NS cpu0_app so it can
        hand the TrustEngine over before a Low-Voltage sleep and ask the Secure
        world to rebuild it after wake. Required because the WRLP_ENCP domain
        (TE200 + OTP + WiFi/BT) is powered off in both LV and deep sleep.
        Forwarded to the TF-M build as CONFIG_ENCP_NSC.

config TFM_AP_SHIM_L2_CACHE_DISABLE
    bool "Disable AP L2 (PL310) init in the AP boot shim"
    depends on SOC_BK7259
    default n
    help
        When set, the secure AP boot shim skips the shared L2 (PL310) cache
        initialization entirely and boots the AP with L2 left disabled. For
        bring-up/debug of SRAM windows or PM paths where the L2 config is
        suspected. Forwarded to the TF-M build as CONFIG_TFM_AP_SHIM_L2_CACHE_DISABLE.

config TFM_OTP_NSC
    bool "Enable NSC OTP access gateway (read/write secure OTP1/OTP2)"
    default n
    help
        Beken ARMv8-M CMSE non-secure-callable (NSC) OTP access. When set, the
        secure world builds the secure OTP driver (otp_s.c) and the gateways
        (otp_nsc.c) and exports bk_otp_read_nsc / bk_otp_update_nsc /
        bk_otp_read_permission_nsc / bk_otp_write_permission_nsc /
        bk_otp_write_mask_nsc into libtfm_s_veneers.a, so the non-secure
        cpu0_app can read/write OTP banks owned by the secure world. Forwarded
        to the TF-M build as CONFIG_OTP_NSC.

config TFM_BOOTLOADER_VERSION_NSC
    bool "Enable NSC bootloader-version gateway (bk_bootloader_version_nsc)"
    default y
    help
        Beken ARMv8-M CMSE non-secure-callable (NSC) access to the BL2 version
        stamp stored at the tail of the BL2 manifest slot. The manifest lives in
        the flash region TF-M marks Secure on the DBUS, so the non-secure
        cpu0_app cannot read it directly. When set, the secure world builds
        bootloader_nsc.c and exports bk_bootloader_version_nsc into
        libtfm_s_veneers.a. Forwarded to the TF-M build as
        CONFIG_BOOTLOADER_VERSION_NSC.

endmenu # TF-M Options

endmenu # TFM
```

## cp/components/utf8/Kconfig
```kconfig
# KCONFIG_GROUP: System Services::Utilities & Libraries::UTF-8
menu "utf8"
	config USE_CONV_UTF8
		bool "Enable UTF8"
		default y
endmenu
```

## cp/components/wfa_ca/Kconfig
```kconfig
menu "modules::wfa_ca"
	config WFA_CA
		bool "Enable WFA CA"
		default n
	config WFA_WMM_THREAD_PRIO
		bool "enable priority of wmm task"
		default n
	config WMM_FC
		bool "Enable WMM Flow control"
		default y
endmenu
```

## cp/middleware/arch/mpu/Kconfig
```kconfig
menu "Arch::MPU"
	config MPU
		bool "Enable Memory Protect Unit Feature"
		default n
endmenu
```

## cp/middleware/boards/bk7258/vnd_cal/Kconfig
```kconfig
menu "VENDOR CAL CONFIG"
	config VND_CAL
		bool "Enable vendor cal"
		default n

	config OVERRIDE_VND_CAL
		bool "Enable Override vnd_cal"
		default y

	config BLE_USE_HIGH_POWER_LEVEL
		bool "Enable high power level"
		default n

	config EPA_ENABLE_FLAG
		bool "Enable epa"
		default n
endmenu
```

## cp/middleware/driver/Kconfig
```kconfig
menu "SoC Low-level Drivers"
	menu "System Control"
	source "${ARMINO_PATH}/middleware/driver/common/Kconfig"
	source "${ARMINO_PATH}/middleware/driver/device/Kconfig"
	source "${ARMINO_PATH}/middleware/driver/sys_ctrl/Kconfig"
	source "${ARMINO_PATH}/middleware/driver/icu/Kconfig"
	source "${ARMINO_PATH}/middleware/driver/reset_reason/Kconfig"
	source "${ARMINO_PATH}/middleware/driver/chip_support/Kconfig"
	source "${ARMINO_PATH}/middleware/driver/dbg_probe/Kconfig"
	source "${ARMINO_PATH}/middleware/driver/sys_sw_regs/Kconfig"
	endmenu

	menu "Bus & IO"
	source "${ARMINO_PATH}/middleware/driver/uart/Kconfig"
	source "${ARMINO_PATH}/middleware/driver/gpio/Kconfig"
	source "${ARMINO_PATH}/middleware/driver/i3c/Kconfig"
	source "${ARMINO_PATH}/middleware/driver/lin/Kconfig"
	source "${ARMINO_PATH}/middleware/driver/scr/Kconfig"
	source "${ARMINO_PATH}/middleware/driver/hspl/Kconfig"
	source "${ARMINO_PATH}/middleware/driver/pwm/Kconfig"
	endmenu

	menu "Inter-core & Sync"
	source "${ARMINO_PATH}/middleware/driver/multicore/Kconfig"
	source "${ARMINO_PATH}/middleware/driver/mailbox/Kconfig"
	source "${ARMINO_PATH}/middleware/driver/ipi/Kconfig"
	source "${ARMINO_PATH}/middleware/driver/spinlock/Kconfig"
	endmenu

	menu "Storage & DMA"
	source "${ARMINO_PATH}/middleware/driver/flash/Kconfig"
	source "${ARMINO_PATH}/middleware/driver/general_dma/Kconfig"
	source "${ARMINO_PATH}/middleware/driver/psram/Kconfig"
	endmenu

	menu "Analog & Audio HW"
	source "${ARMINO_PATH}/middleware/driver/i2s/Kconfig"
	source "${ARMINO_PATH}/middleware/driver/saradc/Kconfig"
	source "${ARMINO_PATH}/middleware/driver/sdmadc/Kconfig"
	source "${ARMINO_PATH}/middleware/driver/fft/Kconfig"
	source "${ARMINO_PATH}/middleware/driver/sbc/Kconfig"
	source "${ARMINO_PATH}/middleware/driver/lpvad/Kconfig"
	source "${ARMINO_PATH}/middleware/driver/xdac/Kconfig"
	endmenu

	menu "Display & Media HW"
	source "${ARMINO_PATH}/middleware/driver/touch/Kconfig"
	endmenu

	menu "Power & Clock HW"
	source "${ARMINO_PATH}/middleware/driver/pmu/Kconfig"
	source "${ARMINO_PATH}/middleware/driver/pwr_clk/Kconfig"
	source "${ARMINO_PATH}/middleware/driver/rtc/Kconfig"
	source "${ARMINO_PATH}/middleware/driver/calendar/Kconfig"
	source "${ARMINO_PATH}/middleware/driver/timer/Kconfig"
	source "${ARMINO_PATH}/middleware/driver/ckmn/Kconfig"
	source "${ARMINO_PATH}/middleware/driver/wakeup/Kconfig"
	endmenu

	menu "Security & Fuse"
	source "${ARMINO_PATH}/middleware/driver/otp/Kconfig"
	source "${ARMINO_PATH}/middleware/driver/efuse/Kconfig"
	endmenu

	menu "Connectivity PHY"
	source "${ARMINO_PATH}/middleware/driver/phy/Kconfig"
	source "${ARMINO_PATH}/middleware/driver/irda/Kconfig"
	endmenu

	menu "Watchdog"
	source "${ARMINO_PATH}/middleware/driver/wdt/Kconfig"
	source "${ARMINO_PATH}/middleware/driver/aon_wdt/Kconfig"
	source "${ARMINO_PATH}/middleware/driver/wwdt/Kconfig"
	endmenu
endmenu
```

## cp/middleware/driver/common/Kconfig
```kconfig
config DRIVER_TEST
	bool "Enable Peripheral Test"
	default y

config INIT_EXPORT_WITH_NAME
	bool "Enable Device Name"
	default n

config SUPPORT_INIT_EXPORT
	bool "Enable The Feature of Init Export"
	default n
```

## cp/middleware/driver/efuse/Kconfig
```kconfig
menu "EFUSE"
	config EFUSE
		bool "Enable efuse"
		default y

	config EFUSE_TEST
		depends on EFUSE && DRIVER_TEST
		bool "Enable efuse test"
		default y
endmenu
```

## cp/middleware/driver/flash/Kconfig
```kconfig
menu "FLASH"
	config FLASH
		bool "Enable flash"
		default y

	config FLASH_QUAD_ENABLE
		bool "Enable flash quad enable"
		default n

	config FLASH_CLK
		int "flash clk,recommend value:80000000, unit:Hz. If not set, the flash clock will be configured by XTAL"
		range 26000000 120000000
		default 80000000

	config FLASH_SRC_CLK_60M
		bool "Enable flash source clock 60M,used in property document.If not set, the flash clock will be configured by CONFIG_FLASH_CLK"
		default n

	config FLASH_TEST
		depends on FLASH
		bool "Enable flash test"
		default y

	config PARTITION_TEST
		depends on FLASH
		bool "Enable pattition test"
		default y

	config FLASH_API_TEST
		depends on FLASH
		bool "Enable flash_api test"
		default n

	config FLASH_CLEAR_RD_RESIDUAL
		depends on FLASH
		bool "Enable The Feature of Clearing Read Residual Data"
		default n

	config FLASH_PARTITION_CHECK_VALID
		depends on FLASH
		bool "Enable flash driver check write permission and address range"
		default y

	config FLASH_BYPASS
		bool "enable flash bypass"
		default n

	config FLASH_BYPASS_OTP_OPERATION
		bool "Bypass flash to operate otp in flash"
		default n

	config PARTITION_OP_BY_NAME
		depends on FLASH
		bool "Enable flash partition operation by name"
		default n

	config FLASH_MONITER
			bool "Enable flash moniter"
			default n

	config SYS_CTRL_FLASH_LINE_MODE
		bool "Use system bit to resume flash line mode"
		default n

	config FLASH_API_TEST
		depends on FLASH
		bool "Enable flash_api test"
		default n
		help
			Enable flash_api test.

	config FLASH_CAPACITY_16M
		bool "Use 16M flash partition table (auto_partitions_16M.csv)"
		default n
		help
			Select the 16M partition layout (sys_rf/sys_net at 0xFFE000/0xFFF000).
			Save as project default ([D] in menuconfig) or pass FLASH_CAPACITY=16M
			on the make command line. Images are stored in build/<soc>/<project>_16M/
			so they do not overwrite the 8M package.
endmenu
```

## cp/middleware/driver/general_dma/Kconfig
```kconfig
menu "GENERAL_DMA"
	config GENERAL_DMA
		bool "Enable General DMA"
		default y

	choice GENERAL_DMA_VERSION
		prompt "DMA Driver Version"
		default GENERAL_DMA_V2P6
		help
		  Select the DMA driver version to use.
		  
		config GENERAL_DMA_V2P6
			bool "DMA v2p6"
			help
			  Use DMA driver version 2p6.
			  
		config GENERAL_DMA_V2PX
			bool "DMA v2px"
			help
			  Use DMA driver version 2px (for BK7258 project).
	endchoice

	config GENERAL_DMA_LINK_MODE
		depends on GENERAL_DMA_V2P6
		bool "Enable DMA linked list mode"
		default y
		help
		  Enable DMA linked list transfer mode support.
		  This feature allows DMA to transfer data using descriptor linked lists.

	config DMA_LOGIC_CHAN_CNT
		int "DMA logic channel count"
		default 4
		help
		  Current CPU-CORE software system uses how many dma-logic-channels.
		  Total of all CPU-COREs dma logic chan count should be not bigger than total dma hardware supported channels.

	config DMA_LOGIC_CHAN_ID_MIN
		int "DMA logic channel ID minimum"
		default 0
		help
		  Current CPU-CORE software system min dma-logic-channel-id.
		  Be careful not to overlap with other CPU-CORE software system's dma-logic-channel-id.
		  The value should be set like this:
		    CPU0 is from 0
		    CPU1 is from CPU0_DMA_LOGIC_CHAN_CNT

	config GENERAL_DMA_TEST
		depends on GENERAL_DMA
		bool "Enable general dma test"
		default n
endmenu
```

## cp/middleware/driver/hspl/Kconfig
```kconfig
menu "HSPL"
	config HSPL
		bool "Enable HSPL (Hardware Spin Lock)"
		default y
		help
			Enable HSPL hardware spinlock driver.

	config HSPL_TEST
		depends on HSPL && DRIVER_TEST
		bool "Enable HSPL test"
		default n
		help
			Enable HSPL driver CLI test commands.

	config HSPL_LEAK_DEBUG
		depends on HSPL
		bool "Enable HSPL leak debug before AP powerdown"
		default n
		help
			Read the AP HSPL owner shadow from shared memory and assert before
			AP powerdown if AP still owns a lock.

	config HSPL_MUST_LOCK_TIMEOUT_MS_DEFAULT
		depends on HSPL
		int "must_lock timeout for non-FLASH resources (ms)"
		range 0 60000
		default 500
		help
			Timeout for all HSPL resources except FLASH. 0 means wait forever.

	config HSPL_MUST_LOCK_TIMEOUT_MS_FLASH
		depends on HSPL
		int "must_lock timeout for FLASH resource (ms)"
		range 0 5000
		default 5000
		help
			FLASH erase/program may take longer; max 5000 ms. 0 means wait forever.
endmenu
```

## cp/middleware/driver/ipi/Kconfig
```kconfig
menu "IPI"
	config IPI
		bool "Enable IPI (Inter-Processor Interrupt)"
		default y
		help
			Enable IPI driver for inter-core communication.
			IPI allows different CPU cores to send interrupts to each other.

	config IPI_TEST
		depends on IPI && DRIVER_TEST
		bool "Enable IPI test"
		default n
		help
			Enable IPI driver test cases.
endmenu
```
