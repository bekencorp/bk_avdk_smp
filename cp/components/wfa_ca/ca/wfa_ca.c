/****************************************************************************
 *  (c) Copyright 2007 Wi-Fi Alliance.  All Rights Reserved
 *
 *
 *  LICENSE
 *
 *  License is granted only to Wi-Fi Alliance members and designated
 *  contractors ($B!H(BAuthorized Licensees$B!I(B)..AN  Authorized Licensees are granted
 *  the non-exclusive, worldwide, limited right to use, copy, import, export
 *  and distribute this software:
 *  (i) solely for noncommercial applications and solely for testing Wi-Fi
 *  equipment; and
 *  (ii) solely for the purpose of embedding the software into Authorized
 *  Licensee$B!G(Bs proprietary equipment and software products for distribution to
 *  its customers under a license with at least the same restrictions as
 *  contained in this License, including, without limitation, the disclaimer of
 *  warranty and limitation of liability, below..AN  The distribution rights
 *  granted in clause
 *  (ii), above, include distribution to third party companies who will
 *  redistribute the Authorized Licensee$B!G(Bs product to their customers with or
 *  without such third party$B!G(Bs private label. Other than expressly granted
 *  herein, this License is not transferable or sublicensable, and it does not
 *  extend to and may not be used with non-Wi-Fi applications..AN  Wi-Fi Alliance
 *  reserves all rights not expressly granted herein..AN
 *.AN
 *  Except as specifically set forth above, commercial derivative works of
 *  this software or applications that use the Wi-Fi scripts generated by this
 *  software are NOT AUTHORIZED without specific prior written permission from
 *  Wi-Fi Alliance.
 *.AN
 *  Non-Commercial derivative works of this software for internal use are
 *  authorized and are limited by the same restrictions; provided, however,
 *  that the Authorized Licensee shall provide Wi-Fi Alliance with a copy of
 *  such derivative works under a perpetual, payment-free license to use,
 *  modify, and distribute such derivative works for purposes of testing Wi-Fi
 *  equipment.
 *.AN
 *  Neither the name of the author nor "Wi-Fi Alliance" may be used to endorse
 *  or promote products that are derived from or that use this software without
 *  specific prior written permission from Wi-Fi Alliance.
 *
 *  THIS SOFTWARE IS PROVIDED BY WI-FI ALLIANCE "AS IS" AND ANY EXPRESS OR
 *  IMPLIED WARRANTIES, INCLUDING, BUT NOT LIMITED TO, THE IMPLIED WARRANTIES
 *  OF MERCHANTABILITY, NON-INFRINGEMENT AND FITNESS FOR A.AN PARTICULAR PURPOSE,
 *  ARE DISCLAIMED. IN NO EVENT SHALL WI-FI ALLIANCE BE LIABLE FOR ANY DIRECT,
 *  INDIRECT, INCIDENTAL, SPECIAL, EXEMPLARY, OR CONSEQUENTIAL DAMAGES
 *  (INCLUDING, BUT NOT LIMITED TO, THE COST OF PROCUREMENT OF SUBSTITUTE
 *  GOODS OR SERVICES; LOSS OF USE, DATA, OR PROFITS; OR BUSINESS INTERRUPTION)
 *  HOWEVER CAUSED AND ON ANY THEORY OF LIABILITY, WHETHER IN CONTRACT,
 *  STRICT LIABILITY, OR TORT (INCLUDING NEGLIGENCE) ARISING IN ANY WAY OUT OF
 *  THE USE OF THIS SOFTWARE, EVEN IF ADVISED OF THE POSSIBILITY OF SUCH DAMAGE.
 ******************************************************************************
 */


/*
 * File: wfa_ca.c
 *       This is the main program for Control Agent.
 *
 * Revision History:
 *   2006/06/01 -- BETA Release by qhu
 *   2006/06/13 -- 00.02 Release by qhu
 *   2006/06/30 -- 00.10 Release by qhu
 *   2006/07/10 -- 01.00 Release by qhu
 *   2006/09/01 -- 01.05 Release by qhu
 *   2007/01/11 -- 01.10 released by qhu
 *   2007/02/15 -- WMM beta released by qhu, mkaroshi
 *   2007/03/21 -- 01.40 WPA2 and Official WMM Beta release by qhu
 *   2007/04/20 -- 02.00 WPA2 and Official WMM release by qhu
 *   2007/08/15 --  02.10 WMM-Power Save release by qhu
 *   2007/10/10 --  02.20 Voice SOHO beta -- qhu
 *   2007/11/07 -- 02.30 Voice HSO -- qhu
 *      -- on the calls wfaCtrlSend(), the string len is replaced with strlen()
 *   2007/12/10 -- 02.32 update -- qhu
 *   2008/02/11 -- fix the BUG #5, instead of using done/break (suggested),
 *                 continue is used here.
 */

#include <stdio.h>      /* for printf() and fprintf() */
//#include <sys/socket.h> /* for socket(), connect(), send(), and recv() */
//#include <arpa/inet.h>  /* for sockaddr_in and inet_addr() */
#include <stdlib.h>     /* for atoi() and exit() */
#include <string.h>     /* for memset() */
//#include <unistd.h>     /* for close() */
//#include <sys/select.h>

#include "wfa_portall.h"
#include "pthread.h"
#include "wfa_debug.h"
#include "wfa_utils.h"
#include "wfa_main.h"
#include "wfa_types.h"
#include "wfa_tlv.h"
#include "wfa_tg.h"
#include "wfa_cmds.h"
#include "wfa_miscs.h"
#include "wfa_sock.h"
#include "wfa_ca.h"
#include "wfa_agtctrl.h"
#include "wfa_rsp.h"
#include "wfa_agt.h"
#include "wfa_dut_param.h"
#include <os/str.h>
#include <driver/uart.h>
#include "os/mem.h"

//Import from Sigma_DUT.sh
#define WFA_ENV_AGENT_IPADDR "WFA_ENV_AGENT_IPADDR"

#define TG_APPLICATION_PRIORITY 4
extern int xcCmdProcGetVersion(unsigned char *parms);
extern dutCommandRespFuncPtr wfaCmdRespProcFuncTbl[];
extern xcCommandFuncPtr gWfaCmdFuncTbl[];
extern typeNameStr_t nameStr[];
extern char gRespStr[];
extern BYTE   *trafficBuf;
extern BYTE   *respBuf;
dutCmdResponse_t gGenericResp;
int gSock = -1, tmsockfd, gCaSockfd = -1, gxcSockfd = -1,xcSockfd, gSerialfd;
//int gtgSend, gtgRecv, gtgTransac /* streamid*/;
char gnetIf[32] = "any";
tgStream_t *theStreams;
long itimeout = 0;

/* ========================
 * Thread Synchronize flags
 =========================*/
tgWMM_t wmm_thr[WFA_THREADS_NUM];

extern void wfa_wmm_thread(void *thr_param);
extern void *wfa_wmmps_thread();
extern int wfa_estimate_timer_latency();

// stream table
extern tgStream_t gStreams[]; // streams' buffers

// WMM traffic streams socket fds - Socket Handler table
extern int tgSockfds[];

extern int adj_latency;

unsigned short wfa_defined_debug = WFA_DEBUG_ERR | WFA_DEBUG_WARNING | WFA_DEBUG_INFO;
unsigned short dfd_lvl = WFA_DEBUG_DEFAULT | WFA_DEBUG_ERR | WFA_DEBUG_INFO;

char ssid_sta[WFA_SSID_NAME_LEN];

/*
 * the output format can be redefined for file output.
 */
//MBO
int Ch_Pref_Flag = 0;

int Ch_Op_Class1 = 0;
int Ch_Pref_Num1 = 0;
int Ch_Pref1 = 0;
int Ch_Reason_Code1 = 0;

int Ch_Op_Class2 = 0;
int Ch_Pref_Num2 = 0;
int Ch_Pref2 = 0;
int Ch_Reason_Code2 = 0;

#ifndef CONFIG_ETH
beken_semaphore_t wfa_ca_uart_rx_sema = NULL;

static void wfa_ca_uart_rx_callback(uart_id_t uport, void *param)
{
    if (wfa_ca_uart_rx_sema)
        rtos_set_semaphore(&wfa_ca_uart_rx_sema);
}
#endif // !CONFIG_ETH

extern int tgSockfds[WFA_MAX_TRAFFIC_STREAMS];

BYTE xcCmdBuf[WFA_BUFF_4K];
BYTE pcmdBuf[WFA_BUFF_1K];
BYTE parmsVal[WFA_BUFF_1K];
char cmdName[WFA_BUFF_32];
char respStr[WFA_BUFF_512];

//err = rtos_init_timer(&timer_handle, 500, timer_alarm, 0);  ///500mS
beken2_timer_t wfa_tg_timer;
void tmout_stop_send(void *arg, void *);

#ifdef CONFIG_ETH
void wfa_ca_main(beken_thread_arg_t arg)
{
    int nfds;
    // struct sockaddr_in servAddr;
    // unsigned short servPort;
    unsigned short myport = 9000;
    // char *servIP = NULL, *tstr = NULL;
    // int bytesRcvd; // Unused variable
    fd_set sockSet;
    int i, isFound = 0, nbytes = 0, tag, slen; // Unused variable , ret_status
    WORD xcCmdTag;
    int cmdLen = WFA_BUFF_1K, cmdLen1 = WFA_BUFF_1K ;
    int maxfdn1;
    char *pcmdStr = NULL;
    int respLen;
    tgThrData_t tdata[WFA_THREADS_NUM];

    for (i = 0; i < WFA_MAX_TRAFFIC_STREAMS; i++)
        tgSockfds[i] = -1;
    memset(gStreams, 0, sizeof(struct _tg_stream));
    memset(wmm_thr, 0, sizeof(wmm_thr));
    memset(tdata, 0, sizeof(tdata));
    wmm_fc_init();

#ifdef __LINUX__
    pthread_attr_t ptAttr;
    int ptPolicy;
    struct sched_param ptSchedParam;
#endif

    DPRINT_IN_FUNC();

    DPRINT_CONTENT("\r\n###########################################################\r\n");
    DPRINT_CONTENT("| -->>> Parsing DUT configuration file ...                |\r\n");
    DPRINT_CONTENT("###########################################################\r\n");
    if (wfa_dut_param_get_default() != WFA_SUCCESS) {
        DPRINT_ERR("Failed to get DUT parameters\r\n");
        return;
    }

    wSLEEP(1);

    DPRINT_BOX("Perform basic configuration ...");

    // @RW: Start
    trafficBuf = (BYTE *) malloc(MAX_UDP_LEN + 1); /* alloc a traffic buffer */
    if (trafficBuf == NULL) {
        DPRINT_ERR("Failed to malloc traffic buffer\r\n");
        return;
    }

    adj_latency = wfa_estimate_timer_latency() + 4000; /* four more mini */

    if (adj_latency > 500000) {
        printf("****************** WARNING  **********************\n");
        printf("!!!THE SLEEP TIMER LATENCY IS TOO HIGH!!!!!!!!!!!!\n");
        printf("**************************************************\n");

        /* Just set it to  500 mini seconds */
        adj_latency = 500000;
    }
    printf("adj_latency:%d\n", adj_latency);
    rtos_init_oneshot_timer(&wfa_tg_timer, 1000, tmout_stop_send, &wfa_tg_timer, NULL);

#ifdef __LINUX__
    pthread_attr_init(&ptAttr);

    ptSchedParam.sched_priority = 10;
    pthread_attr_setschedparam(&ptAttr, &ptSchedParam);
    pthread_attr_getschedpolicy(&ptAttr, &ptPolicy);
    pthread_attr_setschedpolicy(&ptAttr, SCHED_RR);
    pthread_attr_getschedpolicy(&ptAttr, &ptPolicy);
#endif

    /*
     * Create multiple threads for WMM Stream processing.
     */
    for (i = 0; i < WFA_THREADS_NUM; i++) {
        tdata[i].tid = i;
#ifdef __LINUX__
        pthread_mutex_init(&wmm_thr[i].thr_flag_mutex, NULL);
        pthread_cond_init(&wmm_thr[i].thr_flag_cond, NULL);
        wmm_thr[i].thr_id = pthread_create(&wmm_thr[i].thr, &ptAttr, wfa_wmm_thread, &tdata[i]);
#else
        rtos_init_semaphore(&wmm_thr[i].thr_flag_mutex, 1);
#ifdef CONFIG_FREERTOS_SMP
        rtos_create_thread_with_affinity(&wmm_thr[i].thr, -1, TG_APPLICATION_PRIORITY, "wfa_wmm_thread",
                           wfa_wmm_thread, 4096, &tdata[i]);
#else
        rtos_create_thread(&wmm_thr[i].thr, TG_APPLICATION_PRIORITY, "wfa_wmm_thread",
                           wfa_wmm_thread, 4096, &tdata[i]);
#endif
        wmm_thr[i].prio = TG_APPLICATION_PRIORITY;
#endif
    }

    for (i = 0; i < WFA_MAX_TRAFFIC_STREAMS; i++)
        tgSockfds[i] = -1;
    // @RW: End

    respBuf = (BYTE *)os_malloc(MAX_UDP_LEN + 1); /* alloc a traffic buffer */
    if (respBuf == NULL) {
        DPRINT_ERR("Failed to malloc traffic buffer\r\n");
        return;
    }

    tmsockfd = wfaCreateTCPServSock(myport);

    maxfdn1 = tmsockfd + 1;

    FD_ZERO(&sockSet);
#if 0
    if(gSock == -1)
    {
        if ((gSock = socket(PF_INET, SOCK_STREAM, IPPROTO_TCP)) < 0)
        {
            DPRINT_ERR("socket() failed: %i", errno);
            exit(1);
        }

        memset(&servAddr, 0, sizeof(servAddr));
        servAddr.sin_family      = AF_INET;
        servAddr.sin_addr.s_addr = inet_addr(servIP);
        servAddr.sin_port        = htons(servPort);

        if (connect(gSock, (struct sockaddr *) &servAddr, sizeof(servAddr)) < 0)
        {
            DPRINT_ERR("connect() failed: %i", errno);
            exit(1);
        }

    }
#endif

    for (;;) {
        FD_ZERO(&sockSet);
        FD_SET(tmsockfd, &sockSet);
        maxfdn1 = tmsockfd + 1;

        if(gCaSockfd != -1)
        {
            FD_SET(gCaSockfd, &sockSet);
            if(maxfdn1 < gCaSockfd + 1)
                maxfdn1 = gCaSockfd +1;
        }
        //os_printf("XXX: tmsockfd %d, gCaSockfd %d, maxfdn1 %d\n", tmsockfd, gCaSockfd, maxfdn1);

#if 0
        if(gSock != -1)
        {
            FD_SET(gSock, &sockSet);
            if(maxfdn1 < gSock)
            maxfdn1 = gSock +1;
        }
#endif

        if((nfds = select(maxfdn1, &sockSet, NULL, NULL, NULL)) < 0)
        {
            //if(errno == EINTR)
            //{
                // DPRINT_WARNING(".");
                continue;
            //}
            //else
            //{
                DPRINT_WARNING("select error %i", errno);
            //}
        }

        DPRINT_INFO("new event \r\n");
        if(FD_ISSET(tmsockfd, &sockSet))
        {
            gCaSockfd = wfaAcceptTCPConn(tmsockfd);
            DPRINT_INFO("accept new connection, gCaSockfd %d\r\n", gCaSockfd);
            continue;
        }

        if(gCaSockfd > 0 && FD_ISSET(gCaSockfd, &sockSet))
        {
            memset(xcCmdBuf, 0, WFA_BUFF_4K);
            memset(gRespStr, 0, WFA_BUFF_512);

            nbytes = wfaCtrlRecv(gCaSockfd, xcCmdBuf);
            if(nbytes <=0)
            {
                shutdown(gCaSockfd, SHUT_WR);
                close(gCaSockfd);
                gCaSockfd = -1;
                continue;
            }
            /*
             * send back to command line or TM.
             */
            //sleep(1); /* having this is for slowing down unexpected output result on CLI command sometimes */
            memset(respStr, 0, WFA_BUFF_128);
            sprintf(respStr, "status,RUNNING\r\n");
            wfaCtrlSend(gCaSockfd, (BYTE *)respStr, strlen(respStr));

            DPRINT_INFO("%s\r\n", respStr);
            DPRINT_INFO("message %s %i\r\n", xcCmdBuf, nbytes);
            slen = (int)strlen((char *)xcCmdBuf);

            //DPRINT_INFO("last %x last-1  %x last-2 %x last-3 %x\r\n", cmdName[slen], cmdName[slen-1], cmdName[slen-2], cmdName[slen-3]);
            DPRINT_INFO("last %x last-1  %x last-2 %x last-3 %x\r\n", xcCmdBuf[slen], xcCmdBuf[slen - 1], xcCmdBuf[slen - 2], xcCmdBuf[slen - 3]);

            xcCmdBuf[slen - 2] = '\0';

            //print_hex_dump("CMD", xcCmdBuf, strlen((char *)xcCmdBuf));

            DPRINT_INFO("XXX: cmd |%s|\r\n", xcCmdBuf);

#if 0
            if(gSock == -1)
            {
                if ((gSock = socket(PF_INET, SOCK_STREAM, IPPROTO_TCP)) < 0)
                {
                    DPRINT_ERR("socket() failed: %i", errno);
                    exit(1);
                }

                memset(&servAddr, 0, sizeof(servAddr));
                servAddr.sin_family      = AF_INET;
                servAddr.sin_addr.s_addr = inet_addr(servIP);
                servAddr.sin_port        = htons(servPort);

                if (connect(gSock, (struct sockaddr *) &servAddr, sizeof(servAddr)) < 0)
                {
                    DPRINT_ERR("connect() failed: %i", errno);
                    exit(1);
                }
            }
#endif

            isFound = 0;

            memcpy(cmdName, strtok_r((char *)xcCmdBuf, ",", (char **)&pcmdStr), 32);

            i = 0;
            // os_printf("cmdName: <<<%s>>>\n", cmdName);
            while (nameStr[i].type != -1) {
                if (strcmp(nameStr[i].name, cmdName) == 0) {
                    isFound = 1;
                    break;
                }
                i++;
            }
            DPRINT_INFO("%s\r\n", cmdName);

            if (isFound == 0) {
                sleep(1);
                sprintf(respStr, "status,INVALID\r\n");
                wfaCtrlSend(gCaSockfd, (BYTE *)respStr, strlen(respStr));
                DPRINT_WARNING("Command not valid, check the name\r\n");
                continue;
            }

            // Convert command string to c structure
            memset(pcmdBuf, 0, WFA_BUFF_1K);
            cmdLen = WFA_BUFF_1K;    // reset to cmdLen to bufsize
            if (nameStr[i].cmdProcFunc(pcmdStr, pcmdBuf, &cmdLen) == WFA_FAILURE) {
                sleep(1);
                sprintf(respStr, "status,INVALID\r\n");
                wfaCtrlSend(gCaSockfd, (BYTE *)respStr, strlen(respStr));
                DPRINT_WARNING("Incorrect command syntax\r\n");
                continue;
            }

            //@RW: Start

            //gGenericResp = (dutCmdResponse_t*)malloc(sizeof(dutCmdResponse_t));
            memset(parmsVal, 0, WFA_BUFF_1K);
            memset(&gGenericResp, 0, sizeof(dutCmdResponse_t));
            memset(respBuf, 0, WFA_RESP_BUF_SZ);
            wfaDecodeTLV(pcmdBuf, cmdLen, &xcCmdTag, &cmdLen1, parmsVal);
            DPRINT_WARNING("tag wfa_cs = %d\r\n", xcCmdTag);


            // xcCmdTag: command tag, cmdLen1: command (struct) len, paramsVal: command (struct format)
            if (xcCmdTag != 0 && gWfaCmdFuncTbl[xcCmdTag] != NULL) {
                // since the new commands are expanded to new block
                gWfaCmdFuncTbl[xcCmdTag](cmdLen1, parmsVal, &respLen, (BYTE *)respBuf);
            } else {
                // no command defined
                NotDefinedYet(cmdLen, parmsVal, &respLen, (BYTE *)respBuf);
            }

            DPRINT_WARNING("respBuf len = %d\r\n", ((wfaTLV *)respBuf)->len);
            DPRINT_WARNING("respBuf tag = %d\r\n", ((wfaTLV *)respBuf)->tag);
            tag = ((wfaTLV *)respBuf)->tag;

            if (tag == WFA_INVALID_TLV)
                printf("No response sent\n");
            else if (tag != 0 && wfaCmdRespProcFuncTbl[tag] != NULL)
                wfaCmdRespProcFuncTbl[tag](respBuf);
            else {
                DPRINT_WARNING("tag shall != 0 --> tag = %d\r\n", tag);
                DPRINT_WARNING("Function not defined\r\n");
                caCmdNotDefinedYet(respBuf);
            }
        }
    }
    //@RW: End

#if 0
    close(gSock);
#endif
    DPRINT_OUT_FUNC();
}
#else // !CONFIG_ETH
void wfa_ca_main(beken_thread_arg_t arg)
{
    //int nfds;
    //struct sockaddr_in servAddr;
    //unsigned short servPort, myport;
    //char *servIP = NULL, *tstr = NULL;
    //int bytesRcvd; // Unused variable
    //fd_set sockSet;
    int i, isFound = 0, nbytes = 0, tag, slen; // Unused variable , ret_status
    WORD xcCmdTag;
    int cmdLen = WFA_BUFF_1K, cmdLen1 = WFA_BUFF_1K ;
    //int maxfdn1;
    char *pcmdStr = NULL;
    int respLen;
    tgThrData_t tdata[WFA_THREADS_NUM];
    rtos_init_semaphore(&wfa_ca_uart_rx_sema, 10);
    int rx_complete_line = 1;

    for (i = 0; i < WFA_MAX_TRAFFIC_STREAMS; i++)
        tgSockfds[i] = -1;
    memset(gStreams, 0, sizeof(struct _tg_stream));
    memset(wmm_thr, 0, sizeof(wmm_thr));
    memset(tdata, 0, sizeof(tdata));
    wmm_fc_init();

#ifdef __LINUX__
    pthread_attr_t ptAttr;
    int ptPolicy;
    struct sched_param ptSchedParam;
#endif

    DPRINT_IN_FUNC();

    DPRINT_CONTENT("\r\n########################################################### \r\n");
    DPRINT_CONTENT("| -->>> Parsing DUT configuration file ...                |\r\n");
    DPRINT_CONTENT("########################################################### \r\n");
    if (wfa_dut_param_get_default() != WFA_SUCCESS) {
        DPRINT_ERR("Failed to get DUT parameters\r\n");
        return;
    }

    wSLEEP(1);

    DPRINT_BOX("Perform basic configuration ...");

    // @RW: Start
    trafficBuf = (BYTE *) malloc(MAX_UDP_LEN + 1); /* alloc a traffic buffer */
    if (trafficBuf == NULL) {
        DPRINT_ERR("Failed to malloc traffic buffer\r\n");
        return;
    }

    adj_latency = wfa_estimate_timer_latency() + 4000; /* four more mini */

    if (adj_latency > 500000) {
        printf("****************** WARNING  **********************\n");
        printf("!!!THE SLEEP TIMER LATENCY IS TOO HIGH!!!!!!!!!!!!\n");
        printf("**************************************************\n");

        /* Just set it to  500 mini seconds */
        adj_latency = 500000;
    }
    printf("adj_latency:%d\n", adj_latency);
    rtos_init_oneshot_timer(&wfa_tg_timer, 1000, tmout_stop_send, &wfa_tg_timer, NULL);

#ifdef __LINUX__
    pthread_attr_init(&ptAttr);

    ptSchedParam.sched_priority = 10;
    pthread_attr_setschedparam(&ptAttr, &ptSchedParam);
    pthread_attr_getschedpolicy(&ptAttr, &ptPolicy);
    pthread_attr_setschedpolicy(&ptAttr, SCHED_RR);
    pthread_attr_getschedpolicy(&ptAttr, &ptPolicy);
#endif

    /*
     * Create multiple threads for WMM Stream processing.
     */
    for (i = 0; i < WFA_THREADS_NUM; i++) {
        tdata[i].tid = i;
#ifdef __LINUX__
        pthread_mutex_init(&wmm_thr[i].thr_flag_mutex, NULL);
        pthread_cond_init(&wmm_thr[i].thr_flag_cond, NULL);
        wmm_thr[i].thr_id = pthread_create(&wmm_thr[i].thr, &ptAttr, wfa_wmm_thread, &tdata[i]);
#else
        rtos_init_semaphore(&wmm_thr[i].thr_flag_mutex, 1);
#ifdef CONFIG_FREERTOS_SMP
        rtos_create_thread_with_affinity(&wmm_thr[i].thr, -1, TG_APPLICATION_PRIORITY, "wfa_wmm_thread",
                           wfa_wmm_thread, 4096, &tdata[i]);
#else
        rtos_create_thread(&wmm_thr[i].thr, TG_APPLICATION_PRIORITY, "wfa_wmm_thread",
                           wfa_wmm_thread, 4096, &tdata[i]);
#endif
        wmm_thr[i].prio = TG_APPLICATION_PRIORITY;
#endif
    }

    for (i = 0; i < WFA_MAX_TRAFFIC_STREAMS; i++)
        tgSockfds[i] = -1;
    // @RW: End

    respBuf = (BYTE *)os_malloc(MAX_UDP_LEN + 1); /* alloc a traffic buffer */
    if (respBuf == NULL) {
        DPRINT_ERR("Failed to malloc traffic buffer\r\n");
        return;
    }

    uart_config_t config = {0};
    os_memset(&config, 0, sizeof(uart_config_t));
    config.baud_rate = 115200;
    config.data_bits = UART_DATA_8_BITS;
    config.parity = UART_PARITY_NONE;
    config.stop_bits = UART_STOP_BITS_1;
    config.flow_ctrl = UART_FLOWCTRL_DISABLE;
    config.src_clk = UART_SCLK_XTAL_26M;

    BK_LOG_ON_ERR(bk_uart_init(WFA_UART_PORT, &config));

    // enable rx interrupt
    bk_uart_enable_rx_interrupt(WFA_UART_PORT);

    for (;;) {
        if (rx_complete_line) {
            memset(xcCmdBuf, 0, WFA_BUFF_4K);
            memset(gRespStr, 0, WFA_BUFF_512);
            nbytes = 0;
        }

        if (!wfaCtrlGetInput((char *)xcCmdBuf, WFA_BUFF_4K, &nbytes)) {
            //os_printf("%s %d: nbytes %d\n", __func__, __LINE__, nbytes);
            //os_printf("|%s|\n", xcCmdBuf);
            rx_complete_line = 0;
            continue;
        }

        rx_complete_line = 1;

        /*
         * send back to command line or TM.
         */
        //sleep(1); /* having this is for slowing down unexpected output result on CLI command sometimes */
        memset(respStr, 0, WFA_BUFF_128);
        sprintf(respStr, "status,RUNNING\r\n");
        wfaCtrlSend(gCaSockfd, (BYTE *)respStr, strlen(respStr));

        DPRINT_INFO("%s\r\n", respStr);
        DPRINT_INFO("message %s %i\r\n", xcCmdBuf, nbytes);
        slen = (int)strlen((char *)xcCmdBuf);

        //DPRINT_INFO("last %x last-1  %x last-2 %x last-3 %x\r\n", cmdName[slen], cmdName[slen-1], cmdName[slen-2], cmdName[slen-3]);
        DPRINT_INFO("last %x last-1  %x last-2 %x last-3 %x\r\n", xcCmdBuf[slen], xcCmdBuf[slen - 1], xcCmdBuf[slen - 2], xcCmdBuf[slen - 3]);

        xcCmdBuf[slen - 2] = '\0';

        //print_hex_dump("CMD", xcCmdBuf, strlen((char *)xcCmdBuf));

        DPRINT_INFO("XXX: cmd |%s|\r\n", xcCmdBuf);

        isFound = 0;

        memcpy(cmdName, strtok_r((char *)xcCmdBuf, ",", (char **)&pcmdStr), 32);

        i = 0;
        while (nameStr[i].type != -1) {
            if (strcmp(nameStr[i].name, cmdName) == 0) {
                isFound = 1;
                break;
            }
            i++;
        }
        DPRINT_INFO("%s\r\n", cmdName);

        if (isFound == 0) {
            sleep(1);
            sprintf(respStr, "status,INVALID\r\n");
            wfaCtrlSend(gCaSockfd, (BYTE *)respStr, strlen(respStr));
            DPRINT_WARNING("Command not valid, check the name\r\n");
            continue;
        }

        // Convert command string to c structure
        memset(pcmdBuf, 0, WFA_BUFF_1K);
        cmdLen = WFA_BUFF_1K;    // reset to cmdLen to bufsize
        if (nameStr[i].cmdProcFunc(pcmdStr, pcmdBuf, &cmdLen) == WFA_FAILURE) {
            sleep(1);
            sprintf(respStr, "status,INVALID\r\n");
            wfaCtrlSend(gCaSockfd, (BYTE *)respStr, strlen(respStr));
            DPRINT_WARNING("Incorrect command syntax\r\n");
            continue;
        }

        //@RW: Start

        //gGenericResp = (dutCmdResponse_t*)malloc(sizeof(dutCmdResponse_t));
        memset(parmsVal, 0, WFA_BUFF_1K);
        memset(&gGenericResp, 0, sizeof(dutCmdResponse_t));
        memset(respBuf, 0, WFA_RESP_BUF_SZ);
        wfaDecodeTLV(pcmdBuf, cmdLen, &xcCmdTag, &cmdLen1, parmsVal);
        DPRINT_WARNING("tag wfa_cs = %d\r\n", xcCmdTag);


        // xcCmdTag: command tag, cmdLen1: command (struct) len, paramsVal: command (struct format)
        if (xcCmdTag != 0 && gWfaCmdFuncTbl[xcCmdTag] != NULL) {
            // since the new commands are expanded to new block
            gWfaCmdFuncTbl[xcCmdTag](cmdLen1, parmsVal, &respLen, (BYTE *)respBuf);
        } else {
            // no command defined
            NotDefinedYet(cmdLen, parmsVal, &respLen, (BYTE *)respBuf);
        }

        DPRINT_WARNING("respBuf len = %d\r\n", ((wfaTLV *)respBuf)->len);
        DPRINT_WARNING("respBuf tag = %d\r\n", ((wfaTLV *)respBuf)->tag);
        tag = ((wfaTLV *)respBuf)->tag;

        if (tag == WFA_INVALID_TLV)
            printf("No response sent\n");
        else if (tag != 0 && wfaCmdRespProcFuncTbl[tag] != NULL)
            wfaCmdRespProcFuncTbl[tag](respBuf);
        else {
            DPRINT_WARNING("tag shall != 0 --> tag = %d\r\n", tag);
            DPRINT_WARNING("Function not defined\r\n");
            caCmdNotDefinedYet(respBuf);
        }
    }
    //@RW: End

    DPRINT_OUT_FUNC();

}
#endif // CONFIG_ETH

beken_thread_t wfa_ca_thr = 0;

void wfa_ca_start()
{
    bk_err_t ret;

    ret = rtos_create_thread(&wfa_ca_thr, TG_APPLICATION_PRIORITY, "wfa_ca",
                             wfa_ca_main, 4096, NULL);
    if (ret != kNoErr) {
        os_printf("wfa_ca_start: create thread failed %d\r\n", ret);
    }
}

void wfa_ca_stop()
{
    if (wfa_ca_thr) {
        rtos_delete_thread(wfa_ca_thr);
        wfa_ca_thr = 0;
    }
}

void wfa_ca_set(int argc, char **argv)
{
    // os_printf("argc: %d, argv[0] %s\n", argc, argv[0]);
    if (!os_strcmp(argv[0], "clear")) {
        wmm_fc_init();
    } else if (!os_strcmp(argv[0], "dump")) {
        wmm_fc_dump();
    } else if (!os_strcmp(argv[0], "step")) {
        if (argc >= 2)
            wmm_fc_set_step(atoi(argv[1]));
    } else if (!os_strcmp(argv[0], "delay")) {
        if (argc >= 2)
            wmm_fc_set_delay(atoi(argv[1]));
    } else if (!os_strcmp(argv[0], "debug")) {
        if (argc >= 2)
            wmm_fc_set_debug(!!atoi(argv[1]));
    } else {
        /*
         *  Step   TX    AC   PER
         */
        if (argc >= 4) {
            int step = atoi(argv[0]);
            int tx = atoi(argv[1]);
            int ac = atoi(argv[2]);
            int per = atoi(argv[3]);
            wmm_fc_set(step, tx, ac, per);
        }
    }

}

