
/****************************************************************************
 *  (c) Copyright 2007 Wi-Fi Alliance.  All Rights Reserved
 *
 *
 *  LICENSE
 *
 *  License is granted only to Wi-Fi Alliance members and designated
 *  contractors ($B!H(BAuthorized Licensees$B!I(B)..AN  Authorized Licensees are granted
 *  the non-exclusive, worldwide, limited right to use, copy, import, export
 *  and distribute this software:
 *  (i) solely for noncommercial applications and solely for testing Wi-Fi
 *  equipment; and
 *  (ii) solely for the purpose of embedding the software into Authorized
 *  Licensee$B!G(Bs proprietary equipment and software products for distribution to
 *  its customers under a license with at least the same restrictions as
 *  contained in this License, including, without limitation, the disclaimer of
 *  warranty and limitation of liability, below..AN  The distribution rights
 *  granted in clause
 *  (ii), above, include distribution to third party companies who will
 *  redistribute the Authorized Licensee$B!G(Bs product to their customers with or
 *  without such third party$B!G(Bs private label. Other than expressly granted
 *  herein, this License is not transferable or sublicensable, and it does not
 *  extend to and may not be used with non-Wi-Fi applications..AN  Wi-Fi Alliance
 *  reserves all rights not expressly granted herein..AN
 *.AN
 *  Except as specifically set forth above, commercial derivative works of
 *  this software or applications that use the Wi-Fi scripts generated by this
 *  software are NOT AUTHORIZED without specific prior written permission from
 *  Wi-Fi Alliance.
 *.AN
 *  Non-Commercial derivative works of this software for internal use are
 *  authorized and are limited by the same restrictions; provided, however,
 *  that the Authorized Licensee shall provide Wi-Fi Alliance with a copy of
 *  such derivative works under a perpetual, payment-free license to use,
 *  modify, and distribute such derivative works for purposes of testing Wi-Fi
 *  equipment.
 *.AN
 *  Neither the name of the author nor "Wi-Fi Alliance" may be used to endorse
 *  or promote products that are derived from or that use this software without
 *  specific prior written permission from Wi-Fi Alliance.
 *
 *  THIS SOFTWARE IS PROVIDED BY WI-FI ALLIANCE "AS IS" AND ANY EXPRESS OR
 *  IMPLIED WARRANTIES, INCLUDING, BUT NOT LIMITED TO, THE IMPLIED WARRANTIES
 *  OF MERCHANTABILITY, NON-INFRINGEMENT AND FITNESS FOR A.AN PARTICULAR PURPOSE,
 *  ARE DISCLAIMED. IN NO EVENT SHALL WI-FI ALLIANCE BE LIABLE FOR ANY DIRECT,
 *  INDIRECT, INCIDENTAL, SPECIAL, EXEMPLARY, OR CONSEQUENTIAL DAMAGES
 *  (INCLUDING, BUT NOT LIMITED TO, THE COST OF PROCUREMENT OF SUBSTITUTE
 *  GOODS OR SERVICES; LOSS OF USE, DATA, OR PROFITS; OR BUSINESS INTERRUPTION)
 *  HOWEVER CAUSED AND ON ANY THEORY OF LIABILITY, WHETHER IN CONTRACT,
 *  STRICT LIABILITY, OR TORT (INCLUDING NEGLIGENCE) ARISING IN ANY WAY OUT OF
 *  THE USE OF THIS SOFTWARE, EVEN IF ADVISED OF THE POSSIBILITY OF SUCH DAMAGE. ******************************************************************************
 */
/*
 *    File: wfa_tg.c
 *    Library functions for traffic generator.
 *    They are shared with both TC and DUT agent.
 *
 *    Revision History:
 *       2006/03/10 -- initially created by qhu
 *       2006/06/01 -- BETA release by qhu
 *       2006/06/13 -- 00.02 release by qhu
 *       2006/06/30 -- 00.10 Release by qhu
 *       2006/07/10 -- 01.00 Release by qhu
 *       2006/08/01 -- 01.03 fix ping result unreachable caused by random output
 *                           timing. Add 2 seconds wait-time.
 *                           change priority level to 40 max while traffic
 *                           sending/receiving and 60 min for normal state.
 *       2006/09/01 -- 01.05 Release by qhu
 *       2006/10/26 -- 01.06 released by qhu
 *       2006/10.20 -- bug fixes report by n. ojannen
 *       2006/12/30 -- bug fix. a potential race condition for transaction test, *                     reported by c.benson.
 *       2006/01/11 -- 01.10 released by qhu
 *       2007/02/15  -- WMM Extension Beta released by qhu, mkaroshi
 *       2007/03/15  -- develop a better rate control method for sendLong
 *                      a major bug fix for File receive that opens socket with
 *                      source port. It should be destination port. This was
 *                      an early mistake because of interpretation.
 *       2007/03/30 -- 01.40 WPA2 and Official WMM Beta Release by qhu
 *       2007/04/20 -- 02.00 WPA2 and Official WMM Release by qhu
 *       2007/08/15 --  02.10 WMM-Power Save release by qhu
 *       2007/10/10 -- 02.20 Voice SOHO beta -- qhu
 *       2007/11/07 -- 02.30 Voice HSO -- qhu
 *           -- revise the code for traffic throttled control
 *           -- take care of EAGAIN error return by socket sendto() -- suggested
 *              by tterhaar
 *       2007/12/10 -- 02.32 Further modify the throttled mechanism for traffic
 *                     test.
 *       2008/01/03 -- 02.34 Support the result upload command
 *       2008/02/07 -- 02.40 Support Updated WMM-PS method
 *                     Comment out the process priority settings, user could
 *                     decide to use them
 *       2008/03/14 -- 02.41 Bug #12, reset a socket before closing it, change
 *                           to close the socket id first then reset it to -1
 *                           in function tmout_stop_send()
 *
 *                           Bug #14. Not A Bug, impove the rate control by
 *                           change 50 ms period to 20 ms period and lower
 *                           max rate from 3000 to 2500 in function
 *                           wfaTxSleepTime().
 */
#include <sys/time.h>
#include <time.h>
#include <signal.h>
#include <fcntl.h>
#include <netdb.h>
#include <pthread.h>
#include <math.h>

#include "wfa_portall.h"
#include "wfa_stdincs.h"
#include "wfa_debug.h"
#include "wfa_ver.h"
#include "wfa_main.h"
#include "wfa_tlv.h"
#include "wfa_tg.h"
#include "wfa_cmds.h"
#include "wfa_sock.h"
#include "wfa_rsp.h"
#ifdef WFA_WMM_PS_EXT
#include "wfa_wmmps.h"
#endif
#include "wfa_miscs.h"
#include "wfa_dut_param.h"
#include "wfa_ca.h"

extern tgStream_t gStreams[];
extern BOOL gtgRecv;
extern BOOL gtgSend;
extern BOOL gtgTransac;
extern int gtimeOut;
extern int gRegSec;
extern BOOL gtgCaliRTD;
extern beken2_timer_t wfa_tg_timer;

int btSockfd = -1;
int adj_latency = 0;

extern tgStream_t *findStreamProfile(int);
extern int wfaTrafficSendTo(int, char *, int, struct sockaddr *);
extern int wfaTrafficRecv(int, char *, struct sockaddr *, int *tos);
extern int wfaSendPing(tgPingStart_t *staPing, float *interval, int streamid);
extern int wfaStopPing(dutCmdResponse_t *stpResp, tgPingStop_t *stoping);
extern int os_gettimeofday(struct timeval *tv, struct timezone *tz);
extern unsigned short wfa_defined_debug;
extern int tgSockfds[];

extern tgWMM_t wmm_thr[];

extern double min_rttime;
extern double gtgPktRTDelay;
extern void int2BuffBigEndian(int val, char *buf);
extern int bigEndianBuff2Int(char *buff);

#ifdef WFA_WMM_PS_EXT
extern int gtgWmmPS;
extern wfaWmmPS_t wmmps_info;
extern int psSockfd;
extern unsigned int psTxMsg[];
extern unsigned int psRxMsg[];
extern int gtgPsPktRecvd;

extern void wfaSetDUTPwrMgmt(int mode);
void wmmps_wait_state_proc();

#endif


#define FHOST_MAX_TRAFFIC_STREAMS       4
static int streamId = 0;
static int totalTranPkts = 0, sentTranPkts = 0;
int slotCnt = 0;

extern int usedThread;
extern int runLoop;
extern int sendThrId;

char e2eResults[124];
#if 0  /* for test purpose only */
char *e2eResults = "/tmp/e2e1198798626.txt";
#endif

extern char gCmdStr[128];
extern dutCmdResponse_t gGenericResp;

#ifdef CONFIG_RW_FHOST
static int tgStreamId = 0;
#endif

extern dutCmdResponse_t *FhostCmdExecute(char *cmdStr, enum cmd_tags tag);


#if 1//def CONFIG_WMM_FC

struct wmm_fc {
    int enabled;    /* enabled */
    int ac;            /* TG_WMM_AC_BE, TG_WMM_AC_BK, TG_WMM_AC_VI, TG_WMM_AC_VO */
    int per;        /* [0:10] */
    int phase;      /* 1: phase 1, 2: phase 2 */
    uint32_t count;
    uint32_t count_detect;
    uint32_t dropped;
};

int wmm_fc_step = 0;
int wmm_fc_delay = 2000; // 2ms
bool wmm_fc_debug = false;
#define MAX_STEPS      20
#define INVALID_STEP   0xFF

struct wmm_fc wmm_fc_tx[MAX_STEPS][WMMAC_AC_MAX];        /* H->T */
struct wmm_fc wmm_fc_rx[MAX_STEPS][WMMAC_AC_MAX];        /* T -> H */

void wmm_fc_set(int step, int tx, int ac, int per)
{
    if (step >= MAX_STEPS || ac >= WMMAC_AC_MAX)
        return;

    if (tx) {
        wmm_fc_tx[step][ac].enabled = 1;
        wmm_fc_tx[step][ac].ac = ac;
        wmm_fc_tx[step][ac].per = per * 10 / 100;
    } else {
        wmm_fc_rx[step][ac].enabled = 1;
        wmm_fc_rx[step][ac].ac = ac;
        wmm_fc_rx[step][ac].per = per * 10 / 100;
    }
}

void wmm_fc_set_step(int step)
{
    if (step >= MAX_STEPS)
        return;
    wmm_fc_step = step;
    os_printf("set wmm_fc_step to %d\n", wmm_fc_step);
}

void wmm_fc_set_delay(int delay)
{
    wmm_fc_delay = delay;
    os_printf("set wmm_fc_delay to %d\n", wmm_fc_delay);
}

void wmm_fc_set_debug(bool debug)
{
    wmm_fc_debug = debug;
    os_printf("set wmm_fc_debug to %d\n", wmm_fc_debug);
}

void wmm_fc_dump()
{
    // print info
    // STEP      TX/RX        AC       PER
    os_printf("Current Step %d\n", wmm_fc_step);
    os_printf("delay %d\n", wmm_fc_delay);
    os_printf("debug %d\n", wmm_fc_debug);
    os_printf("Step      TX/RX       AC     PER\n");
    for (int i = 1; i < MAX_STEPS; i++) {
        printf("Step [%d]:\n", i);
        for (int j = 0; j < WMMAC_AC_MAX; j++) {
            if (wmm_fc_tx[i][j].enabled) {
                printf("\t\tTX\t%d\t%d\n", wmm_fc_tx[i][j].ac, wmm_fc_tx[i][j].per);
            }
            if (wmm_fc_rx[i][j].enabled) {
                printf("\t\tRX\t%d\t%d\n", wmm_fc_rx[i][j].ac, wmm_fc_rx[i][j].per);
            }
        }
    }
}

/*
 * read wmm parameters from /valid/wmm.txt
 */
void wmm_fc_init()
{
    memset(wmm_fc_tx, 0, sizeof(wmm_fc_tx));
    memset(wmm_fc_rx, 0, sizeof(wmm_fc_rx));
    wmm_fc_step = INVALID_STEP;

#ifdef __LINUX__
    // read from file
    //1     0      0  90
    //1     0      2  90
    //3     1      0  60
    //3     1      2  60
    //5     1      0  60
    //5     1      2  60
    //7     1      1  60
    //7     1      0  60
    //9     1      2  60
    //9     1      3  60

    FILE *fp = fopen("/valid/wmm.txt", "r");
    if (fp) {
        int ret;
        int step, tx, ac, per, phase;

        /*
         *  Step   TX    AC   PER
         */
        while (1) {
            ret = fscanf(fp, "%d %d %d %d", &step, &tx, &ac, &per);
            printf("ret=%d\n", ret);
            if (ret == 4) {

                if (step >= MAX_STEPS || ac >= WMMAC_AC_MAX)
                    continue;

                if (tx) {
                    wmm_fc_tx[step][ac].enabled = 1;
                    wmm_fc_tx[step][ac].ac = ac;
                    wmm_fc_tx[step][ac].per = per * 10 / 100;
                } else {
                    wmm_fc_rx[step][ac].enabled = 1;
                    wmm_fc_rx[step][ac].ac = ac;
                    wmm_fc_rx[step][ac].per = per * 10 / 100;
                }
            } else if (ret <= 0) {
                printf("%s: EOF\n", __func__);
                break;
            }
        }

        // print info
        // STEP      TX/RX      AC     PER
        for (int i = 1; i < MAX_STEPS; i++) {
            printf("Step [%d]:\n", i);
            for (int j = 0; j < WMMAC_AC_MAX; j++) {
                if (wmm_fc_tx[i][j].enabled) {
                    printf("\tTX\t%d\t%d\n", wmm_fc_tx[i][j].ac, wmm_fc_tx[i][j].per);
                }
                if (wmm_fc_rx[i][j].enabled) {
                    printf("\tRX\t%d\t%d\n", wmm_fc_rx[i][j].ac, wmm_fc_rx[i][j].per);
                }
            }
        }

        fclose(fp);
    }
#endif
}

struct wmm_fc *find_wmm_fc(int ac, int tx, int debug)
{
    struct wmm_fc *fc;

    if (wmm_fc_step >= MAX_STEPS || ac >= WMMAC_AC_MAX) {
        if (debug) {
            printf("%s %d: %s\n", __func__, __LINE__, tx ? "tx" : "rx");
        }
        return NULL;
    }

    if (tx)
        fc = &wmm_fc_tx[wmm_fc_step][ac];
    else
        fc = &wmm_fc_rx[wmm_fc_step][ac];

    if (fc->enabled)
        return fc;

    if (debug) {
        printf("%s %d: %s\n", __func__, __LINE__, tx ? "tx" : "rx");
    }
    return NULL;
}

/*
 * wfaTGSetPrio(): This depends on the network interface card.
 *               So you might want to remap according to the driver
 *               provided.
 *               The current implementation is to set the TOS/DSCP bits
 *               in the IP header
 */
int wmm_tos_to_ac(int tos)
{
    int ac;

    switch (tos)
    {
    case TOS_BE:
        ac = WMMAC_AC_BE;   // user priority "0"
        break;

    case TOS_BK:
        ac = WMMAC_AC_BK;
        break;

    case TOS_VI:
        ac = WMMAC_AC_VI;   // user priority "5"
        break;

    case TOS_VO:
        ac = WMMAC_AC_VO;   // user priority "6"
        break;

    default:
        printf("unknown tos\n");
        ac = -1;
        /* default */
        ;
    }
    return ac;
}


// 1: drop packet
int wmm_fc_handle_rx(tgProfile_t *theProf, int tos)
{
    int ac = wmm_tos_to_ac(tos);
    //printf("tos %d, ac %d\n", tos, ac);

    if (ac < 0 || ac > WMMAC_AC_MAX)
        return 0;

    struct wmm_fc *fc = find_wmm_fc(ac, 0, 0);

    if (!fc)
        return 0;

    fc->count++;
    if ((fc->count % 10) < fc->per) {
        // drop packet
        if (wmm_fc_debug)
            printf("%s: drop pkt\n", __func__);
        return 1;
    }

    return 0;
}

// add delay for tx frames
void wmm_fc_handle_tx(tgProfile_t *theProf)
{
    struct wmm_fc *fc = find_wmm_fc(theProf->trafficClass - 1, 1, 0);
    if (!fc) {
        //printf("%s: ac %d, wmm_fc_step %d\n", __func__, theProf->trafficClass - 1, wmm_fc_step);
        return;
    }

    fc->count++;

    if ((fc->count % 10) < fc->per) {
        // delay tx
        if (wmm_fc_debug)
            printf("%s: delay %d for ac %d\n", __func__, wmm_fc_delay, theProf->trafficClass  - 1);
        wUSLEEP(wmm_fc_delay);
    }
}
#endif // CONFIG_WMM_FC


#define check_is_num(_str, _len)  \
    for (j = 0 ; j < _len; j++) do {  \
        if (_str[j] < '0' || _str[j] > '9')                      \
            return -1;                                           \
    } while (0)

/**
 ****************************************************************************************
 * @brief Verify if string contains ip address
 * @return 0 if string contained what looks like a valid ip address and -1 otherwise
 ****************************************************************************************
 */
int IsIp4(char *str)
{
    char *token = NULL;
    // store part of ip address (between dots)
    char tmp[4];
    // length of part of ip address (1 ~ 3)
    int len;
    uint32_t a, i, j;

    // parse the ip part
    for (i = 0; i < 4; i ++) {
        if (i < 3) {
            token = strchr(str, '.');
            if (!token)
                return -1;

            len = token - str;
        } else {
            // if it's the last part of ip address
            len = strlen(str);
        }
        check_is_num(str, len);
        // retrieve number between dot
        memset(tmp, 0, 4);
        strncpy(tmp, str, len);

        a = atoi(tmp);
        if (a > 255)
            return -1;
        str = ++token;
    }

    return 0;
}

/* Some devices may only support UDP ECHO and do not have ICMP level ping */
// #define WFA_PING_UDP_ECHO_ONLY     1

/*
 * findStreamProfile(): search existing stream profile by stream id
 * input: id - stream id;
 * return: matched stream profile
 */
tgStream_t *findStreamProfile(int id)
{
    int i;
    tgStream_t *myStream = gStreams;

    for (i = 0; i < WFA_MAX_TRAFFIC_STREAMS; i++) {
        if (myStream->id == id)
            return myStream;

        myStream++;
    }

    return NULL;
}

tgProfile_t *findTGProfile(int streamId)
{
    volatile int i;
    tgStream_t *myStream = gStreams;

    for(i = 0; i< WFA_MAX_TRAFFIC_STREAMS; i++)
    {
        if(myStream->id == streamId)
            return &(myStream->profile);

        myStream++;
    }

    return NULL;
}

/*
 * wfaTGSendPing(): Instruct Traffic Generator to send ping packets
 *
 */
int wfaTGSendPing(int len, BYTE *caCmdBuf, int *respLen, BYTE *respBuf)
{
    int streamid = ++streamId;
    float interval;      /* it could be subseconds/100s minisecond */
    tgPingStart_t *staPing = (tgPingStart_t *)caCmdBuf;
    dutCmdResponse_t *spresp = &gGenericResp;

#ifdef WFA_PING_UDP_ECHO_ONLY
    tgStream_t *myStream = NULL;
#endif

    DPRINT_IN_FUNC();

    if (staPing->frameSize == 0)
        staPing->frameSize = 100;

    printf("fr %f\n", staPing->frameRate);
    if (staPing->frameRate == 0)
        staPing->frameRate = 1;

    interval = (float) 1 / staPing->frameRate;
    printf("TG: interval %f\n", interval);

    if (staPing->duration == 0)
        staPing->duration = 30;

    switch (staPing->type) {
    case WFA_PING_ICMP_ECHO:
#ifndef WFA_PING_UDP_ECHO_ONLY
        // FULLMAC and SOFTMAC
        if (DUT_TYPE != DUT_TYPE_FHOST) {
            printf("The steam ID is:%d \n", streamId);
            wfaSendPing(staPing, &interval, streamId);

            spresp->streamId = streamid;
        }
        // FHOST
        else
            spresp->streamId = wfaSendPing(staPing, &interval, 0);
        spresp->status = STATUS_COMPLETE;

#else
        printf("Only support UDP ECHO\n");
#endif
        break;

    case WFA_PING_UDP_ECHO: {
#ifdef WFA_PING_UDP_ECHO_ONLY
        /*
         * Make this like a transaction testing
         * Then make it a profile and run it
         */
        myStream = &gStreams[slotCnt++];
        memset(myStream, 0, sizeof(tgStream_t));
        memcpy(&myStream->profile, caCmdBuf, len);
        myStream->id = streamid; /* the id start from 1 */
        myStream->tblidx = slotCnt - 1;

        btSockfd = wfaCreateUDPSock("127.0.0.1", WFA_UDP_ECHO_PORT);
        if ((btSockfd = wfaConnectUDPPeer(btSockfd, staPing->dipaddr, WFA_UDP_ECHO_PORT)) > 0) {
            gtgTransac = streamid;
            gtgSend = streamid;
            totalTranPkts = 512;
            sentTranPkts = 0;

            /*
             * the framerate here is used to derive the timeout
             * value for waiting transaction echo responses.
             */
            gtimeOut = MINISECONDS / staPing->frameRate; /* in msec */

            /* set to longest time */
            if (staPing->duration == 0)
                staPing->duration = 3600;
        }
#else
        printf("Doesn't support UDP Echo\n");
#endif
        break;
    }
    default: {
        spresp->status = STATUS_INVALID;
        spresp->streamId = streamid;
    }
    }

    WFA_ENC_TLV(WFA_TRAFFIC_SEND_PING_TLV, sizeof(dutCmdResponse_t), (BYTE *)spresp, respBuf);
    *respLen = WFA_TLV_HDR_LEN + sizeof(dutCmdResponse_t);

    DPRINT_OUT_FUNC();

    return WFA_SUCCESS;
}

/*
 * tgStopPing(): Instruct Traffic Generator to stop ping packets
 *
 */
int wfaTGStopPing(int len, BYTE *caCmdBuf, int *respLen, BYTE *respBuf)
{
    tgPingStop_t *stoPing = (tgPingStop_t *)caCmdBuf;
    dutCmdResponse_t *stpResp = &gGenericResp;
    tgStream_t *myStream;
    int i;

    DPRINT_IN_FUNC();

    stpResp->status = STATUS_COMPLETE;

    printf("CS: The length %d\n and the command buff is \n", len);

    for (i = 0; i < 8; i++)
        printf(" %x ", caCmdBuf[i]);

    printf("\nthe stream id is %d\n", stoPing->streamid);

    if (gtgTransac == stoPing->streamid && gtgSend == stoPing->streamid && DUT_TYPE != DUT_TYPE_FHOST) {
        gtgTransac = 0;
        gtgSend = 0;
        gtgRecv = 0;
#ifdef XXX
        alarm(0);
#endif

        myStream = findStreamProfile(stoPing->streamid);
        if (myStream == NULL)
            stpResp->status = STATUS_INVALID;

        stpResp->cmdru.pingStp.sendCnt = myStream->stats.txFrames;
        stpResp->cmdru.pingStp.repliedCnt = myStream->stats.rxFrames;
    } else {
#if 0
        if (wfaStopPing(stpResp, stoping) == WFA_FAILURE) {
            stpResp->status = STATUS_COMPLETE;

            WFA_ENC_TLV(WFA_TRAFFIC_STOP_PING_TLV, sizeof(dutCmdResponse_t), (BYTE *)stpResp, respBuf);
            *respLen = WFA_TLV_HDR_LEN + sizeof(dutCmdResponse_t);
        }
#endif
        printf("CS: wfaStopPing \n");
        wfaStopPing(stpResp, stoPing);
    }

    WFA_ENC_TLV(WFA_TRAFFIC_STOP_PING_TLV, sizeof(dutCmdResponse_t), (BYTE *)stpResp, respBuf);
    *respLen = WFA_TLV_HDR_LEN + sizeof(dutCmdResponse_t);

    DPRINT_OUT_FUNC();

    return WFA_SUCCESS;
}

/*
 * wfaTGConfig: store the traffic profile setting that will be used to
 *           instruct traffic generation.
 * input: cmd -- not used
 * response: send success back to controller
 * return: success or fail
 * Note: the profile storage is a global space.
 */
int wfaTGConfig(int len, BYTE *caCmdBuf, int *respLen, BYTE *respBuf)
{
    int ret = WFA_FAILURE;
    tgStream_t *myStream = NULL;
    dutCmdResponse_t *confResp = &gGenericResp;

    DPRINT_IN_FUNC();

    // FULLMAC and SOFTMAC
    if (DUT_TYPE != DUT_TYPE_FHOST) {
        /* if the stream table over maximum, reset it */
        if (slotCnt == WFA_MAX_TRAFFIC_STREAMS)
            slotCnt = 0;

        if (slotCnt == 0) {
            printf("resetting stream table\n");
            wMEMSET(gStreams, 0, WFA_MAX_TRAFFIC_STREAMS * sizeof(tgStream_t));
        }

        myStream = &gStreams[slotCnt++];
        wMEMSET(myStream, 0, sizeof(tgStream_t));
        wMEMCPY(&myStream->profile, caCmdBuf, len);
        myStream->id = ++streamId; /* the id start from 1 */
        myStream->tblidx = slotCnt - 1;

#if 0
        DPRINT_INFO("profile %i direction %i dest ip %s dport %i source %s sport %i rate %i duration %i size %i class %i delay %i\r\n", myStream->profile.profile, myStream->profile.direction, myStream->profile.dipaddr, myStream->profile.dport, myStream->profile.sipaddr, myStream->profile.sport, myStream->profile.rate, myStream->profile.duration, myStream->profile.pksize, myStream->profile.trafficClass, myStream->profile.startdelay);
#endif

#ifdef CONFIG_WMM_FC
        if (wmm_fc_step == INVALID_STEP) {
            wmm_fc_step = 1;    /* first traffic */
            DPRINT_ERR("WMM Step --> %d\n", wmm_fc_step);
        }
#endif

        confResp->status = STATUS_COMPLETE;
        confResp->streamId = myStream->id;
    }

#ifdef CONFIG_RW_FHOST
    // FHOST
    else {
        dutCmdResponse_t *fhostCmdResp = NULL;
        if (tgStreamId == FHOST_MAX_TRAFFIC_STREAMS)
            tgStreamId = 0;
        /*
         * NOTE : we also use gStreams for FHOST to store certain configuration parameters
         *        which will be used at TG sending process (e.g. streamid, duration)
         */
        // Take un stream from the pool which corresponds the stream id
        myStream = &gStreams[tgStreamId];
        wMEMSET(myStream, 0, sizeof(tgStream_t));
        // retrieve configuration information
        wMEMCPY(&myStream->profile, caCmdBuf, len);
        // the id start from 0 and incremente until FHOST_MAX_TRAFFIC_STREAMS (3 TG streams in total for FHOST)
        myStream->id = tgStreamId++;

        // if ip address is incorrect, reset it to "0" with dotted-decimal format
        if (-1 == IsIp4(myStream->profile.dipaddr)) {
            wMEMSET((myStream->profile.dipaddr), 0, IPV4_ADDRESS_STRING_LEN);
            strcpy((myStream->profile.dipaddr), "0.0.0.0");
            DPRINT_INFO("reset diapaddr 0 %s\r\n", myStream->profile.dipaddr);
        } else
            DPRINT_INFO("correct diapaddr %s\r\n", myStream->profile.dipaddr);

        if (-1 == IsIp4(myStream->profile.sipaddr)) {
            wMEMSET((myStream->profile.sipaddr), 0, IPV4_ADDRESS_STRING_LEN);
            strcpy((myStream->profile.sipaddr), "0.0.0.0");
            DPRINT_INFO("reset siapaddr 0 %s\r\n", myStream->profile.sipaddr);
        } else
            DPRINT_INFO("correct siapaddr %s\r\n", myStream->profile.sipaddr);

        DPRINT_INFO("FHOST profile %i direction %i dest ip %s dport %i source %s sport %i rate %i duration %i size %i class %i delay %i\r\n", myStream->profile.profile, myStream->profile.direction, myStream->profile.dipaddr, myStream->profile.dport, myStream->profile.sipaddr, myStream->profile.sport, myStream->profile.rate, myStream->profile.duration, myStream->profile.pksize, myStream->profile.trafficClass, myStream->profile.startdelay);

        // Interpretation of traffic class to TG command parameter
        switch (myStream->profile.trafficClass) {
        case TG_WMM_AC_BE :
            myStream->profile.trafficClass = TOS_BE;
            break;

        case TG_WMM_AC_BK :
            myStream->profile.trafficClass = TOS_BK;
            break;

        case TG_WMM_AC_VI :
            myStream->profile.trafficClass = TOS_VI;
            break;

        case TG_WMM_AC_VO :
            myStream->profile.trafficClass = TOS_VO;
            break;

        default :
            myStream->profile.trafficClass = TOS_BE;
            break;
        }

        if (DIRECT_SEND == myStream->profile.direction)
            sprintf(gCmdStr, "tg config %d %d %d %s %d %s %d %d %d %d %d", myStream->id, myStream->profile.profile, myStream->profile.direction, myStream->profile.dipaddr, myStream->profile.dport, myStream->profile.sipaddr, myStream->profile.sport, myStream->profile.rate, myStream->profile.pksize, myStream->profile.duration, myStream->profile.trafficClass);
        else if (DIRECT_RECV == myStream->profile.direction) {
            // destination address is MCAST group address
            if (PROF_MCAST == myStream->profile.profile)
                sprintf(gCmdStr, "tg config %d %d %d %s %d %s %d %d %d %d %d", myStream->id, myStream->profile.profile, myStream->profile.direction, myStream->profile.dipaddr, myStream->profile.dport, myStream->profile.sipaddr, myStream->profile.sport, myStream->profile.rate, myStream->profile.pksize, myStream->profile.duration, myStream->profile.trafficClass);
            else {
                // receive from source address, so reverse destination address and source address
                sprintf(gCmdStr, "tg config %d %d %d %s %d %s %d %d %d %d %d", myStream->id, myStream->profile.profile, myStream->profile.direction, myStream->profile.sipaddr, myStream->profile.sport, myStream->profile.dipaddr, myStream->profile.dport, myStream->profile.rate, myStream->profile.pksize, myStream->profile.duration, myStream->profile.trafficClass);
            }

        }

        DPRINT_INFO("CMD --> %s\r\n", gCmdStr);
        // write the command string in the device file to execute it
        fhostCmdResp = FhostCmdExecute(gCmdStr, WFA_TRAFFIC_AGENT_CONFIG_TLV);

        if (fhostCmdResp != NULL) {
            confResp->status = fhostCmdResp->status;
            confResp->streamId = fhostCmdResp->streamId;
            free(fhostCmdResp);
        } else {
            confResp->status = STATUS_ERROR;
            DPRINT_ERR("Error: fhostCmdResp NULL\r\n");
        }

    }
#endif //CONFIG_RW_FHOST

    WFA_ENC_TLV(WFA_TRAFFIC_AGENT_CONFIG_TLV, sizeof(dutCmdResponse_t), (BYTE *)confResp, respBuf);
    *respLen = WFA_TLV_HDR_LEN + sizeof(dutCmdResponse_t);

    DPRINT_OUT_FUNC();

    return ret;
}

/* RecvStart: instruct traffic generator to start receiving
 *                 based on a profile
 * input:      cmd -- not used
 * response:   inform controller for "running"
 * return:     success or failed
 */
int wfaTGRecvStart(int len, BYTE *parms, int *respLen, BYTE *respBuf)
{
    int status = STATUS_COMPLETE, i;
    int numStreams = len / 4;
    int streamid;
    tgProfile_t *theProfile;
    tgStream_t *myStream;
    dutCmdResponse_t *confResp = &gGenericResp;

    DPRINT_IN_FUNC();

    /*
     * The function wfaSetProcPriority called here is to enhance the real-time
     * performance for packet receiving. It is only for tuning and optional
     * to implement
     */
    //wfaSetProcPriority(60);

    for (i = 0; i < numStreams; i++) {
        wMEMCPY(&streamid, parms + (4 * i), 4); /* changed from 2 to 4, bug reported by n.ojanen */
        // FULLMAC and SOFTMAC
        if (DUT_TYPE != DUT_TYPE_FHOST) {
            myStream = findStreamProfile(streamid);
            if (myStream == NULL) {
                status = STATUS_INVALID;
                return status;
            }

            theProfile = &myStream->profile;
            if (theProfile == NULL) {
                status = STATUS_INVALID;
                return status;
            }

            /* calculate the frame interval which is used to derive its jitter */
            if (theProfile->rate != 0 && theProfile->rate < 5000)
                myStream->fmInterval = 1000000 / theProfile->rate; /* in ms */
            else
                myStream->fmInterval = 0;

            if (theProfile->direction != DIRECT_RECV) {
                status = STATUS_INVALID;
                return status;
            }

            wMEMSET(&myStream->stats, 0, sizeof(tgStats_t));

            // mark the stream active
            myStream->state = WFA_STREAM_ACTIVE;

            switch (theProfile->profile) {
#ifdef WFA_WPA2_SINGLE_THREAD
            case PROF_MCAST:
            case PROF_FILE_TX:
                //           case PROF_IPTV:
                btSockfd = wfaCreateUDPSock(theProfile->dipaddr, theProfile->dport);
                gtgRecv = streamid;

                if (btSockfd < 0)
                    status = STATUS_ERROR;
                else {
                    /* get current flags setting */
                    int ioflags = wFCNTL(btSockfd, F_GETFL, 0);

                    /* set only BLOCKING flag to non-blocking */
                    wFCNTL(btSockfd, F_SETFL, ioflags | O_NONBLOCK);
                }
                break;
#else

            case PROF_TRANSC:
            case PROF_CALI_RTD:  /* Calibrate roundtrip delay */
                gtgTransac = streamid;
            case PROF_MCAST:
            case PROF_FILE_TX:
            case PROF_IPTV:
                gtgRecv = streamid;
                wmm_thr[usedThread].thr_flag = streamid;
#ifdef __LINUX__
                wPT_MUTEX_LOCK(&wmm_thr[usedThread].thr_flag_mutex);
                wPT_COND_SIGNAL(&wmm_thr[usedThread].thr_flag_cond);
                wPT_MUTEX_UNLOCK(&wmm_thr[usedThread].thr_flag_mutex);
#else
                rtos_set_semaphore(&wmm_thr[usedThread].thr_flag_mutex);
#endif
                printf("Recv Start in thread %i for streamid %i\n", usedThread, streamid);
                usedThread++;
                break;
#endif
            case PROF_UAPSD:
#ifdef WFA_WMM_PS_EXT
                status = STATUS_COMPLETE;
                psSockfd = wfaCreateUDPSock(theProfile->dipaddr, WFA_WMMPS_UDP_PORT);

                wmmps_info.sta_state = 0;
                wmmps_info.wait_state = WFA_WAIT_STAUT_00;

                wMEMSET(&wmmps_info.psToAddr, 0, sizeof(wmmps_info.psToAddr));
                wmmps_info.psToAddr.sin_family = AF_INET;
                wmmps_info.psToAddr.sin_addr.s_addr = inet_addr(theProfile->sipaddr);
                wmmps_info.psToAddr.sin_port = htons(theProfile->sport);
                wmmps_info.reset = 0;

                wmm_thr[usedThread].thr_flag = streamid;
                wmmps_info.streamid = streamid;
                wPT_MUTEX_LOCK(&wmm_thr[usedThread].thr_flag_mutex);
                wPT_COND_SIGNAL(&wmm_thr[usedThread].thr_flag_cond);
                gtgWmmPS = streamid;;
                wPT_MUTEX_UNLOCK(&wmm_thr[usedThread].thr_flag_mutex);
                usedThread++;
#endif   /* WFA_WMM_PS_EXT */
                break;
            }
            confResp->status = status;
        }
#ifdef CONFIG_RW_FHOST
        // FHOST
        else {
            dutCmdResponse_t *fhostCmdResp = NULL;

            sprintf(gCmdStr, "tg start %d", streamid);
            DPRINT_INFO("CMD --> %s\r\n", gCmdStr);
            // write the command string in the device file to execute it
            fhostCmdResp = FhostCmdExecute(gCmdStr, WFA_TRAFFIC_AGENT_RECV_START_TLV);

            if (fhostCmdResp != NULL) {
                // *confResp = *fhostCmdResp;
                confResp->status = fhostCmdResp->status;
                confResp->streamId = fhostCmdResp->streamId;
                // staSendResp = *fhostCmdResp;
                free(fhostCmdResp);
            } else {
                confResp->status = STATUS_ERROR;
                DPRINT_ERR("Error: fhostCmdResp NULL\r\n");
            }
        }
#endif //CONFIG_RW_FHOST
    }
    /* encode a TLV for response for "complete/error ..." */

    WFA_ENC_TLV(WFA_TRAFFIC_AGENT_RECV_START_TLV, sizeof(dutCmdResponse_t), (BYTE *)confResp, respBuf);
    *respLen = WFA_TLV_HDR_LEN + sizeof(dutCmdResponse_t);

    DPRINT_OUT_FUNC();

    return WFA_SUCCESS;
}

/*
 * tgRecvStop: instruct traffic generator to stop receiving based on a profile
 * input:      cmd -- not used
 * response:   inform controller for "complete"
 * return:     success or failed
 */
int wfaTGRecvStop(int len, BYTE *parms, int *respLen, BYTE *respBuf)
{
    int status = STATUS_COMPLETE, i;
    int numStreams = len / 4;
    unsigned int streamid;
    tgProfile_t *theProfile;
    tgStream_t *myStream = NULL;
    dutCmdResponse_t statResp;
    BYTE dutRspBuf[WFA_RESP_BUF_SZ];
    int id_cnt = 0;

    DPRINT_IN_FUNC();

    /* in case that send-stream not done yet, an optional delay */
    while (sendThrId != 0)
        sleep(1);

    /*
     * After finishing the receiving command, it should lower itself back to
     * normal level. It is optional implementation if it is not called
     * while it starts receiving for raising priority level.
     */
    wMEMSET(dutRspBuf, 0, WFA_RESP_BUF_SZ);
    for (i = 0; i < numStreams; i++) {
        wMEMCPY(&streamid, parms + (4 * i), 4);

        // FULLMAC and SOFTMAC
        if (DUT_TYPE != DUT_TYPE_FHOST) {
            printf(" stop stream id %u\n", streamid);
            myStream = findStreamProfile(streamid);
            if (myStream == NULL) {
                status = STATUS_INVALID;
                WFA_ENC_TLV(WFA_TRAFFIC_AGENT_RECV_STOP_TLV, 4, (BYTE *)&status, respBuf);
                *respLen = WFA_TLV_HDR_LEN + 4;
                continue;
            }

            theProfile = &myStream->profile;
            if (theProfile == NULL) {
                status = STATUS_INVALID;
                WFA_ENC_TLV(WFA_TRAFFIC_AGENT_RECV_STOP_TLV, 4, (BYTE *)&status, respBuf);
                *respLen = WFA_TLV_HDR_LEN + 4;

                return WFA_SUCCESS;
            }

            if (theProfile->direction != DIRECT_RECV) {
                status = STATUS_INVALID;
                WFA_ENC_TLV(WFA_TRAFFIC_AGENT_RECV_STOP_TLV, 4, (BYTE *)&status, respBuf);
                *respLen = WFA_TLV_HDR_LEN + 4;

                return WFA_SUCCESS;
            }

            /* reset its flags , close sockets */
            switch (theProfile->profile) {
            case PROF_TRANSC:
            case PROF_CALI_RTD:
                gtgTransac = 0;
            case PROF_MCAST:
            case PROF_FILE_TX:
            case PROF_IPTV:
                gtgRecv = 0;
                if (tgSockfds[myStream->tblidx] != -1) {
                    wCLOSE(tgSockfds[myStream->tblidx]);
                    tgSockfds[myStream->tblidx] = -1;
                }
                break;

            case PROF_UAPSD:
#ifdef WFA_WMM_PS_EXT
                gtgWmmPS = 0;
                gtgPsPktRecvd = 0;

                if (psSockfd != -1) {
                    wCLOSE(psSockfd);
                    psSockfd = -1;
                }

                wMEMSET(&wmmps_info, 0, sizeof(wfaWmmPS_t));

                wfaSetDUTPwrMgmt(PS_OFF);
#endif /* WFA_WMM_PS_EXT */
                break;

            }

            /* encode a TLV for response for "complete/error ..." */
            statResp.status = STATUS_COMPLETE;
            statResp.streamId = streamid;

#if 0
            DPRINT_INFO("stream Id %u rx %u total %llu\r\n", streamid, myStream->stats.rxFrames, myStream->stats.rxPayloadBytes);
#endif
            wMEMCPY(&statResp.cmdru.stats, &myStream->stats, sizeof(tgStats_t));
            // Not empty it but require to reset the entire table before test starts.
            //wMEMSET(myStream, 0, sizeof(tgStream_t));
        }
        // FHOST
        else {
            dutCmdResponse_t *fhostCmdResp = NULL;
            sprintf(gCmdStr, "tg stop %u", streamid);
            DPRINT_INFO("CMD --> %s\r\n", gCmdStr);
            // write the command string in the device file to execute it
            fhostCmdResp = FhostCmdExecute(gCmdStr, WFA_TRAFFIC_AGENT_RECV_STOP_TLV);

            if (fhostCmdResp != NULL) {
                statResp = *fhostCmdResp;
                free(fhostCmdResp);
            } else {
                statResp.status = STATUS_ERROR;
                DPRINT_ERR("Error: fhostCmdResp NULL\r\n");
            }
        }

        wMEMCPY((dutRspBuf + i * sizeof(dutCmdResponse_t)), (BYTE *)&statResp, sizeof(dutCmdResponse_t));
        id_cnt++;
    }

    if (DUT_TYPE != DUT_TYPE_FHOST) {
        // mark the stream inactive
        myStream->state = WFA_STREAM_INACTIVE;
    }
    printf("Sending back the statistics at recvstop\n");
    WFA_ENC_TLV(WFA_TRAFFIC_AGENT_RECV_STOP_TLV, id_cnt * sizeof(dutCmdResponse_t), dutRspBuf, respBuf);

    /* done here */
    *respLen = WFA_TLV_HDR_LEN + numStreams * sizeof(dutCmdResponse_t);

    DPRINT_OUT_FUNC();

    return WFA_SUCCESS;
}

/*
 * wfaTGSendStart: instruct traffic generator to start sending based on a profile
 * input:      cmd -- not used
 * response:   inform controller for "running"
 * return:     success or failed
 */
int wfaTGSendStart(int len, BYTE *parms, int *respLen, BYTE *respBuf)
{
    int i = 0, streamid = 0;
    int numStreams = len / 4;

    //int maxDuration = 0;
    //dutCmdResponse_t *fhostCmdResp = NULL;

    tgProfile_t *theProfile;
    tgStream_t *myStream = NULL;

    //dutCmdResponse_t staSendResp;

    DPRINT_IN_FUNC();

    //staSendResp.status = 0x0005;
    int status = 0x0005;
    DPRINT_INFO("nb streams %i\r\n", numStreams);

    for (i = 0; i < numStreams; i++) {
        wMEMCPY(&streamid, parms + (4 * i), 4);
        // FULLMAC and SOFTMAC
        if (DUT_TYPE != DUT_TYPE_FHOST) {

            myStream = findStreamProfile(streamid);
            if (myStream == NULL) {
                //staSendResp.status = STATUS_INVALID;
                status = STATUS_INVALID;
                WFA_ENC_TLV(WFA_TRAFFIC_AGENT_SEND_TLV, 4, (BYTE *)&status, respBuf);
                *respLen = WFA_TLV_HDR_LEN + 4;
                return WFA_SUCCESS;
            }

            theProfile = &myStream->profile;
            if (theProfile == NULL) {
                //staSendResp.status = STATUS_INVALID;
                status = STATUS_INVALID;
                WFA_ENC_TLV(WFA_TRAFFIC_AGENT_SEND_TLV, 4, (BYTE *)&status, respBuf);
                *respLen = WFA_TLV_HDR_LEN + 4;

                return WFA_SUCCESS;
            }

            if (theProfile->direction != DIRECT_SEND) {
                //staSendResp.status = STATUS_INVALID;
                status = STATUS_INVALID;
                WFA_ENC_TLV(WFA_TRAFFIC_AGENT_SEND_TLV, 4, (BYTE *)&status, respBuf);
                *respLen = WFA_TLV_HDR_LEN + 4;

                return WFA_SUCCESS;
            }

            /*
             * need to reset the stats
             */
            wMEMSET(&myStream->stats, 0, sizeof(tgStats_t));

            // mark the stream active;
            myStream->state = WFA_STREAM_ACTIVE;

            switch (theProfile->profile) {
            case PROF_FILE_TX:
            case PROF_MCAST:
            case PROF_TRANSC:
                gtgTransac = streamid;
                gtgSend = streamid;
            case PROF_CALI_RTD:
                gtgCaliRTD = streamid;
            case PROF_IPTV:
                gtgSend = streamid;

                /*
                 * singal the thread to Sending WMM traffic
                 */
                wmm_thr[usedThread].thr_flag = streamid;
                printf("streamid = %d\n", streamid);
#ifdef __LINUX__
                wPT_MUTEX_LOCK(&wmm_thr[usedThread].thr_flag_mutex);
                wPT_COND_SIGNAL(&wmm_thr[usedThread].thr_flag_cond);
                wPT_MUTEX_UNLOCK(&wmm_thr[usedThread].thr_flag_mutex);
#else
                rtos_set_semaphore(&wmm_thr[usedThread].thr_flag_mutex);
#endif
                usedThread++;
                //wfaSetProcPriority(90);

                break;
            }
        }
#ifdef CONFIG_RW_FHOST
        // FHOST
        else {
            sprintf(gCmdStr, "tg start %d", streamid);
            DPRINT_INFO("CMD --> %s\r\n", gCmdStr);

            // Normally the stream is configured during TG config process
            myStream = findStreamProfile(streamid);

            // write the command string in the device file to execute it
            fhostCmdResp = FhostCmdExecute(gCmdStr, WFA_TRAFFIC_AGENT_SEND_TLV);

            if (fhostCmdResp != NULL)
                free(fhostCmdResp);
            else
                DPRINT_ERR("Error: fhostCmdResp NULL\r\n");

            // Find the longest duration in all the streams to be started
            maxDuration = (maxDuration > myStream->profile.duration) ? maxDuration : myStream->profile.duration;
            DPRINT_INFO("TG SEND streamid : %d duration : %d maxDuration : %d \r\n", myStream->id, myStream->profile.duration, maxDuration);
        }
#endif  //CONFIG_RW_FHOST
    }

    // For FHOST, we have to do TG stop since there's no corresponding tag
    if (DUT_TYPE == DUT_TYPE_FHOST) {
#if 0
        int id_cnt = 0;
        BYTE dutRspBuf[FHOST_MAX_TRAFFIC_STREAMS * WFA_RESP_BUF_SZ];

        // suspension before executing the TG stop command
        wSLEEP(maxDuration);

        wMEMSET(dutRspBuf, 0, WFA_RESP_BUF_SZ);

        for (i = 0; i < numStreams; i++) {
            wMEMCPY(&streamid, parms + (4 * i), 4);

            sprintf(gCmdStr, "tg stop %d", streamid);
            DPRINT_INFO("CMD --> %s\r\n", gCmdStr);
            // write the command string in the device file to execute it
            fhostCmdResp = FhostCmdExecute(gCmdStr, WFA_TRAFFIC_AGENT_SEND_TLV);

            if (fhostCmdResp != NULL) {
                staSendResp = *fhostCmdResp;
                free(fhostCmdResp);
            } else {
                staSendResp.status = STATUS_ERROR;
                DPRINT_ERR("Error: fhostCmdResp NULL\r\n");
            }
            // if there's several streams, we should store all their information into the response buffer
            wMEMCPY((dutRspBuf + i * sizeof(dutCmdResponse_t)), (BYTE *)&staSendResp, sizeof(dutCmdResponse_t));
            id_cnt++;
        }
        WFA_ENC_TLV(WFA_TRAFFIC_AGENT_SEND_TLV, id_cnt * sizeof(dutCmdResponse_t),
                    (BYTE *)dutRspBuf, (BYTE *)respBuf);
        *respLen = WFA_TLV_HDR_LEN + id_cnt * sizeof(dutCmdResponse_t);
        //        wfaTrafficAgentSendResp((BYTE *)buff);
#endif
    } else {
        WFA_ENC_TLV(WFA_INVALID_TLV, 0, NULL, respBuf);
        *respLen = WFA_TLV_HDR_LEN;
    }

    DPRINT_OUT_FUNC();

    return WFA_SUCCESS;
}

int wfaTGReset(int len, BYTE *parms, int *respLen, BYTE *respBuf)
{
    dutCmdResponse_t *resetResp = &gGenericResp;
    int i;

    DPRINT_IN_FUNC();

    /* need to reset all traffic socket fds */
    if (btSockfd != -1) {
        wCLOSE(btSockfd);
        btSockfd = -1;
    }

    for (i = 0; i < WFA_MAX_TRAFFIC_STREAMS; i++) {
        if (tgSockfds[i] != -1) {
            wCLOSE(tgSockfds[i]);
            tgSockfds[i] = -1;
        }
    }

#ifdef __LINUX__
    /* reset the timer alarm if it was armed */
    wALARM(0);
#else
    rtos_stop_oneshot_timer(&wfa_tg_timer);
    rtos_change_period((beken_timer_t *)&wfa_tg_timer, 10);
    rtos_start_oneshot_timer(&wfa_tg_timer);
#endif

#ifdef CONFIG_WMM_FC
    if (wmm_fc_step != INVALID_STEP)
        wmm_fc_step++;
    DPRINT_ERR("WMM Step --> %d\n", wmm_fc_step);
    if (g_testcase == TESTCASE_HE_264_2G4) {
        if (wmm_fc_step == 3) {
#if XXX
            os_printf("AC0 0x%x\n", REG_READ(0x49100200));
            os_printf("AC1 0x%x\n", REG_READ(0x49100204));
            os_printf("AC2 0x%x\n", REG_READ(0x49100208));
            os_printf("AC3 0x%x\n", REG_READ(0x4910020C));

            // REG_WRITE(0x49100208, 0x2fa42); // EDCA VI reg
#endif
            os_printf("set EDCA VI reg\n");
        }
    }
#endif

    /* just reset the flags for the command */
    gtgRecv = 0;
    gtgSend = 0;
    gtgTransac = 0;
#ifdef WFA_VOICE_EXT
    gtgCaliRTD = 0;
    min_rttime = 0xFFFFFFFF;
    gtgPktRTDelay = 0xFFFFFFFF;
#endif

    totalTranPkts = 0;
    //gtimeOut = 0;

    runLoop = 0;

    usedThread = 0;
#ifdef WFA_WMM_PS_EXT
    gtgWmmPS = 0;
    gtgPsPktRecvd = 0;

    if (psSockfd != -1) {
        wCLOSE(psSockfd);
        psSockfd = -1;
    }

    wMEMSET(&wmmps_info, 0, sizeof(wfaWmmPS_t));

    //         wfaSetDUTPwrMgmt(PS_OFF);
#endif

    e2eResults[0] = '\0';

    /* Also need to clean up WMM streams NOT DONE YET!*/
    slotCnt = 0;             /* reset stream profile container */
    wMEMSET(gStreams, 0, WFA_MAX_TRAFFIC_STREAMS);

    /*
     * After be asked to reset, it should lower itself back to
     * normal level. It is optional implementation if it is not called
     * while it starts sending/receiving for raising priority level.
     */
    //wfaSetProcPriority(20);

    /* encode a TLV for response for "complete ..." */
    resetResp->status = STATUS_COMPLETE;
    WFA_ENC_TLV(WFA_TRAFFIC_AGENT_RESET_TLV, 4,
                (BYTE *)resetResp, respBuf);
    *respLen = WFA_TLV_HDR_LEN + 4;

    DPRINT_OUT_FUNC();

    return WFA_SUCCESS;
}

/*
 * calculate the sleep time for different frame rate
 * It should be done according the device
 * This is just one way to adjust the packet delivery speed. If you find
 * you device does not meet the test requirements, you MUST re-adjust
 * the method.
 */

/* The HZ value could be found in the build header file */
/* 100 -> 10ms, 1000 -> 1ms , etc                       */
#define WFA_KERNEL_MIN_TIMER_RES   100   /* HZ Value for 10 ms */

void wfaTxSleepTime(int profile, int rate, int *sleepTime, int *throttledRate)
{
    *sleepTime = 0;   /* in microseconds */
    /* calculate the sleep time based on frame rate */

    /*
     * Framerate is still required for Multicast traffic
     * Sleep and hold for a timeout.
     *
     * For WMM traffic, the framerate must also need for VO and VI.
     * the framerate 500, OS may not handle it precisely.
     */
    switch (profile) {
    /*
     * make it a fix rate
     * according to test plan, it requires ~80kbps which is around 50 frames/s
     * For other cases which may want to run experiments for very high rate,
     * the change should accommodate the requirement.
     */
    case PROF_MCAST:
        if (rate < 500 && rate >= 50) {
            *sleepTime = 100000;  /* sleep for 100 ms */
            *throttledRate = WFA_MCAST_FRATE;
        } else {
            *sleepTime = 100000;
            *throttledRate = rate;
        }
#if 0
        *throttledRate = WFA_MCAST_FRATE;
#endif
        break;

    /*
     * Vendor must find ways to better adjust the speed for their own device
     */
    case PROF_IPTV:
    case PROF_FILE_TX:
        if (rate > 50) {
            /*
             * this sleepTime indeed is now being used for time period
             * to send packets in the throttled Rate.
             * The idea here is that in each fixed 20 minisecond period,
             * The device will send rate/50 (rate = packets / second),
             * then go sleep for rest of time.
             */
            *sleepTime = 20000; /* fixed 20 miniseconds */
            *throttledRate = (rate ? rate : 10000) / 50;
            printf("Hi Sleep time %i, throttledRate %i\n", *sleepTime, *throttledRate);
        } else if (rate == 0) {
            *sleepTime = 20000; /* fixed 20 miniseconds */
            *throttledRate = (rate ? rate : 10000) / 50;
            printf("Hi Sleep time %i, throttledRate %i\n", *sleepTime, *throttledRate);
        } else if (rate > 0 && rate <= 50) { /* typically for voice */
            *throttledRate = 1;
            *sleepTime = 1000 * 1000 / rate;
        }
        break;
    default:
        DPRINT_ERR("Incorrect profile\r\n");
    }
}

#define WFA_TIME_DIFF(before, after, rtime, dtime) \
    dtime = rtime + (after.tv_sec*1000000 + after.tv_usec) - (before.tv_sec*1000000 + before.tv_usec);

void buzz_time(int delay)
{
    struct timeval now, stop;
    int diff;
    int remain_time = 0;

    wGETTIMEOFDAY(&stop, 0);

    stop.tv_usec += delay;
    if (stop.tv_usec > 1000000) {
        stop.tv_usec -= 1000000;
        stop.tv_sec += 1;
    }

    do {
        wGETTIMEOFDAY(&now, 0);
        WFA_TIME_DIFF(now, stop, remain_time, diff);
        rtos_delay_milliseconds(0);
    } while (diff > 0);
}

/**************************************************/
/* the actually functions to send/receive packets */
/**************************************************/

/* This is going to be a blocking SEND till it finishes */
int wfaSendLongFile(int mySockfd, int streamid, BYTE *aRespBuf, int *aRespLen)
{
    tgProfile_t           *theProf = NULL;
    tgStream_t            *myStream = NULL;
    struct sockaddr_in    toAddr;
    char                  *packBuf;
    int  packLen;
    int  bytesSent;
    dutCmdResponse_t sendResp;
    int sleepTime = 0;
    int throttledRate = 0;
    struct timeval before, after, af;
    int difftime = 0, counter = 0;
    struct timeval stime;
    //    int throttled_est_cost;
    int act_sleep_time;
    gettimeofday(&af, 0);

    DPRINT_IN_FUNC();

    /* find the profile */
    myStream = findStreamProfile(streamid);
    if (myStream == NULL)
        return WFA_FAILURE;

    theProf = &myStream->profile;

    if (theProf == NULL)
        return WFA_FAILURE;

    /* If RATE is 0 which means to send as much as possible, the frame size set to max UDP length */
    if (theProf->rate == 0) {
        if (theProf->hti == 0 && theProf->pksize && (theProf->pksize < MAX_UDP_LEN))
            packLen = theProf->pksize;
        else
            packLen = MAX_UDP_LEN;
    } else
        packLen = theProf->pksize;

    /* allocate a buf */
    packBuf = (char *)malloc(packLen + 1);
    if (!packBuf)
        return WFA_FAILURE;

    wMEMSET(packBuf, 0, packLen);

    /* fill in the header */
    wSTRNCPY(packBuf, "1345678", sizeof(tgHeader_t));

    /* initialize the destination address */
    wMEMSET(&toAddr, 0, sizeof(toAddr));
    toAddr.sin_family = AF_INET;
    toAddr.sin_addr.s_addr = inet_addr(theProf->dipaddr);
    toAddr.sin_port = htons(theProf->dport);

    /* if a frame rate and duration are defined, then we know
     * interval for each packet and how many packets it needs to
     * send.
     */
    if (theProf->duration != 0) {
        // printf("duration %i\n", theProf->duration);

        /*
         *  use this to decide periodical interval sleep time and frames to send
         *  int the each interval.
         *  Each device should adopt a own algorithm for better performance
         */
        wfaTxSleepTime(theProf->profile, theProf->rate, &sleepTime, &throttledRate);
        /*
         * alright, we need to raise the priority level of the process
         * to improve the real-time performance of packet sending.
         * Since this is for tuning purpose, it is optional implementation.
         */
        //wfaSetProcPriority(60);

        //interval = 1*1000000/theProf->rate ; // in usec;

        // Here assumes it takes 20 usec to send a packet
        //throttled_est_cost = throttledRate * 20;  // MUST estimate the cost per ppk
        act_sleep_time = sleepTime - adj_latency;
        if (act_sleep_time <= 0)
            act_sleep_time = sleepTime;

        // printf("sleep time %i act_sleep_time %i\n", sleepTime, act_sleep_time);

        runLoop = 1;
        while (runLoop) {
            counter++;
            /* fill in the counter */
            int2BuffBigEndian(counter, &((tgHeader_t *)packBuf)->hdr[8]);

            /*
             * the following code is only used to slow down
             * over fast traffic flooding the buffer and cause
             * packet drop or the other end not able to receive due to
             * some limitations, purely for experiment purpose.
             * each implementation needs some fine tune to it.
             */
            if (counter == 1) {
                wGETTIMEOFDAY(&before, NULL);

                before.tv_usec += sleepTime;
                if (before.tv_usec > 1000000) {
                    before.tv_usec -= 1000000;
                    before.tv_sec += 1;
                }
            }

            if (throttledRate != 0) {
                if (counter % throttledRate == 0) {
                    wGETTIMEOFDAY(&after, NULL);
                    difftime = wfa_itime_diff(&after, &before);

#if 0
                    if (difftime > adj_latency) {
                        // too much time left, go sleep
                        wUSLEEP(difftime - adj_latency);

                        wGETTIMEOFDAY(&after, NULL);
                        difftime = wfa_itime_diff(&after, &before);
                    }
#endif

                    // burn the rest to absort latency
                    if (difftime > 0)
                        buzz_time(difftime);

                    before.tv_usec += sleepTime;
                    if (before.tv_usec > 1000000) {
                        before.tv_usec -= 1000000;
                        before.tv_sec += 1;
                    }
                }
            } // otherwise, it floods

            /*
             * Fill the timestamp to the header.
             */
            wGETTIMEOFDAY(&stime, NULL);

            int2BuffBigEndian(stime.tv_sec, &((tgHeader_t *)packBuf)->hdr[12]);
            int2BuffBigEndian(stime.tv_usec, &((tgHeader_t *)packBuf)->hdr[16]);

#ifdef CONFIG_WMM_FC
            /* delay in handle tx to reduce pkt throughput */
            wmm_fc_handle_tx(theProf);
#endif

            bytesSent = wfaTrafficSendTo(mySockfd, packBuf, packLen, (struct sockaddr *)&toAddr);

            if (bytesSent != -1) {
                myStream->stats.txPayloadBytes += bytesSent;
                myStream->stats.txFrames++ ;
            } else {
#ifdef __LINUX
                int errsv = errno;
                switch (errsv) {
                case EAGAIN:
                case ENOBUFS:
                    DPRINT_ERR("send error\r\n");
                    wUSLEEP(1000);             /* hold for 1 ms */
                    counter-- ;
                    myStream->stats.txFrames--;
                    break;
                case ECONNRESET:
                    runLoop = 0;
                    break;
                case EPIPE:
                    runLoop = 0;
                    break;
                default:
                    break;
                    // perror("sendto: ");
                    // DPRINT_ERR("Packet sent error\r\n");
                }
#endif
            }

        }

        /*
         * lower back to an original level if the process is raised previously
         * It is optional.
         */
        //wfaSetProcPriority(30);
    } else { /* invalid parameters */
        /* encode a TLV for response for "invalid ..." */
        sendResp.status = STATUS_INVALID;
        WFA_ENC_TLV(WFA_TRAFFIC_AGENT_SEND_TLV, 4,
                    (BYTE *)&sendResp, (BYTE *)aRespBuf);

        /* done here */
        *aRespLen = WFA_TLV_HDR_LEN + 4;

        return WFA_FAILURE;
    }

    gtgSend = 0;

    /* free the buffer */
    wFREE(packBuf);

    //printf("done sending long\n");
    /* return statistics */
    sendResp.status = STATUS_COMPLETE;
    sendResp.streamId = myStream->id;
    wMEMCPY(&sendResp.cmdru.stats, &myStream->stats, sizeof(tgStats_t));

#if 1
    DPRINT_INFO("stream Id %u tx %u total %llu\r\n", myStream->id, myStream->stats.txFrames, myStream->stats.txPayloadBytes);
#endif

    WFA_ENC_TLV(WFA_TRAFFIC_AGENT_SEND_TLV, sizeof(dutCmdResponse_t),
                (BYTE *)&sendResp, (BYTE *)aRespBuf);

    *aRespLen = WFA_TLV_HDR_LEN + sizeof(dutCmdResponse_t);

    DPRINT_OUT_FUNC();

    return WFA_SUCCESS;
}


/* this only sends one packet a time */
int wfaSendShortFile(int mySockfd, int streamid, BYTE *sendBuf, int pksize, BYTE *aRespBuf, int *aRespLen)
{
    BYTE *packBuf = sendBuf;
    struct sockaddr_in toAddr;
    tgProfile_t *theProf;
    tgStream_t *myStream;
    int packLen, bytesSent = -1;
    dutCmdResponse_t sendResp;

    //DPRINT_IN_FUNC();

    if (mySockfd == -1) {
        /* stop */
        gtgTransac = 0;
        //gtimeOut = 0;
        gtgRecv = 0;
        gtgSend = 0;
        printf("stop short traffic\n");

        myStream = findStreamProfile(streamid);
        if (myStream != NULL) {
            sendResp.status = STATUS_COMPLETE;
            sendResp.streamId = streamid;
            wMEMCPY(&sendResp.cmdru.stats, &myStream->stats, sizeof(tgStats_t));

            WFA_ENC_TLV(WFA_TRAFFIC_AGENT_SEND_TLV, sizeof(dutCmdResponse_t), (BYTE *)&sendResp, aRespBuf);

            *aRespLen = WFA_TLV_HDR_LEN + sizeof(dutCmdResponse_t);
        }

        return WFA_FAILURE;
    }

    /* find the profile */
    myStream = findStreamProfile(streamid);

    if (myStream == NULL)
        return WFA_FAILURE;

    theProf = &myStream->profile;
    if (theProf == NULL)
        return WFA_FAILURE;

    if (pksize == 0)
        packLen = theProf->pksize;
    else
        packLen = pksize;

    wMEMSET(&toAddr, 0, sizeof(toAddr));
    toAddr.sin_family = AF_INET;
    toAddr.sin_addr.s_addr = inet_addr(theProf->sipaddr);
    toAddr.sin_port = htons(theProf->sport);

    if (gtgRecv && gtgTransac) {
        //      printf("mySock %i sipaddr %s sport %i\n", mySockfd, theProf->sipaddr, theProf->sport);
        toAddr.sin_addr.s_addr = inet_addr(theProf->sipaddr);
        toAddr.sin_port = htons(theProf->sport);
    } else if (gtgSend && gtgTransac) {
        //      printf("mySock %i dipaddr %s dport %i\n", mySockfd, theProf->dipaddr, theProf->dport);
        toAddr.sin_addr.s_addr = inet_addr(theProf->dipaddr);
        toAddr.sin_port = htons(theProf->dport);
    }
    memcpy(packBuf + 12, packBuf + 8, 4);    // keep original no
    int2BuffBigEndian(myStream->stats.txFrames, &((tgHeader_t *)packBuf)->hdr[8]);

    if (mySockfd != -1)
        bytesSent = wfaTrafficSendTo(mySockfd, (char *)packBuf, packLen, (struct sockaddr *)&toAddr);

    if (bytesSent != -1) {
        myStream->stats.txFrames++;
        myStream->stats.txPayloadBytes += bytesSent;
    } else {
        int errsv = errno;
        switch (errsv) {
        case EAGAIN:
        case ENOBUFS:
            DPRINT_ERR("send error\r\n");
            wUSLEEP(1000);             /* hold for 1 ms */
            myStream->stats.txFrames--;
            break;
        default:
            ;;
            //perror("sendto: ");
        }
    }

    sentTranPkts++;

    //DPRINT_OUT_FUNC();

    return WFA_SUCCESS;
}

/* always receive from a specified IP address and Port */
int wfaRecvFile(int mySockfd, int streamid, char *recvBuf)
{
    /* how many packets are received */
    char *packBuf = recvBuf;
    struct sockaddr_in fromAddr;
    tgProfile_t *theProf;
    tgStream_t *myStream;
    unsigned int bytesRecvd;
    int lostPkts;
    int tos = 0;

    /* find the profile */
    myStream = findStreamProfile(streamid);
    if (myStream == NULL)
        return WFA_FAILURE;

    theProf = &myStream->profile;
    if (theProf == NULL)
        return WFA_FAILURE;

    wMEMSET(packBuf, 0, MAX_UDP_LEN);

    wMEMSET(&fromAddr, 0, sizeof(fromAddr));
    fromAddr.sin_family = AF_INET;
    fromAddr.sin_addr.s_addr = inet_addr(theProf->dipaddr);
    fromAddr.sin_port = htons(theProf->dport);

    if (gtgRecv && gtgTransac) {
        fromAddr.sin_addr.s_addr = inet_addr(theProf->sipaddr);
        fromAddr.sin_port = htons(theProf->sport);
    } else if (gtgSend && gtgTransac) {
        fromAddr.sin_addr.s_addr = inet_addr(theProf->dipaddr);
        fromAddr.sin_port = htons(theProf->dport);
    }

    /* it is always to receive at least one packet, in case more in the
       queue, just pick them up.
     */
    bytesRecvd = wfaTrafficRecv(mySockfd, packBuf, (struct sockaddr *)&fromAddr, &tos);

#ifdef CONFIG_WMM_FC
    /* packet is discarded, return immediately */
    if (wmm_fc_handle_rx(theProf, tos))
        return bytesRecvd;
#endif

    if (bytesRecvd != -1) {
        myStream->stats.rxFrames++;
        myStream->stats.rxPayloadBytes += bytesRecvd;

        /*
         *  Get the lost packet count
         */
        lostPkts = bigEndianBuff2Int(&((tgHeader_t *)packBuf)->hdr[8]) - 1 - myStream->lastPktSN;
        myStream->stats.lostPkts += lostPkts;
        myStream->lastPktSN = bigEndianBuff2Int(&((tgHeader_t *)packBuf)->hdr[8]);
    } else {
#if 0
        DPRINT_ERR("Packet received error\r\n");
        perror("receive error");
#endif
    }
    return (bytesRecvd);
}

//  new add-on code to process limite bitrate data push
//

void wfaSleepMilsec(int milSec)
{
    if (milSec >0)
    usleep(milSec * 1000);
}

/* send limite bitrate data only
  Condition under Win7:
   payload <= 1000
   rate    <= 3500


*/
int wfaSendBitrateData(int mySockfd, int streamId, BYTE *pRespBuf, int *pRespLen)
{
    tgProfile_t           *theProf = findTGProfile(streamId);
    tgStream_t            *myStream =findStreamProfile(streamId);
    int                   ret = WFA_SUCCESS;
    struct sockaddr_in    toAddr;
    char                  *packBuf=NULL;
    int                   packLen, bytesSent, rate;
    //int                 sleepTimePerSent = 0;
    int                   nOverTimeCount = 0, nDuration=0, nOverSend=0;
    unsigned long long int sleepTotal=0, extraTimeSpendOnSending=0;   /* sleep mil-sec per sending  */
    int                   counter = 0, i, iSleep;     /*  frame data sending count */
    unsigned long         difftime;
    dutCmdResponse_t      sendResp;

    //int throttledRate = 0;
    struct timeval        before, after, stime;

    DPRINT_INFO("wfaSendBitrateData entering\r\n");
    /* error check section  */
    if ( (mySockfd < 0) || (streamId < 0) || ( pRespBuf == NULL)
            || ( pRespLen == NULL) )
    {
        DPRINT_INFO("wfaSendBitrateData pass-in parameter err mySockfd=%i streamId=%i pRespBuf=0x%x pRespLen=0x%x\r\n",
            mySockfd,streamId,pRespBuf,pRespLen);
        ret= WFA_FAILURE;
        goto errcleanup;
    }

    if ( theProf == NULL || myStream == NULL)
    {
        DPRINT_INFO("wfaSendBitrateData parameter err in NULL pt theProf=%l myStream=%l \r\n",
            theProf, myStream);
        ret= WFA_FAILURE;
        goto errcleanup;
    }
    if (theProf->rate == 0 || theProf->duration == 0)
    {  /*  rate == 0 means unlimited to push data out which is not this routine to do */
        DPRINT_INFO("wfaSendBitrateData usage error, bitrate=%i or duration=%i \r\n" ,
            theProf->rate, theProf->duration);
        ret= WFA_FAILURE;
        goto errcleanup;
    }

    if ((theProf->rate > 3500) || (theProf->pksize > 1000))
    {
        DPRINT_INFO("wfaSendBitrateData Warning, must set total streams rate<=10000 and payload<=1000; stream bitrate may not meet\r\n");
    }

    /* calculate bitrate asked */
    if ( (rate = theProf->pksize * theProf->rate * 8) > WFA_SEND_FIX_BITRATE_MAX)
    {
        DPRINT_INFO("wfaSendBitrateData over birate can do in the routine, req bitrate=%l \r\n",rate);
        ret= WFA_FAILURE;
        goto errcleanup;
    }
    /* alloc sending buff  */
    //packLen = (theProf->pksize * theProf->rate)/ WFA_SEND_FIX_BITRATE_FRAMERATE ;
    packLen = theProf->pksize;
    packBuf = (char *)malloc(packLen+4);
    if ( packBuf == NULL)
    {
        DPRINT_INFO("wfaSendBitrateData malloc err \r\n");
        ret= WFA_FAILURE;
        goto errcleanup;
    }
    memset(packBuf, 0, packLen + 4);
    /* fill in the header */
    wSTRNCPY(packBuf, "1345678", sizeof(tgHeader_t));

    /*  initialize the destination address  */
    memset(&toAddr, 0, sizeof(toAddr));
    toAddr.sin_family = AF_INET;
    toAddr.sin_addr.s_addr = inet_addr(theProf->dipaddr);
    toAddr.sin_port = htons(theProf->dport);

#if 0
    /*  set sleep time per sending */
    if ( theProf->rate < 100  )
        sleepTimePerSent =  WFA_SEND_FIX_BITRATE_SLEEP_PER_SEND  +1;
    else
        sleepTimePerSent = WFA_SEND_FIX_BITRATE_SLEEP_PER_SEND;
#endif

    runLoop=1; /* global defined share with thread routine, should remove it later  */
    while ( runLoop)
    {
        iSleep = 1;
        gettimeofday(&before, NULL);
        /* send data per second loop */
        for ( i=0; i<= (theProf->rate); i++)
        {
#ifdef CONFIG_WMM_FC
            /* delay in handle tx to reduce pkt throughput */
            wmm_fc_handle_tx(theProf);
#endif
           counter++;
           //iSleep++;
           /* fill in the counter */
           int2BuffBigEndian(counter, &((tgHeader_t *)packBuf)->hdr[8]);
           /*
            * Fill the timestamp to the header.
           */
           wGETTIMEOFDAY(&stime, NULL);
           int2BuffBigEndian(stime.tv_sec, &((tgHeader_t *)packBuf)->hdr[12]);
           int2BuffBigEndian(stime.tv_usec, &((tgHeader_t *)packBuf)->hdr[16]);

           bytesSent = wfaTrafficSendTo(mySockfd, packBuf, packLen,
                 (struct sockaddr *)&toAddr);
           if(bytesSent != -1)
           {
               myStream->stats.txPayloadBytes += bytesSent;
               myStream->stats.txFrames++ ;
            }
           else
           {
               counter--;
               wfaSleepMilsec(1);

               sleepTotal = sleepTotal + (unsigned long long int) 1;
               // DPRINT_INFO("wfaSendBitrateData wfaTrafficSendTo call ERR counter=%i i=%i; send busy, sleep %i MilSec then send\r\n", counter, i, sleepTimePerSent);
               i--;
           }
           /*  sleep per batch sending */
           if ( i == ((int)(theProf->rate/50)) * iSleep)
           {
              wfaSleepMilsec(10);
              sleepTotal = sleepTotal + (unsigned long long int) 10;
              iSleep++;
           }


        }// for loop per second sending
        //iSleep = 0;
        nDuration++;

        /*calculate second rest part need to sleep  */
        gettimeofday(&after, NULL);
        difftime = wfa_itime_diff(&before, &after);
        if ( difftime < 0 || difftime >= 1000000 )
        {/* over time used, no sleep, go back to send */
            nOverTimeCount++;
            //if (difftime > 1200000 )
               //DPRINT_INFO(WFA_OUT, "wfaSendBitrateData Warning difftime=%i nDuration=%i\r\n",difftime, nDuration);
            if ( difftime > 1000000)
                extraTimeSpendOnSending += (difftime - 1000000);
            wfaSleepMilsec(1);
            sleepTotal++;
            continue;
        }

        /* difftime < 1 sec case, use sleep to catchup time as 1 sec per sending  */
        /*  check with accumulated extra time spend on previous sending, difftime < 1 sec case */
        if (extraTimeSpendOnSending > 0)
        {
            if ( extraTimeSpendOnSending > 1000000 - difftime )
            {/* reduce sleep time to catch up over all on time sending   */
                extraTimeSpendOnSending = (extraTimeSpendOnSending - (1000000 - difftime));
                wfaSleepMilsec(5);
                sleepTotal = sleepTotal + (unsigned long long int) 5;
                continue;
            }
            else
            {  /* usec used to   */
                difftime =(unsigned long)( difftime - extraTimeSpendOnSending);
                extraTimeSpendOnSending = 0;
            }
        }

        difftime = difftime/1000; // convert to mil-sec

        if(1000 - difftime > 0)
        {/*  only sleep if there is extrac time with in the second did not spend on sending */
            wfaSleepMilsec(1000 - difftime);
            sleepTotal = sleepTotal + (unsigned long long int)(1000 - difftime);
        }

        if ( theProf->duration < nDuration)
        {
            nOverSend++;
        }

    }// while loop

    if (packBuf) free(packBuf);
    /* return statistics */
    sendResp.status = STATUS_COMPLETE;
    sendResp.streamId = myStream->id;

    memcpy(&sendResp.cmdru.stats, &myStream->stats, sizeof(tgStats_t));

    wfaEncodeTLV(WFA_TRAFFIC_AGENT_SEND_TLV, sizeof(dutCmdResponse_t),
                 (BYTE *)&sendResp, (BYTE *)pRespBuf);

    *pRespLen = WFA_TLV_HDR_LEN + sizeof(dutCmdResponse_t);

    extraTimeSpendOnSending = extraTimeSpendOnSending/1000;
    DPRINT_INFO("*** wfg_tg.cpp wfaSendBitrateData Count=%i txFrames=%i totalByteSent=%i sleepTotal=%llu milSec extraTimeSpendOnSending=%llu nOverTimeCount=%d nOverSend=%i rate=%d nDuration=%d iSleep=%d ***\r\n",
        counter, (myStream->stats.txFrames),(unsigned int) (myStream->stats.txPayloadBytes), sleepTotal,extraTimeSpendOnSending, nOverTimeCount, nOverSend, theProf->rate , nDuration,iSleep);
    wfaSleepMilsec(1000);
    return ret;

errcleanup:
    /* encode a TLV for response for "invalid ..." */
    if (packBuf) free(packBuf);

    sendResp.status = STATUS_INVALID;
    wfaEncodeTLV(WFA_TRAFFIC_AGENT_SEND_TLV, 4,
                 (BYTE *)&sendResp, (BYTE *)pRespBuf);
    /* done here */
    *pRespLen = WFA_TLV_HDR_LEN + 4;

    return ret;
}/*  wfaSendBitrateData  */
