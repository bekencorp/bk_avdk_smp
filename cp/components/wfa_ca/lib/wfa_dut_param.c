/****************************************************************************
 *  (c) Copyright 2007 Wi-Fi Alliance.  All Rights Reserved
 *
 *
 *  LICENSE
 *
 *  License is granted only to Wi-Fi Alliance members and designated
 *  contractors ($B!H(BAuthorized Licensees$B!I(B)..AN  Authorized Licensees are granted
 *  the non-exclusive, worldwide, limited right to use, copy, import, export
 *  and distribute this software:
 *  (i) solely for noncommercial applications and solely for testing Wi-Fi
 *  equipment; and
 *  (ii) solely for the purpose of embedding the software into Authorized
 *  Licensee$B!G(Bs proprietary equipment and software products for distribution to
 *  its customers under a license with at least the same restrictions as
 *  contained in this License, including, without limitation, the disclaimer of
 *  warranty and limitation of liability, below..AN  The distribution rights
 *  granted in clause
 *  (ii), above, include distribution to third party companies who will
 *  redistribute the Authorized Licensee$B!G(Bs product to their customers with or
 *  without such third party$B!G(Bs private label. Other than expressly granted
 *  herein, this License is not transferable or sublicensable, and it does not
 *  extend to and may not be used with non-Wi-Fi applications..AN  Wi-Fi Alliance
 *  reserves all rights not expressly granted herein..AN
 *.AN
 *  Except as specifically set forth above, commercial derivative works of
 *  this software or applications that use the Wi-Fi scripts generated by this
 *  software are NOT AUTHORIZED without specific prior written permission from
 *  Wi-Fi Alliance.
 *.AN
 *  Non-Commercial derivative works of this software for internal use are
 *  authorized and are limited by the same restrictions; provided, however,
 *  that the Authorized Licensee shall provide Wi-Fi Alliance with a copy of
 *  such derivative works under a perpetual, payment-free license to use,
 *  modify, and distribute such derivative works for purposes of testing Wi-Fi
 *  equipment.
 *.AN
 *  Neither the name of the author nor "Wi-Fi Alliance" may be used to endorse
 *  or promote products that are derived from or that use this software without
 *  specific prior written permission from Wi-Fi Alliance.
 *
 *  THIS SOFTWARE IS PROVIDED BY WI-FI ALLIANCE "AS IS" AND ANY EXPRESS OR
 *  IMPLIED WARRANTIES, INCLUDING, BUT NOT LIMITED TO, THE IMPLIED WARRANTIES
 *  OF MERCHANTABILITY, NON-INFRINGEMENT AND FITNESS FOR A.AN PARTICULAR PURPOSE,
 *  ARE DISCLAIMED. IN NO EVENT SHALL WI-FI ALLIANCE BE LIABLE FOR ANY DIRECT,
 *  INDIRECT, INCIDENTAL, SPECIAL, EXEMPLARY, OR CONSEQUENTIAL DAMAGES
 *  (INCLUDING, BUT NOT LIMITED TO, THE COST OF PROCUREMENT OF SUBSTITUTE
 *  GOODS OR SERVICES; LOSS OF USE, DATA, OR PROFITS; OR BUSINESS INTERRUPTION)
 *  HOWEVER CAUSED AND ON ANY THEORY OF LIABILITY, WHETHER IN CONTRACT,
 *  STRICT LIABILITY, OR TORT (INCLUDING NEGLIGENCE) ARISING IN ANY WAY OUT OF
 *  THE USE OF THIS SOFTWARE, EVEN IF ADVISED OF THE POSSIBILITY OF SUCH DAMAGE. ******************************************************************************
 */


#include <stddef.h>
#include <stdlib.h>
#include <string.h>
#include "wfa_types.h"
#include "wfa_ca.h"
#include "wfa_debug.h"
#include "wfa_dut_param.h"

#define GENERATE_STRING(STRING) #STRING,

const char *dut_setup_param_name[DUT_SETUP_PARAM_MAX] =
{
    FOREACH_DUT_SETUP_PARAM(GENERATE_STRING)
};

int dut_setup_param_default[DUT_SETUP_PARAM_MAX];
int dut_setup_param[DUT_SETUP_PARAM_MAX];

const char *dut_feats_param_name[DUT_FEATS_PARAM_MAX] =
{
    FOREACH_DUT_FEATS_PARAM(GENERATE_STRING)
};

int dut_feats_param_default[DUT_FEATS_PARAM_MAX];
int dut_feats_param[DUT_FEATS_PARAM_MAX];

const char *dut_common_param_name[DUT_COMMON_PARAM_MAX] =
{
    FOREACH_DUT_COMMON_PARAM(GENERATE_STRING)
};

int dut_common_param_default[DUT_COMMON_PARAM_MAX];
int dut_common_param[DUT_COMMON_PARAM_MAX];

const char *dut_smac_param_name[DUT_SMAC_PARAM_MAX] =
{
    FOREACH_DUT_SMAC_PARAM(GENERATE_STRING)
};

int dut_smac_param_default[DUT_SMAC_PARAM_MAX];
int dut_smac_param[DUT_SMAC_PARAM_MAX];

const char *dut_fmac_param_name[DUT_FMAC_PARAM_MAX] =
{
    FOREACH_DUT_FMAC_PARAM(GENERATE_STRING)
};

int dut_fmac_param_default[DUT_FMAC_PARAM_MAX];
int dut_fmac_param[DUT_FMAC_PARAM_MAX];

static int wfa_dut_param_get(int param_cnt, const char *param_name[], int param_val[])
{
#ifdef __LINUX__
    int i;

    for (i = 0; i < param_cnt; i++)
    {
        char *var=NULL;
        char var_name[128];

        snprintf(var_name, sizeof(var_name), "param_%s", param_name[i]);
        var = getenv(var_name);
        if (var == NULL)
        {
            DPRINT_INFO("Failed to get %s\r\n", param_name[i]);
            continue;
        }

        param_val[i]= atoi(var);
    }
#endif

    return WFA_SUCCESS;
}

static int wfa_dut_param_print(int param_cnt, const char *param_name[], int param_val[])
{
    int i;

    for (i = 0; i < param_cnt; i++)
    {
        DPRINT_INFO("%-20s: %d\r\n", param_name[i], param_val[i]);
    }

    return WFA_SUCCESS;
}

static int wfa_dut_param_format(char **opt, int *len, int param_cnt,
                                const char *param_name[], int param_val[])
{
    int i;

    // First put common options
    for (i = 0; i < param_cnt; i++)
    {
        int opt_len;

        opt_len = snprintf(*opt, *len, "%s=%d ", param_name[i], param_val[i]);
        if ((opt_len < 0) || (opt_len >= *len))
            return WFA_FAILURE;

        *opt += opt_len;
        *len -= opt_len;
    }
    return WFA_SUCCESS;
}

int wfa_dut_param_get_default(void)
{
    // Reset all parameter tables
    memset(dut_setup_param_default, 0, sizeof(dut_setup_param_default));
    memset(dut_feats_param_default, 0, sizeof(dut_feats_param_default));
    memset(dut_common_param_default, 0, sizeof(dut_common_param_default));
    memset(dut_smac_param_default, 0, sizeof(dut_smac_param_default));
    memset(dut_fmac_param_default, 0, sizeof(dut_fmac_param_default));

    wfa_dut_param_get(DUT_SETUP_PARAM_MAX, dut_setup_param_name,
                      dut_setup_param_default);
    wfa_dut_param_get(DUT_FEATS_PARAM_MAX, dut_feats_param_name,
                      dut_feats_param_default);
    wfa_dut_param_get(DUT_COMMON_PARAM_MAX, dut_common_param_name,
                      dut_common_param_default);
    wfa_dut_param_get(DUT_SMAC_PARAM_MAX, dut_smac_param_name,
                      dut_smac_param_default);
    wfa_dut_param_get(DUT_FMAC_PARAM_MAX, dut_fmac_param_name,
                      dut_fmac_param_default);

	//setup
	PARAM_SETUP_DEF(umac) = 1;

	//features
	PARAM_FEATS_DEF(width) = 20;
	PARAM_FEATS_DEF(dtim) = 2;
	PARAM_FEATS_DEF(pmf) = 1;

	//common
	PARAM_COMMON_DEF(ldpc_on) = 1;
	PARAM_COMMON_DEF(nss) = 1;
	PARAM_COMMON_DEF(amsdu_maxnb) = 0;
	PARAM_COMMON_DEF(amsdu_rx_max) = 2;
	PARAM_COMMON_DEF(bfmee) = 1;
	PARAM_COMMON_DEF(ht_on) = 1;
	PARAM_COMMON_DEF(murx) = 1;
	PARAM_COMMON_DEF(sgi) = 1;
	PARAM_COMMON_DEF(vht_on) = 1;
	PARAM_COMMON_DEF(stbc_on) = 1;
	PARAM_COMMON_DEF(he_ul_on) = 1;
	PARAM_COMMON_DEF(he_on) = 1;

    // PRINT MODULES PARAMS
    DPRINT_BOX("SETUP PARAMS" );
    wfa_dut_param_print(DUT_SETUP_PARAM_MAX, dut_setup_param_name, dut_setup_param_default);
    DPRINT_BOX("FEATS PARAMS" );
    wfa_dut_param_print(DUT_FEATS_PARAM_MAX, dut_feats_param_name, dut_feats_param_default);
    DPRINT_BOX("COMMON PARAMS" );
    wfa_dut_param_print(DUT_COMMON_PARAM_MAX, dut_common_param_name, dut_common_param_default);
    DPRINT_BOX("SMAC PARAMS" );
    wfa_dut_param_print(DUT_SMAC_PARAM_MAX, dut_smac_param_name, dut_smac_param_default);
    DPRINT_BOX("FMAC PARAMS" );
    wfa_dut_param_print(DUT_FMAC_PARAM_MAX, dut_fmac_param_name, dut_fmac_param_default);

    DPRINT_INFO("+---------------------------------------------------------+\r\n" );

    // Copy default to current tables
    memcpy(dut_setup_param, dut_setup_param_default, sizeof(dut_setup_param_default));
    memcpy(dut_feats_param, dut_feats_param_default, sizeof(dut_feats_param_default));
    memcpy(dut_common_param, dut_common_param_default, sizeof(dut_common_param_default));
    memcpy(dut_smac_param, dut_smac_param_default, sizeof(dut_smac_param_default));
    memcpy(dut_fmac_param, dut_fmac_param_default, sizeof(dut_fmac_param_default));

    return WFA_SUCCESS;
}

int wfa_dut_param_set_default(void)
{
    memcpy(dut_setup_param, dut_setup_param_default, sizeof(dut_setup_param_default));
    memcpy(dut_feats_param, dut_feats_param_default, sizeof(dut_feats_param_default));
    memcpy(dut_common_param, dut_common_param_default, sizeof(dut_common_param_default));
    memcpy(dut_smac_param, dut_smac_param_default, sizeof(dut_smac_param_default));
    memcpy(dut_fmac_param, dut_fmac_param_default, sizeof(dut_fmac_param_default));

    return WFA_SUCCESS;
}

int wfa_dut_param_build_options(char *buf, int buflen)
{
    char *opt = buf;
    int len = buflen;

    // First put common options
    if (wfa_dut_param_format(&opt, &len, DUT_COMMON_PARAM_MAX, dut_common_param_name,
                             dut_common_param) != WFA_SUCCESS)
        return WFA_FAILURE;

    if (DUT_TYPE == DUT_TYPE_SMAC)
    {
        if (wfa_dut_param_format(&opt, &len, DUT_SMAC_PARAM_MAX, dut_smac_param_name,
                             dut_smac_param) != WFA_SUCCESS)
            return WFA_FAILURE;
    }
    else if(DUT_TYPE == DUT_TYPE_FMAC)
    {
        if (wfa_dut_param_format(&opt, &len, DUT_FMAC_PARAM_MAX, dut_fmac_param_name,
                             dut_fmac_param) != WFA_SUCCESS)
            return WFA_FAILURE;
    }
    else if (DUT_TYPE == DUT_TYPE_FHOST)
    {
        if (wfa_dut_param_format(&opt, &len, DUT_FMAC_PARAM_MAX, dut_fmac_param_name,
                             dut_fmac_param) != WFA_SUCCESS)
            return WFA_FAILURE;
    }

    return WFA_SUCCESS;
}

