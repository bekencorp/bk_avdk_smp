/****************************************************************************
 *  (c) Copyright 2007 Wi-Fi Alliance.  All Rights Reserved
 *
 *
 *  LICENSE
 *
 *  License is granted only to Wi-Fi Alliance members and designated
 *  contractors ($B!H(BAuthorized Licensees$B!I(B)..AN  Authorized Licensees are granted
 *  the non-exclusive, worldwide, limited right to use, copy, import, export
 *  and distribute this software:
 *  (i) solely for noncommercial applications and solely for testing Wi-Fi
 *  equipment; and
 *  (ii) solely for the purpose of embedding the software into Authorized
 *  Licensee$B!G(Bs proprietary equipment and software products for distribution to
 *  its customers under a license with at least the same restrictions as
 *  contained in this License, including, without limitation, the disclaimer of
 *  warranty and limitation of liability, below..AN  The distribution rights
 *  granted in clause
 *  (ii), above, include distribution to third party companies who will
 *  redistribute the Authorized Licensee$B!G(Bs product to their customers with or
 *  without such third party$B!G(Bs private label. Other than expressly granted
 *  herein, this License is not transferable or sublicensable, and it does not
 *  extend to and may not be used with non-Wi-Fi applications..AN  Wi-Fi Alliance
 *  reserves all rights not expressly granted herein..AN
 *.AN
 *  Except as specifically set forth above, commercial derivative works of
 *  this software or applications that use the Wi-Fi scripts generated by this
 *  software are NOT AUTHORIZED without specific prior written permission from
 *  Wi-Fi Alliance.
 *.AN
 *  Non-Commercial derivative works of this software for internal use are
 *  authorized and are limited by the same restrictions; provided, however,
 *  that the Authorized Licensee shall provide Wi-Fi Alliance with a copy of
 *  such derivative works under a perpetual, payment-free license to use,
 *  modify, and distribute such derivative works for purposes of testing Wi-Fi
 *  equipment.
 *.AN
 *  Neither the name of the author nor "Wi-Fi Alliance" may be used to endorse
 *  or promote products that are derived from or that use this software without
 *  specific prior written permission from Wi-Fi Alliance.
 *
 *  THIS SOFTWARE IS PROVIDED BY WI-FI ALLIANCE "AS IS" AND ANY EXPRESS OR
 *  IMPLIED WARRANTIES, INCLUDING, BUT NOT LIMITED TO, THE IMPLIED WARRANTIES
 *  OF MERCHANTABILITY, NON-INFRINGEMENT AND FITNESS FOR A.AN PARTICULAR PURPOSE,
 *  ARE DISCLAIMED. IN NO EVENT SHALL WI-FI ALLIANCE BE LIABLE FOR ANY DIRECT,
 *  INDIRECT, INCIDENTAL, SPECIAL, EXEMPLARY, OR CONSEQUENTIAL DAMAGES
 *  (INCLUDING, BUT NOT LIMITED TO, THE COST OF PROCUREMENT OF SUBSTITUTE
 *  GOODS OR SERVICES; LOSS OF USE, DATA, OR PROFITS; OR BUSINESS INTERRUPTION)
 *  HOWEVER CAUSED AND ON ANY THEORY OF LIABILITY, WHETHER IN CONTRACT,
 *  STRICT LIABILITY, OR TORT (INCLUDING NEGLIGENCE) ARISING IN ANY WAY OUT OF
 *  THE USE OF THIS SOFTWARE, EVEN IF ADVISED OF THE POSSIBILITY OF SUCH DAMAGE. ******************************************************************************
 */


#ifndef WFA_DEBUG_H
#define WFA_DEBUG_H

#include <stdio.h>
#include <components/system.h>

extern unsigned short wfa_defined_debug;

#define WFA_DEBUG_DEFAULT          0x0001
#define WFA_DEBUG_ERR              0x0001
#define WFA_DEBUG_INFO             0x0002
#define WFA_DEBUG_WARNING          0x0004

#define WFA_COLOR_RED     "\x1b[31m"
#define WFA_COLOR_GREEN   "\x1b[32m"
#define WFA_COLOR_YELLOW  "\x1b[33m"
#define WFA_COLOR_BLUE    "\x1b[34m"
#define WFA_COLOR_MAGENTA "\x1b[35m"
#define WFA_COLOR_CYAN    "\x1b[36m"
#define WFA_COLOR_RESET   "\x1b[0m"

#define CUSTOM_COLOR_RED     "\033[91m"
#define CUSTOM_COLOR_GREEN   "\033[92m"
#define CUSTOM_COLOR_YELLOW  "\033[93m"
#define CUSTOM_COLOR_BLUE    "\033[94m"
#define CUSTOM_COLOR_MAGENTA "\033[95m"
#define CUSTOM_COLOR_CYAN    "\033[96m"
#define CUSTOM_COLOR_RESET   "\x1b[0m"

#define WFA_DEBUG 1

#define printf(...)    bk_printf_raw(0, "", ## __VA_ARGS__)

#define DPRINT_ERR(msg, ...)                                                             \
do {                                                                                     \
    char _str[256];                                                                       \
    snprintf(_str, sizeof(_str), msg, ## __VA_ARGS__);                                     \
    printf(" < ERROR > " CUSTOM_COLOR_RED "\r\n!!! func %s, Line %d: ", __FUNCTION__, __LINE__);      \
    printf("%s !!!\r\n" WFA_COLOR_RESET, _str);                                   \
} while(0)

#define DPRINT_CONTENT(msg, ...)                                                         \
do {                                                                                     \
    if(wfa_defined_debug & WFA_DEBUG_INFO)                                               \
        printf(CUSTOM_COLOR_BLUE msg WFA_COLOR_RESET, ## __VA_ARGS__);         \
} while(0)

#define DPRINT_CONTENT_S(msg, ...)                                                       \
do {                                                                                     \
    if(wfa_defined_debug & WFA_DEBUG_INFO)                                               \
        printf(msg , ## __VA_ARGS__);                                          \
} while(0)

#define DPRINT_CONTENT_IN(msg, ...)                                                      \
do {                                                                                     \
    if(wfa_defined_debug & WFA_DEBUG_INFO)                                               \
        printf(CUSTOM_COLOR_MAGENTA msg WFA_COLOR_RESET, ## __VA_ARGS__);      \
} while(0)

#define DPRINT_CONTENT_OUT(msg, ...)                                                     \
do {                                                                                     \
    if(wfa_defined_debug & WFA_DEBUG_INFO)                                               \
        printf(msg , ## __VA_ARGS__);                                          \
} while(0)

#define DPRINT_CONTENT_TLV(msg, ...)                                                     \
do {                                                                                     \
    if(wfa_defined_debug & WFA_DEBUG_INFO)                                               \
        printf(CUSTOM_COLOR_GREEN msg WFA_COLOR_RESET, ## __VA_ARGS__);        \
} while(0)

#define DPRINT_INFO(msg, ...)                                                            \
do {                                                                                     \
    if(wfa_defined_debug & WFA_DEBUG_INFO)                                               \
        printf(CUSTOM_COLOR_CYAN msg WFA_COLOR_RESET, ## __VA_ARGS__);         \
} while(0)

#define DPRINT_CMD(msg)                                                                  \
do {                                                                                     \
    if(wfa_defined_debug & WFA_DEBUG_INFO)                                               \
        bk_printf_raw(0, "", " < CMD > " CUSTOM_COLOR_YELLOW "%s\r\n" WFA_COLOR_RESET, msg);   \
} while(0)

#define DPRINT_WARNING(msg, ...)                                                         \
do {                                                                                     \
    if(wfa_defined_debug & WFA_DEBUG_WARNING)                                            \
        printf(msg, ## __VA_ARGS__);                                           \
} while(0)

#define DPRINT_BOX(msg, ...)                                                             \
do {                                                                                     \
    char str[256];                                                                       \
    snprintf(str, sizeof(str), msg, ## __VA_ARGS__);                                     \
    DPRINT_CONTENT("\r\n+**********************************************************+\r\n");  \
    DPRINT_CONTENT("| %-57s|\r\n", str);                                                   \
    DPRINT_CONTENT("+**********************************************************+\r\n\r\n");  \
} while(0)

#define DPRINT_BOX_IN(msg, ...)                                                          \
do {                                                                                     \
    char str[256];                                                                       \
    snprintf(str, sizeof(str), msg, ## __VA_ARGS__);                                     \
    DPRINT_CONTENT("\r\n+-----------------------------------------------------------------------------+\r\n");   \
    DPRINT_CONTENT_IN("| %-76s|\r\n", str);                                                \
    DPRINT_CONTENT("+-----------------------------------------------------------------------------+\r\n\r\n");   \
} while(0)

#define DPRINT_BOX_OUT(msg, ...)                                                         \
do {                                                                                     \
    char str[256];                                                                       \
    snprintf(str, sizeof(str), msg, ## __VA_ARGS__);                                     \
    DPRINT_CONTENT("\r\n+-----------------------------------------------------------------------------+\r\n");   \
    DPRINT_CONTENT_OUT("| %-76s|\r\n", str);                                               \
    DPRINT_CONTENT("+-----------------------------------------------------------------------------+\r\n\r\n");   \
} while(0)

#define DPRINT_BOX_TLV(msg, ...)                                                         \
do {                                                                                     \
    char str[256];                                                                       \
    snprintf(str, sizeof(str), msg, ## __VA_ARGS__);                                     \
    DPRINT_CONTENT("\r\n+---------------------------------------------------------+\r\n");   \
    DPRINT_CONTENT_TLV("| %-56s|\r\n", str);                                               \
    DPRINT_CONTENT("+---------------------------------------------------------+\r\n\r\n");   \
} while(0)

#define DPRINT_IN_FUNC() DPRINT_BOX_IN( "IN -->>> function: %s()", __func__)
#define DPRINT_OUT_FUNC() DPRINT_BOX_OUT("END -->>> function: %s()", __func__)

#endif
